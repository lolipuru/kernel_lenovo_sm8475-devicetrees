&mdss_mdp {
	dsi_nt36523n_lcd_144hz_hyper_video_cphy: qcom,mdss_dsi_nt36523n_fhd_plus_cphy_144hz_hyper_vid {
		qcom,mdss-dsi-panel-name =
			"nt36523n lcd video mode dsi tcl panel with DSC";
		qcom,mdss-dsi-panel-type = "dsi_video_mode";
		qcom,dsi-ctrl-num = <0 1>;
		qcom,dsi-phy-num = <0 1>;

		qcom,mdss-dsi-virtual-channel-id = <0>;
		qcom,mdss-dsi-stream = <0>;
		qcom,mdss-dsi-bpp = <24>;
		qcom,mdss-dsi-border-color = <0>;

		qcom,mdss-dsi-traffic-mode = "burst_mode";
		qcom,mdss-dsi-bllp-eof-power-mode;
		qcom,mdss-dsi-bllp-power-mode;
		qcom,mdss-dsi-lane-0-state;
		qcom,mdss-dsi-lane-1-state;
		qcom,mdss-dsi-lane-2-state;
		qcom,mdss-dsi-dma-trigger = "trigger_sw";
		qcom,mdss-dsi-mdp-trigger = "none";
		qcom,mdss-dsi-reset-sequence =<0 10>, <1 10>, <0 10>, <1 11>;
		qcom,mdss-pan-physical-width-dimension = <118>;
		qcom,mdss-pan-physical-height-dimension = <190>;
		qcom,mdss-dsi-tx-eot-append;   //test
		qcom,adjust-timer-wakeup-ms = <1>;
		qcom,panel-cphy-mode;     //for cphy

		qcom,mdss-dsi-panel-hdr-enabled;   //test
		qcom,mdss-dsi-panel-hdr-color-primaries = <14500 15500 32000
						17000 15500 30000 8000 3000>;
		qcom,mdss-dsi-panel-peak-brightness = <4200000>;
		qcom,mdss-dsi-panel-blackness-level = <3230>;

		qcom,mdss-dsi-lp11-init; 
		qcom,mdss-dsi-underflow-color = <0x3ff>;
		qcom,mdss-dsi-display-timings {
			timing@0 {
				cell-index = <0>;
				qcom,mdss-dsi-panel-width = <800>;  //1/2
				qcom,mdss-dsi-panel-height = <2560>;
				qcom,mdss-dsi-h-front-porch = <137>;
				qcom,mdss-dsi-h-back-porch = <54>;
				qcom,mdss-dsi-h-pulse-width = <20>;
				qcom,mdss-dsi-h-sync-skew = <0>;
				qcom,mdss-dsi-v-back-porch = <256>;
				qcom,mdss-dsi-v-front-porch = <30>;
				qcom,mdss-dsi-v-pulse-width = <4>;
				qcom,mdss-dsi-h-sync-pulse = <0>;
				qcom,mdss-dsi-panel-clockrate = <573510000>; //original 476.41Mhz-119.7hz
				qcom,mdss-dsi-panel-framerate = <120>;

				qcom,mdss-dsi-on-command = [

				39 01 00 00 00 00 02 FF D0
				39 01 00 00 00 00 02 FB 01
				39 01 00 00 00 00 02 00 30
				39 01 00 00 00 00 02 09 EE
				39 01 00 00 00 00 02 1C 99
				39 01 00 00 00 00 02 1D 09
				39 01 00 00 00 00 02 FF 20
				39 01 00 00 00 00 02 FB 01
				39 01 00 00 00 00 02 05 09
				39 01 00 00 00 00 02 06 C0
				39 01 00 00 00 00 02 07 3A
				39 01 00 00 00 00 02 08 1E
				39 01 00 00 00 00 02 0D 63
				39 01 00 00 00 00 02 0E 55
				39 01 00 00 00 00 02 0F 37
				39 01 00 00 00 00 02 30 10
				39 01 00 00 00 00 02 31 02
				39 01 00 00 00 00 02 32 42
				39 01 00 00 00 00 02 58 43
				39 01 00 00 00 00 02 60 BB
				39 01 00 00 00 00 02 62 36
				39 01 00 00 00 00 02 63 A6
				39 01 00 00 00 00 02 65 00
				39 01 00 00 00 00 02 69 98
				39 01 00 00 00 00 02 6D 66
				39 01 00 00 00 00 02 6E 00
				39 01 00 00 00 00 02 75 C4
				39 01 00 00 00 00 02 77 3B
				39 01 00 00 00 00 02 7C 44
				39 01 00 00 00 00 02 94 00
				39 01 00 00 00 00 02 95 D7
				39 01 00 00 00 00 02 96 D7
				39 01 00 00 00 00 02 FF 24
				39 01 00 00 00 00 02 FB 01
				39 01 00 00 00 00 02 00 23
				39 01 00 00 00 00 02 01 03
				39 01 00 00 00 00 02 02 22
				39 01 00 00 00 00 02 03 22
				39 01 00 00 00 00 02 04 03
				39 01 00 00 00 00 02 05 13
				39 01 00 00 00 00 02 06 12
				39 01 00 00 00 00 02 07 11
				39 01 00 00 00 00 02 08 10
				39 01 00 00 00 00 02 09 0F
				39 01 00 00 00 00 02 0A 0E
				39 01 00 00 00 00 02 0B 0D
				39 01 00 00 00 00 02 0C 0C
				39 01 00 00 00 00 02 0D 03
				39 01 00 00 00 00 02 0E 04
				39 01 00 00 00 00 02 0F 28
				39 01 00 00 00 00 02 10 00
				39 01 00 00 00 00 02 11 03
				39 01 00 00 00 00 02 12 26
				39 01 00 00 00 00 02 13 03
				39 01 00 00 00 00 02 14 27
				39 01 00 00 00 00 02 15 27
				39 01 00 00 00 00 02 16 23
				39 01 00 00 00 00 02 17 03
				39 01 00 00 00 00 02 18 22
				39 01 00 00 00 00 02 19 22
				39 01 00 00 00 00 02 1A 03
				39 01 00 00 00 00 02 1B 13
				39 01 00 00 00 00 02 1C 12
				39 01 00 00 00 00 02 1D 11
				39 01 00 00 00 00 02 1E 10
				39 01 00 00 00 00 02 1F 0F
				39 01 00 00 00 00 02 20 0E
				39 01 00 00 00 00 02 21 0D
				39 01 00 00 00 00 02 22 0C
				39 01 00 00 00 00 02 23 03
				39 01 00 00 00 00 02 24 04
				39 01 00 00 00 00 02 25 28
				39 01 00 00 00 00 02 26 00
				39 01 00 00 00 00 02 27 03
				39 01 00 00 00 00 02 28 26
				39 01 00 00 00 00 02 29 03
				39 01 00 00 00 00 02 2A 27
				39 01 00 00 00 00 02 2B 27
				39 01 00 00 00 00 02 2F 04
				39 01 00 00 00 00 02 30 03
				39 01 00 00 00 00 02 33 04
				39 01 00 00 00 00 02 34 04
				39 01 00 00 00 00 02 37 44
				39 01 00 00 00 00 02 3A 3D
				39 01 00 00 00 00 02 3B 00
				39 01 00 00 00 00 02 3D 02
				39 01 00 00 00 00 02 4D 43
				39 01 00 00 00 00 02 4E 65
				39 01 00 00 00 00 02 4F 87
				39 01 00 00 00 00 02 50 21
				39 01 00 00 00 00 02 51 56
				39 01 00 00 00 00 02 52 34
				39 01 00 00 00 00 02 53 12
				39 01 00 00 00 00 02 54 78
				39 01 00 00 00 00 03 55 04 04
				39 01 00 00 00 00 02 56 08
				39 01 00 00 00 00 02 58 10
				39 01 00 00 00 00 02 59 10
				39 01 00 00 00 00 02 5A 08
				39 01 00 00 00 00 02 5B 3E
				39 01 00 00 00 00 02 5C 00
				39 01 00 00 00 00 02 5D 00
				39 01 00 00 00 00 03 5E 00 04
				39 01 00 00 00 00 02 60 C8
				39 01 00 00 00 00 02 61 00
				39 01 00 00 00 00 02 63 A0
				39 01 00 00 00 00 02 91 40
				39 01 00 00 00 00 04 92 C8 00 C8
				39 01 00 00 00 00 03 93 1E 00
				39 01 00 00 00 00 03 94 04 01
				39 01 00 00 00 00 02 95 81
				39 01 00 00 00 00 02 96 62
				39 01 00 00 00 00 02 97 C2
				39 01 00 00 00 00 02 98 80
				39 01 00 00 00 00 02 AA 4D
				39 01 00 00 00 00 02 AB 44
				39 01 00 00 00 00 0D B6 05 00 05 00 00 00 05 05 05 05 00 00
				39 01 00 00 00 00 02 BB 80
				39 01 00 00 00 00 06 BC 00 00 40 00 00
				39 01 00 00 00 00 04 C2 C6 00 08
				39 01 00 00 00 00 02 C3 00
				39 01 00 00 00 00 02 C4 2F
				39 01 00 00 00 00 02 DB 71
				39 01 00 00 00 00 02 DC 4E
				39 01 00 00 00 00 02 DF 01
				39 01 00 00 00 00 02 E0 4E
				39 01 00 00 00 00 02 E1 01
				39 01 00 00 00 00 02 E2 4E
				39 01 00 00 00 00 02 E5 01
				39 01 00 00 00 00 02 E6 4E
				39 01 00 00 00 00 02 FF 25
				39 01 00 00 00 00 02 FB 01
				39 01 00 00 00 00 02 05 00
				39 01 00 00 00 00 02 13 01
				39 01 00 00 00 00 02 14 A5
				39 01 00 00 00 00 02 DB 01
				39 01 00 00 00 00 02 DC 4C
				39 01 00 00 00 00 02 15 01
				39 01 00 00 00 00 02 16 A5
				39 01 00 00 00 00 02 DD 01
				39 01 00 00 00 00 02 DE 4C
				39 01 00 00 00 00 02 BC 01
				39 01 00 00 00 00 02 BD 65
				39 01 00 00 00 00 02 F6 01
				39 01 00 00 00 00 02 F7 14
				39 01 00 00 00 00 02 19 07
				39 01 00 00 00 00 02 1B 11
				39 01 00 00 00 00 02 1E 00
				39 01 00 00 00 00 02 1F 08
				39 01 00 00 00 00 02 20 3E
				39 01 00 00 00 00 02 25 00
				39 01 00 00 00 00 02 26 08
				39 01 00 00 00 00 02 27 3E
				39 01 00 00 00 00 02 3F 00
				39 01 00 00 00 00 02 40 02
				39 01 00 00 00 00 02 43 00
				39 01 00 00 00 00 02 48 08
				39 01 00 00 00 00 02 49 3E
				39 01 00 00 00 00 02 5B 00
				39 01 00 00 00 00 02 C0 0C
				39 01 00 00 00 00 02 C2 40
				39 01 00 00 00 00 02 C5 17
				39 01 00 00 00 00 02 C8 04
				39 01 00 00 00 00 02 F1 10
				39 01 00 00 00 00 02 FF 26
				39 01 00 00 00 00 02 FB 01
				39 01 00 00 00 00 02 00 81
				39 01 00 00 00 00 02 06 80
				39 01 00 00 00 00 02 04 96
				39 01 00 00 00 00 02 0A F5
				39 01 00 00 00 00 02 0C 08
				39 01 00 00 00 00 02 0D 10
				39 01 00 00 00 00 02 0F 00
				39 01 00 00 00 00 02 11 00
				39 01 00 00 00 00 02 12 51
				39 01 00 00 00 00 02 13 18
				39 01 00 00 00 00 02 14 1D
				39 01 00 00 00 00 02 16 11
				39 01 00 00 00 00 02 19 1D
				39 01 00 00 00 00 02 1A 82
				39 01 00 00 00 00 02 1B 1B
				39 01 00 00 00 00 02 1C D3
				39 01 00 00 00 00 02 1D 00
				39 01 00 00 00 00 02 1E 4D
				39 01 00 00 00 00 02 1F 4D
				39 01 00 00 00 00 02 20 00
				39 01 00 00 00 00 02 21 07
				39 01 00 00 00 00 02 2A 1D
				39 01 00 00 00 00 02 2B 82
				39 01 00 00 00 00 02 2F 08
				39 01 00 00 00 00 02 30 4D
				39 01 00 00 00 00 02 31 00
				39 01 00 00 00 00 02 32 4D
				39 01 00 00 00 00 02 39 00
				39 01 00 00 00 00 02 33 67
				39 01 00 00 00 00 02 34 89
				39 01 00 00 00 00 02 35 67
				39 01 00 00 00 00 02 36 89
				39 01 00 00 00 00 02 37 78
				39 01 00 00 00 00 02 38 06
				39 01 00 00 00 00 02 8C 04
				39 01 00 00 00 00 02 8D 10
				39 01 00 00 00 00 02 8F 00
				39 01 00 00 00 00 02 91 00
				39 01 00 00 00 00 02 92 51
				39 01 00 00 00 00 02 93 7C
				39 01 00 00 00 00 02 94 C1
				39 01 00 00 00 00 02 96 12
				39 01 00 00 00 00 02 99 25
				39 01 00 00 00 00 02 9A F7
				39 01 00 00 00 00 02 9B 24
				39 01 00 00 00 00 02 9C 47
				39 01 00 00 00 00 02 9D 25
				39 01 00 00 00 00 02 9E F7
				39 01 00 00 00 00 02 3F 00
				39 01 00 00 00 00 02 40 49
				39 01 00 00 00 00 02 41 49
				39 01 00 00 00 00 02 42 49
				39 01 00 00 00 00 02 45 0B
				39 01 00 00 00 00 02 46 49
				39 01 00 00 00 00 02 47 00
				39 01 00 00 00 00 02 48 49
				39 01 00 00 00 00 02 4C 00
				39 01 00 00 00 00 02 4D 39
				39 01 00 00 00 00 02 4E 00
				39 01 00 00 00 00 02 51 08
				39 01 00 00 00 00 02 52 3A
				39 01 00 00 00 00 02 55 00
				39 01 00 00 00 00 02 56 08
				39 01 00 00 00 00 02 58 3A
				39 01 00 00 00 00 02 5B 08
				39 01 00 00 00 00 02 5C 3A
				39 01 00 00 00 00 02 5F 00
				39 01 00 00 00 00 02 64 08
				39 01 00 00 00 00 02 65 3A
				39 01 00 00 00 00 02 49 00
				39 01 00 00 00 00 02 80 66
				39 01 00 00 00 00 02 81 00
				39 01 00 00 00 00 02 8B 96
				39 01 00 00 00 00 02 C7 00
				39 01 00 00 00 00 02 C8 00
				39 01 00 00 00 00 03 CD 76 8A
				39 01 00 00 00 00 03 CE 74 8A
				39 01 00 00 00 00 04 CF 24 00 20
				39 01 00 00 00 00 03 D0 00 00
				39 01 00 00 00 00 03 D1 00 00
				39 01 00 00 00 00 02 D2 30
				39 01 00 00 00 00 02 F7 04
				39 01 00 00 00 00 02 FF 27
				39 01 00 00 00 00 02 FB 01
				39 01 00 00 00 00 02 56 00
				39 01 00 00 00 00 02 78 80
				39 01 00 00 00 00 02 79 1D
				39 01 00 00 00 00 02 7A 01
				39 01 00 00 00 00 02 7B 1C
				39 01 00 00 00 00 02 7C 00
				39 01 00 00 00 00 02 7D 24
				39 01 00 00 00 00 02 7E 20
				39 01 00 00 00 00 02 7F 10
				39 01 00 00 00 00 02 80 96
				39 01 00 00 00 00 02 81 76
				39 01 00 00 00 00 02 82 96
				39 01 00 00 00 00 02 83 10
				39 01 00 00 00 00 02 84 8A
				39 01 00 00 00 00 02 85 74
				39 01 00 00 00 00 02 86 96
				39 01 00 00 00 00 02 87 10
				39 01 00 00 00 00 02 88 8A
				39 01 00 00 00 00 02 95 00
				39 01 00 00 00 00 02 96 00
				39 01 00 00 00 00 02 97 08
				39 01 00 00 00 00 02 00 80
				39 01 00 00 00 00 02 01 1D
				39 01 00 00 00 00 02 02 01
				39 01 00 00 00 00 02 03 20
				39 01 00 00 00 00 02 04 00
				39 01 00 00 00 00 02 05 09
				39 01 00 00 00 00 02 06 20
				39 01 00 00 00 00 02 07 10
				39 01 00 00 00 00 02 08 96
				39 01 00 00 00 00 02 09 58
				39 01 00 00 00 00 02 0A 96
				39 01 00 00 00 00 02 0B 10
				39 01 00 00 00 00 02 0C A8
				39 01 00 00 00 00 02 0D 57
				39 01 00 00 00 00 02 0E 96
				39 01 00 00 00 00 02 0F 10
				39 01 00 00 00 00 02 10 A8
				39 01 00 00 00 00 02 2F 00
				39 01 00 00 00 00 02 30 00
				39 01 00 00 00 00 02 31 08
				39 01 00 00 00 00 02 C0 00
				39 01 00 00 00 00 02 D0 02
				39 01 00 00 00 00 02 D1 54
				39 01 00 00 00 00 02 D2 30
				39 01 00 00 00 00 02 DE 03
				39 01 00 00 00 00 02 DF 02
				39 01 00 00 00 00 02 FF 2A
				39 01 00 00 00 00 02 FB 01
				39 01 00 00 00 00 02 22 1F
				39 01 00 00 00 00 02 23 14
				39 01 00 00 00 00 02 24 00
				39 01 00 00 00 00 02 25 4D
				39 01 00 00 00 00 02 27 00
				39 01 00 00 00 00 02 28 1E
				39 01 00 00 00 00 02 29 00
				39 01 00 00 00 00 02 2A 1E
				39 01 00 00 00 00 02 2B 00
				39 01 00 00 00 00 02 2D 1E
				39 01 00 00 00 00 02 2F 00
				39 01 00 00 00 00 02 30 4D
				39 01 00 00 00 00 02 32 00
				39 01 00 00 00 00 02 33 1E
				39 01 00 00 00 00 02 34 00
				39 01 00 00 00 00 02 35 1E
				39 01 00 00 00 00 02 36 00
				39 01 00 00 00 00 02 37 1E
				39 01 00 00 00 00 02 38 00
				39 01 00 00 00 00 02 39 48
				39 01 00 00 00 00 02 3B 00
				39 01 00 00 00 00 02 3D 1E
				39 01 00 00 00 00 02 3F 00
				39 01 00 00 00 00 02 40 1E
				39 01 00 00 00 00 02 41 00
				39 01 00 00 00 00 02 42 1E
				39 01 00 00 00 00 02 64 41
				39 01 00 00 00 00 02 6A 41
				39 01 00 00 00 00 02 79 41
				39 01 00 00 00 00 02 7C 41
				39 01 00 00 00 00 02 7F 41
				39 01 00 00 00 00 02 82 41
				39 01 00 00 00 00 02 85 41
				39 01 00 00 00 00 02 97 3C
				39 01 00 00 00 00 02 98 02
				39 01 00 00 00 00 02 99 95
				39 01 00 00 00 00 02 9A 03
				39 01 00 00 00 00 02 9B 00
				39 01 00 00 00 00 02 9C 0B
				39 01 00 00 00 00 02 9D 0A
				39 01 00 00 00 00 02 9E 90
				39 01 00 00 00 00 02 F2 3C
				39 01 00 00 00 00 02 F3 02
				39 01 00 00 00 00 02 F4 95
				39 01 00 00 00 00 02 F5 03
				39 01 00 00 00 00 02 F6 00
				39 01 00 00 00 00 02 F7 0B
				39 01 00 00 00 00 02 F8 0A
				39 01 00 00 00 00 02 F9 90
				39 01 00 00 00 00 02 A2 30
				39 01 00 00 00 00 02 A3 00
				39 01 00 00 00 00 02 A4 30
				39 01 00 00 00 00 02 E8 15
				39 01 00 00 00 00 02 FF 22
				39 01 00 00 00 00 02 FB 01
				39 01 00 00 00 00 02 9F 96
				39 01 00 00 00 00 02 FF 23
				39 01 00 00 00 00 02 FB 01
				39 01 00 00 00 00 02 A3 96
				39 01 00 00 00 00 02 00 80
				39 01 00 00 00 00 02 07 00
				39 01 00 00 00 00 02 08 01
				39 01 00 00 00 00 02 09 87
				39 01 00 00 00 00 02 11 02
				39 01 00 00 00 00 02 12 80
				39 01 00 00 00 00 02 15 83
				39 01 00 00 00 00 02 16 0C
				39 01 00 00 00 00 02 29 80
				39 01 00 00 00 00 02 30 FF
				39 01 00 00 00 00 02 31 FC
				39 01 00 00 00 00 02 32 F9
				39 01 00 00 00 00 02 33 F6
				39 01 00 00 00 00 02 34 F3
				39 01 00 00 00 00 02 35 F1
				39 01 00 00 00 00 02 36 EE
				39 01 00 00 00 00 02 37 EB
				39 01 00 00 00 00 02 38 E9
				39 01 00 00 00 00 02 39 E6
				39 01 00 00 00 00 02 3A E4
				39 01 00 00 00 00 02 3B E1
				39 01 00 00 00 00 02 3D DF
				39 01 00 00 00 00 02 3F DD
				39 01 00 00 00 00 02 40 DB
				39 01 00 00 00 00 02 41 D9
				39 01 00 00 00 00 02 FF 20
				39 01 00 00 00 00 02 FB 01
				39 01 00 00 00 00 02 95 EB
				39 01 00 00 00 00 02 96 EB
				39 01 00 00 00 00 11 B0 00 3E 00 4E 00 7C 00 A1 00 BF 00 D8 00 EE 01 02
				39 01 00 00 00 00 11 B1 01 13 01 4D 01 76 01 B7 01 E4 02 2D 02 62 02 64
				39 01 00 00 00 00 11 B2 02 9A 02 D4 02 FD 03 2C 03 4E 03 78 03 88 03 96
				39 01 00 00 00 00 0D B3 03 A6 03 B4 03 D6 03 F2 03 FE 03 FF
				39 01 00 00 00 00 11 B4 00 3E 00 4E 00 7C 00 A1 00 BF 00 D8 00 EE 01 02
				39 01 00 00 00 00 11 B5 01 13 01 4D 01 76 01 B7 01 E4 02 2D 02 62 02 64
				39 01 00 00 00 00 11 B6 02 9A 02 D4 02 FD 03 2C 03 4E 03 78 03 88 03 96
				39 01 00 00 00 00 0D B7 03 A6 03 B4 03 D6 03 F2 03 FE 03 FF
				39 01 00 00 00 00 11 B8 00 3E 00 4E 00 7C 00 A1 00 BF 00 D8 00 EE 01 02
				39 01 00 00 00 00 11 B9 01 13 01 4D 01 76 01 B7 01 E4 02 2D 02 62 02 64
				39 01 00 00 00 00 11 BA 02 9A 02 D4 02 FD 03 2C 03 4E 03 78 03 88 03 96
				39 01 00 00 00 00 0D BB 03 A6 03 B4 03 D6 03 F2 03 FE 03 FF
				39 01 00 00 00 00 02 C6 11
				39 01 00 00 00 00 02 C7 11
				39 01 00 00 00 00 02 C8 11
				39 01 00 00 00 00 02 C9 11
				39 01 00 00 00 00 02 CA 11
				39 01 00 00 00 00 02 CB 11
				39 01 00 00 00 00 02 CC 11
				39 01 00 00 00 00 02 CD 11
				39 01 00 00 00 00 02 CE 11
				39 01 00 00 00 00 02 CF 11
				39 01 00 00 00 00 02 D0 11
				39 01 00 00 00 00 02 D1 11
				39 01 00 00 00 00 02 D2 11
				39 01 00 00 00 00 02 D3 11
				39 01 00 00 00 00 02 D4 11
				39 01 00 00 00 00 02 D5 11
				39 01 00 00 00 00 02 D6 11
				39 01 00 00 00 00 02 D7 11
				39 01 00 00 00 00 02 D8 11
				39 01 00 00 00 00 02 D9 11
				39 01 00 00 00 00 02 DA 11
				39 01 00 00 00 00 02 DB 11
				39 01 00 00 00 00 02 DC 11
				39 01 00 00 00 00 02 DD 11
				39 01 00 00 00 00 02 DE 11
				39 01 00 00 00 00 02 DF 11
				39 01 00 00 00 00 02 E0 11
				39 01 00 00 00 00 02 E1 11
				39 01 00 00 00 00 02 E2 11
				39 01 00 00 00 00 02 E3 11
				39 01 00 00 00 00 02 FF 21
				39 01 00 00 00 00 02 FB 01
				39 01 00 00 00 00 11 B0 00 1A 00 46 00 74 00 99 00 B7 00 D0 00 E6 00 FA
				39 01 00 00 00 00 11 B1 01 0B 01 45 01 6E 01 AF 01 DC 02 25 02 5A 02 5C
				39 01 00 00 00 00 11 B2 02 92 02 CC 02 F5 03 24 03 46 03 70 03 80 03 8E
				39 01 00 00 00 00 0D B3 03 9E 03 AC 03 CE 03 EA 03 F6 03 F7
				39 01 00 00 00 00 11 B4 00 1A 00 46 00 74 00 99 00 B7 00 D0 00 E6 00 FA
				39 01 00 00 00 00 11 B5 01 0B 01 45 01 6E 01 AF 01 DC 02 25 02 5A 02 5C
				39 01 00 00 00 00 11 B6 02 92 02 CC 02 F5 03 24 03 46 03 70 03 80 03 8E
				39 01 00 00 00 00 0D B7 03 9E 03 AC 03 CE 03 EA 03 F6 03 F7
				39 01 00 00 00 00 11 B8 00 1A 00 46 00 74 00 99 00 B7 00 D0 00 E6 00 FA
				39 01 00 00 00 00 11 B9 01 0B 01 45 01 6E 01 AF 01 DC 02 25 02 5A 02 5C
				39 01 00 00 00 00 11 BA 02 92 02 CC 02 F5 03 24 03 46 03 70 03 80 03 8E
				39 01 00 00 00 00 0D BB 03 9E 03 AC 03 CE 03 EA 03 F6 03 F7
				39 01 00 00 00 00 02 FF 10
				39 01 00 00 00 00 02 FB 01
				39 01 00 00 00 00 02 35 00
				39 01 00 00 00 00 03 51 00 00
				39 01 00 00 00 00 02 53 2C
				39 01 00 00 00 00 02 55 00
				39 01 00 00 00 00 03 68 03 01
				39 01 00 00 00 00 02 90 03
				39 01 00 00 00 00 11 91 89 A8 00 14 D2 00 02 B2 02 2B 00 0B 05 7A 03 68
				39 01 00 00 00 00 03 92 10 E0
				39 01 00 00 00 00 02 B2 91
				39 01 00 00 00 00 02 B3 01
				39 01 00 00 00 00 02 BB 13
				39 01 00 00 00 00 07 3B 03 04 1E 04 04 01
				39 01 00 00 64 00 02 11 00
				39 01 00 00 0A 00 02 29 00
				];

				qcom,mdss-dsi-off-command = [
					05 01 00 00 05 00 02 28 00
					05 01 00 00 46 00 02 10 00];
				qcom,mdss-dsi-hbm-on-command = [
					39 01 00 00 00 00 03 51 0F FF
				];
				qcom,mdss-dsi-hbm-off-command = [
					15 01 00 00 00 00 03 51 0D 11
				];
				qcom,mdss-dsi-dispparam-pen-144hz-disable-control-command = [
					39 00 00 40 00 00 02 FF 10
					39 00 00 00 00 00 02 B2 80];
				qcom,mdss-dsi-dispparam-pen-144hz-switch-command = [
					39 00 00 40 00 00 02 FF 10
					39 00 00 40 00 00 02 B3 12
					39 00 00 40 00 00 02 FF 27
					39 00 00 00 00 00 02 78 00];
				qcom,mdss-dsi-dispparam-pen-144hz-enable-touch-command = [
					39 00 00 40 00 00 02 FF 27
					39 00 00 40 00 00 02 78 80
					39 00 00 00 00 00 02 FF 10];
				qcom,mdss-dsi-dispparam-pen-others-enable-control-command = [
					39 00 00 40 00 00 02 FF 10
					39 00 00 00 00 00 02 B2 91];
				qcom,mdss-dsi-dispparam-pen-others-switch-command = [
					39 00 00 40 00 00 02 FF 10
					39 00 00 00 00 00 02 B3 01];
				qcom,mdss-dsi-dispparam-pen-144hz-power-on-command = [
					39 00 00 40 00 00 02 FF 10
					39 00 00 40 00 00 02 B2 80
					39 00 00 00 00 00 02 B3 12];

				 qcom,mdss-dsi-dispparam-pen-144hz-disable-control-command-state = "dsi_lp_mode";
				 qcom,mdss-dsi-dispparam-pen-144hz-switch-command-state = "dsi_lp_mode";
				 qcom,mdss-dsi-dispparam-pen-144hz-enable-touch-command-state = "dsi_lp_mode";
				 qcom,mdss-dsi-dispparam-pen-others-enable-control-command-state = "dsi_lp_mode";
				 qcom,mdss-dsi-dispparam-pen-others-switch-command-state = "dsi_lp_mode";
				 qcom,mdss-dsi-dispparam-pen-144hz-power-on-command-state = "dsi_lp_mode";

				qcom,mdss-dsi-on-command-state = "dsi_lp_mode";
				qcom,mdss-dsi-off-command-state = "dsi_hs_mode";
				qcom,mdss-dsi-hbm-on-command-state = "dsi_lp_mode";
				qcom,mdss-dsi-hbm-off-command-state = "dsi_lp_mode";

				qcom,compression-mode = "dsc";
				qcom,mdss-dsc-slice-height = <20>;
				qcom,mdss-dsc-slice-width = <800>;
				qcom,mdss-dsc-slice-per-pkt = <2>;   //test 1
				qcom,mdss-dsc-bit-per-component = <8>;
				qcom,mdss-dsc-bit-per-pixel = <8>;
				qcom,mdss-dsc-block-prediction-enable;

			};
		};
	};
};
