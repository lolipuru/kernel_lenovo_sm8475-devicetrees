/*
 * Copyright (C) 2010 - 2022 Novatek, Inc.
 *
 * $Revision$
 * $Date$
 *
 * This program is free software; you can redistribute it and/or modify
 * it under the terms of the GNU General Public License as published by
 * the Free Software Foundation; either version 2 of the License, or
 * (at your option) any later version.
 *
 * This program is distributed in the hope that it will be useful, but WITHOUT
 * ANY WARRANTY; without even the implied warranty of MERCHANTABILITY or
 * FITNESS FOR A PARTICULAR PURPOSE.  See the GNU General Public License for
 * more details.
 *
 */


&qupv3_se4_spi {
	status = "ok";

	/* Novatek device tree node */
	novatek@0 {
		compatible = "novatek,NVT-ts-spi";
		reg = <0>; //Same as CS ID
		status = "ok";

		spi-max-frequency = <9600000>;	//4800000,9600000,15000000,19200000
		novatek,reset-gpio = <&tlmm 20 0x00>;
		novatek,irq-gpio = <&tlmm 21 0x2001>;

		novatek,pen-support;
		novatek,stylus-resol-double;

		/* MP */
		novatek,mp-support-dt;

		novatek-mp-criteria-6066@0 {
			#address-cells = <1>;
			#size-cells = <0>;
			compatible = "novatek-mp-criteria-6066";

			/* MP Config */
			IC_X_CFG_SIZE = <32>;
			IC_Y_CFG_SIZE = <50>;
			IC_KEY_CFG_SIZE = <4>;
			X_Channel = <32>;
			Y_Channel = <50>;
			//AIN_X = <0 1 2 3 4 5 6 7 8 9 10 11 12 13 14 15 16 17>;
			//AIN_Y = <0 1 2 3 4 5 6 7 8 9 10 11 12 13 14 15 16 17 18 19 20 21 22 23 24 25 26 27 28 29 30 31 32 33 34 35>;
			AIN_X = <0 1 2 3 4 5 6 7 8 9 10 11 12 13 14 15 16 17 18 19 20 21 22 23 24 25 26 27 28 29 30 31>;
			AIN_Y = <0 1 2 3 4 5 6 7 8 9 10 11 12 13 14 15 16 17 18 19 20 21 22 23 24 25 26 27 28 29 30 31 32 33 34 35 36 37 38 39 40 41 42 43 44 45 46 47 48 49>;
			AIN_KEY = <0 1 2 0xFF>;

			/* MP Criteria */
			PS_Config_Lmt_Short_Rawdata_P = <
				14008 14008 14008 14008 14008 14008 14008 14008 14008 14008 14008 14008 14008 14008 14008 14008 14008 14008 14008 14008 14008 14008 14008 14008 14008 14008 14008 14008 14008 14008 14008 14008 14008 14008 14008 14008 14008 14008 14008 14008
				14008 14008 14008 14008 14008 14008 14008 14008 14008 14008 14008 14008 14008 14008 14008 14008 14008 14008 14008 14008 14008 14008 14008 14008 14008 14008 14008 14008 14008 14008 14008 14008 14008 14008 14008 14008 14008 14008 14008 14008
				14008 14008 14008 14008 14008 14008 14008 14008 14008 14008 14008 14008 14008 14008 14008 14008 14008 14008 14008 14008 14008 14008 14008 14008 14008 14008 14008 14008 14008 14008 14008 14008 14008 14008 14008 14008 14008 14008 14008 14008
				14008 14008 14008 14008 14008 14008 14008 14008 14008 14008 14008 14008 14008 14008 14008 14008 14008 14008 14008 14008 14008 14008 14008 14008 14008 14008 14008 14008 14008 14008 14008 14008 14008 14008 14008 14008 14008 14008 14008 14008
				14008 14008 14008 14008 14008 14008 14008 14008 14008 14008 14008 14008 14008 14008 14008 14008 14008 14008 14008 14008 14008 14008 14008 14008 14008 14008 14008 14008 14008 14008 14008 14008 14008 14008 14008 14008 14008 14008 14008 14008
				14008 14008 14008 14008 14008 14008 14008 14008 14008 14008 14008 14008 14008 14008 14008 14008 14008 14008 14008 14008 14008 14008 14008 14008 14008 14008 14008 14008 14008 14008 14008 14008 14008 14008 14008 14008 14008 14008 14008 14008
				14008 14008 14008 14008 14008 14008 14008 14008 14008 14008 14008 14008 14008 14008 14008 14008 14008 14008 14008 14008 14008 14008 14008 14008 14008 14008 14008 14008 14008 14008 14008 14008 14008 14008 14008 14008 14008 14008 14008 14008
				14008 14008 14008 14008 14008 14008 14008 14008 14008 14008 14008 14008 14008 14008 14008 14008 14008 14008 14008 14008 14008 14008 14008 14008 14008 14008 14008 14008 14008 14008 14008 14008 14008 14008 14008 14008 14008 14008 14008 14008
				14008 14008 14008 14008 14008 14008 14008 14008 14008 14008 14008 14008 14008 14008 14008 14008 14008 14008 14008 14008 14008 14008 14008 14008 14008 14008 14008 14008 14008 14008 14008 14008 14008 14008 14008 14008 14008 14008 14008 14008
				14008 14008 14008 14008 14008 14008 14008 14008 14008 14008 14008 14008 14008 14008 14008 14008 14008 14008 14008 14008 14008 14008 14008 14008 14008 14008 14008 14008 14008 14008 14008 14008 14008 14008 14008 14008 14008 14008 14008 14008
				14008 14008 14008 14008 14008 14008 14008 14008 14008 14008 14008 14008 14008 14008 14008 14008 14008 14008 14008 14008 14008 14008 14008 14008 14008 14008 14008 14008 14008 14008 14008 14008 14008 14008 14008 14008 14008 14008 14008 14008
				14008 14008 14008 14008 14008 14008 14008 14008 14008 14008 14008 14008 14008 14008 14008 14008 14008 14008 14008 14008 14008 14008 14008 14008 14008 14008 14008 14008 14008 14008 14008 14008 14008 14008 14008 14008 14008 14008 14008 14008
				14008 14008 14008 14008 14008 14008 14008 14008 14008 14008 14008 14008 14008 14008 14008 14008 14008 14008 14008 14008 14008 14008 14008 14008 14008 14008 14008 14008 14008 14008 14008 14008 14008 14008 14008 14008 14008 14008 14008 14008
				14008 14008 14008 14008 14008 14008 14008 14008 14008 14008 14008 14008 14008 14008 14008 14008 14008 14008 14008 14008 14008 14008 14008 14008 14008 14008 14008 14008 14008 14008 14008 14008 14008 14008 14008 14008 14008 14008 14008 14008
				14008 14008 14008 14008 14008 14008 14008 14008 14008 14008 14008 14008 14008 14008 14008 14008 14008 14008 14008 14008 14008 14008 14008 14008 14008 14008 14008 14008 14008 14008 14008 14008 14008 14008 14008 14008 14008 14008 14008 14008
				14008 14008 14008 14008 14008 14008 14008 14008 14008 14008 14008 14008 14008 14008 14008 14008 14008 14008 14008 14008 14008 14008 14008 14008 14008 14008 14008 14008 14008 14008 14008 14008 14008 14008 14008 14008 14008 14008 14008 14008
				14008 14008 14008 14008 14008 14008 14008 14008 14008 14008 14008 14008 14008 14008 14008 14008 14008 14008 14008 14008 14008 14008 14008 14008 14008 14008 14008 14008 14008 14008 14008 14008 14008 14008 14008 14008 14008 14008 14008 14008
				14008 14008 14008 14008 14008 14008 14008 14008 14008 14008 14008 14008 14008 14008 14008 14008 14008 14008 14008 14008 14008 14008 14008 14008 14008 14008 14008 14008 14008 14008 14008 14008 14008 14008 14008 14008 14008 14008 14008 14008
				14008 14008 14008 14008 14008 14008 14008 14008 14008 14008 14008 14008 14008 14008 14008 14008 14008 14008 14008 14008 14008 14008 14008 14008 14008 14008 14008 14008 14008 14008 14008 14008 14008 14008 14008 14008 14008 14008 14008 14008
				14008 14008 14008 14008 14008 14008 14008 14008 14008 14008 14008 14008 14008 14008 14008 14008 14008 14008 14008 14008 14008 14008 14008 14008 14008 14008 14008 14008 14008 14008 14008 14008 14008 14008 14008 14008 14008 14008 14008 14008
				14008 14008 14008 14008 14008 14008 14008 14008 14008 14008 14008 14008 14008 14008 14008 14008 14008 14008 14008 14008 14008 14008 14008 14008 14008 14008 14008 14008 14008 14008 14008 14008 14008 14008 14008 14008 14008 14008 14008 14008
				14008 14008 14008 14008 14008 14008 14008 14008 14008 14008 14008 14008 14008 14008 14008 14008 14008 14008 14008 14008 14008 14008 14008 14008 14008 14008 14008 14008 14008 14008 14008 14008 14008 14008 14008 14008 14008 14008 14008 14008
				14008 14008 14008 14008 14008 14008 14008 14008 14008 14008 14008 14008 14008 14008 14008 14008 14008 14008 14008 14008 14008 14008 14008 14008 14008 14008 14008 14008 14008 14008 14008 14008 14008 14008 14008 14008 14008 14008 14008 14008
				14008 14008 14008 14008 14008 14008 14008 14008 14008 14008 14008 14008 14008 14008 14008 14008 14008 14008 14008 14008 14008 14008 14008 14008 14008 14008 14008 14008 14008 14008 14008 14008 14008 14008 14008 14008 14008 14008 14008 14008
				14008 14008 14008 14008 14008 14008 14008 14008 14008 14008 14008 14008 14008 14008 14008 14008 14008 14008 14008 14008 14008 14008 14008 14008 14008 14008 14008 14008 14008 14008 14008 14008 14008 14008 14008 14008 14008 14008 14008 14008
				14008 14008 14008 14008 14008 14008 14008 14008 14008 14008 14008 14008 14008 14008 14008 14008 14008 14008 14008 14008 14008 14008 14008 14008 14008 14008 14008 14008 14008 14008 14008 14008 14008 14008 14008 14008 14008 14008 14008 14008
				14008 14008 14008 14008 14008 14008 14008 14008 14008 14008 14008 14008 14008 14008 14008 14008 14008 14008 14008 14008 14008 14008 14008 14008 14008 14008 14008 14008 14008 14008 14008 14008 14008 14008 14008 14008 14008 14008 14008 14008
				14008 14008 14008 14008 14008 14008 14008 14008 14008 14008 14008 14008 14008 14008 14008 14008 14008 14008 14008 14008 14008 14008 14008 14008 14008 14008 14008 14008 14008 14008 14008 14008 14008 14008 14008 14008 14008 14008 14008 14008
				14008 14008 14008 14008 14008 14008 14008 14008 14008 14008 14008 14008 14008 14008 14008 14008 14008 14008 14008 14008 14008 14008 14008 14008 14008 14008 14008 14008 14008 14008 14008 14008 14008 14008 14008 14008 14008 14008 14008 14008
				14008 14008 14008 14008 14008 14008 14008 14008 14008 14008 14008 14008 14008 14008 14008 14008 14008 14008 14008 14008 14008 14008 14008 14008 14008 14008 14008 14008 14008 14008 14008 14008 14008 14008 14008 14008 14008 14008 14008 14008
				14008 14008 14008 14008 14008 14008 14008 14008 14008 14008 14008 14008 14008 14008 14008 14008 14008 14008 14008 14008 14008 14008 14008 14008 14008 14008 14008 14008 14008 14008 14008 14008 14008 14008 14008 14008 14008 14008 14008 14008
				14008 14008 14008 14008 14008 14008 14008 14008 14008 14008 14008 14008 14008 14008 14008 14008 14008 14008 14008 14008 14008 14008 14008 14008 14008 14008 14008 14008 14008 14008 14008 14008 14008 14008 14008 14008 14008 14008 14008 14008
				14008 14008 14008 14008 14008 14008 14008 14008 14008 14008 14008 14008 14008 14008 14008 14008 14008 14008 14008 14008 14008 14008 14008 14008 14008 14008 14008 14008 14008 14008 14008 14008 14008 14008 14008 14008 14008 14008 14008 14008
				14008 14008 14008 14008 14008 14008 14008 14008 14008 14008 14008 14008 14008 14008 14008 14008 14008 14008 14008 14008 14008 14008 14008 14008 14008 14008 14008 14008 14008 14008 14008 14008 14008 14008 14008 14008 14008 14008 14008 14008
				14008 14008 14008 14008 14008 14008 14008 14008 14008 14008 14008 14008 14008 14008 14008 14008 14008 14008 14008 14008 14008 14008 14008 14008 14008 14008 14008 14008 14008 14008 14008 14008 14008 14008 14008 14008 14008 14008 14008 14008
				14008 14008 14008 14008 14008 14008 14008 14008 14008 14008 14008 14008 14008 14008 14008 14008 14008 14008 14008 14008 14008 14008 14008 14008 14008 14008 14008 14008 14008 14008 14008 14008 14008 14008 14008 14008 14008 14008 14008 14008
				14008 14008 14008 14008 14008 14008 14008 14008 14008 14008 14008 14008 14008 14008 14008 14008 14008 14008 14008 14008 14008 14008 14008 14008 14008 14008 14008 14008 14008 14008 14008 14008 14008 14008 14008 14008 14008 14008 14008 14008
				14008 14008 14008 14008 14008 14008 14008 14008 14008 14008 14008 14008 14008 14008 14008 14008 14008 14008 14008 14008 14008 14008 14008 14008 14008 14008 14008 14008 14008 14008 14008 14008 14008 14008 14008 14008 14008 14008 14008 14008
				14008 14008 14008 14008 14008 14008 14008 14008 14008 14008 14008 14008 14008 14008 14008 14008 14008 14008 14008 14008 14008 14008 14008 14008 14008 14008 14008 14008 14008 14008 14008 14008 14008 14008 14008 14008 14008 14008 14008 14008
				14008 14008 14008 14008 14008 14008 14008 14008 14008 14008 14008 14008 14008 14008 14008 14008 14008 14008 14008 14008 14008 14008 14008 14008 14008 14008 14008 14008 14008 14008 14008 14008 14008 14008 14008 14008 14008 14008 14008 14008
				14008 14008 14008 14008 14008 14008 14008 14008 14008 14008 14008 14008 14008 14008 14008 14008 14008 14008 14008 14008 14008 14008 14008 14008 14008 14008 14008 14008 14008 14008 14008 14008 14008 14008 14008 14008 14008 14008 14008 14008
				14008 14008 14008 14008 14008 14008 14008 14008 14008 14008 14008 14008 14008 14008 14008 14008 14008 14008 14008 14008 14008 14008 14008 14008 14008 14008 14008 14008 14008 14008 14008 14008 14008 14008 14008 14008 14008 14008 14008 14008
				14008 14008 14008 14008 14008 14008 14008 14008 14008 14008 14008 14008 14008 14008 14008 14008 14008 14008 14008 14008 14008 14008 14008 14008 14008 14008 14008 14008 14008 14008 14008 14008 14008 14008 14008 14008 14008 14008 14008 14008
				14008 14008 14008 14008 14008 14008 14008 14008 14008 14008 14008 14008 14008 14008 14008 14008 14008 14008 14008 14008 14008 14008 14008 14008 14008 14008 14008 14008 14008 14008 14008 14008 14008 14008 14008 14008 14008 14008 14008 14008
				14008 14008 14008 14008 14008 14008 14008 14008 14008 14008 14008 14008 14008 14008 14008 14008 14008 14008 14008 14008 14008 14008 14008 14008 14008 14008 14008 14008 14008 14008 14008 14008 14008 14008 14008 14008 14008 14008 14008 14008
				14008 14008 14008 14008 14008 14008 14008 14008 14008 14008 14008 14008 14008 14008 14008 14008 14008 14008 14008 14008 14008 14008 14008 14008 14008 14008 14008 14008 14008 14008 14008 14008 14008 14008 14008 14008 14008 14008 14008 14008
				14008 14008 14008 14008 14008 14008 14008 14008 14008 14008 14008 14008 14008 14008 14008 14008 14008 14008 14008 14008 14008 14008 14008 14008 14008 14008 14008 14008 14008 14008 14008 14008 14008 14008 14008 14008 14008 14008 14008 14008
				14008 14008 14008 14008 14008 14008 14008 14008 14008 14008 14008 14008 14008 14008 14008 14008 14008 14008 14008 14008 14008 14008 14008 14008 14008 14008 14008 14008 14008 14008 14008 14008 14008 14008 14008 14008 14008 14008 14008 14008
				14008 14008 14008 14008 14008 14008 14008 14008 14008 14008 14008 14008 14008 14008 14008 14008 14008 14008 14008 14008 14008 14008 14008 14008 14008 14008 14008 14008 14008 14008 14008 14008 14008 14008 14008 14008 14008 14008 14008 14008
				14008 14008 14008 14008 14008 14008 14008 14008 14008 14008 14008 14008 14008 14008 14008 14008 14008 14008 14008 14008 14008 14008 14008 14008 14008 14008 14008 14008 14008 14008 14008 14008 14008 14008 14008 14008 14008 14008 14008 14008
				14008 14008 14008 14008 14008 14008 14008 14008 14008 14008 14008 14008 14008 14008 14008 14008 14008 14008 14008 14008 14008 14008 14008 14008 14008 14008 14008 14008 14008 14008 14008 14008 14008 14008 14008 14008 14008 14008 14008 14008
				14008 14008 14008 14008 14008 14008 14008 14008 14008 14008 14008 14008 14008 14008 14008 14008 14008 14008 14008 14008 14008 14008 14008 14008 14008 14008 14008 14008 14008 14008 14008 14008 14008 14008 14008 14008 14008 14008 14008 14008
				14008 14008 14008 14008 14008 14008 14008 14008 14008 14008 14008 14008 14008 14008 14008 14008 14008 14008 14008 14008 14008 14008 14008 14008 14008 14008 14008 14008 14008 14008 14008 14008 14008 14008 14008 14008 14008 14008 14008 14008
				14008 14008 14008 14008 14008 14008 14008 14008 14008 14008 14008 14008 14008 14008 14008 14008 14008 14008 14008 14008 14008 14008 14008 14008 14008 14008 14008 14008 14008 14008 14008 14008 14008 14008 14008 14008 14008 14008 14008 14008
				14008 14008 14008 14008 14008 14008 14008 14008 14008 14008 14008 14008 14008 14008 14008 14008 14008 14008 14008 14008 14008 14008 14008 14008 14008 14008 14008 14008 14008 14008 14008 14008 14008 14008 14008 14008 14008 14008 14008 14008
				14008 14008 14008 14008 14008 14008 14008 14008 14008 14008 14008 14008 14008 14008 14008 14008 14008 14008 14008 14008 14008 14008 14008 14008 14008 14008 14008 14008 14008 14008 14008 14008 14008 14008 14008 14008 14008 14008 14008 14008
				14008 14008 14008 14008 14008 14008 14008 14008 14008 14008 14008 14008 14008 14008 14008 14008 14008 14008 14008 14008 14008 14008 14008 14008 14008 14008 14008 14008 14008 14008 14008 14008 14008 14008 14008 14008 14008 14008 14008 14008
				14008 14008 14008 14008 14008 14008 14008 14008 14008 14008 14008 14008 14008 14008 14008 14008 14008 14008 14008 14008 14008 14008 14008 14008 14008 14008 14008 14008 14008 14008 14008 14008 14008 14008 14008 14008 14008 14008 14008 14008
				14008 14008 14008 14008 14008 14008 14008 14008 14008 14008 14008 14008 14008 14008 14008 14008 14008 14008 14008 14008 14008 14008 14008 14008 14008 14008 14008 14008 14008 14008 14008 14008 14008 14008 14008 14008 14008 14008 14008 14008
				14008 14008 14008 14008 14008 14008 14008 14008 14008 14008 14008 14008 14008 14008 14008 14008 14008 14008 14008 14008 14008 14008 14008 14008 14008 14008 14008 14008 14008 14008 14008 14008 14008 14008 14008 14008 14008 14008 14008 14008
				14008 14008 14008 14008 14008 14008 14008 14008 14008 14008 14008 14008 14008 14008 14008 14008 14008 14008 14008 14008 14008 14008 14008 14008 14008 14008 14008 14008 14008 14008 14008 14008 14008 14008 14008 14008 14008 14008 14008 14008
				14008 14008 14008 14008 14008 14008 14008 14008 14008 14008 14008 14008 14008 14008 14008 14008 14008 14008 14008 14008 14008 14008 14008 14008 14008 14008 14008 14008 14008 14008 14008 14008 14008 14008 14008 14008 14008 14008 14008 14008
				14008 14008 14008 14008 14008 14008 14008 14008 14008 14008 14008 14008 14008 14008 14008 14008 14008 14008 14008 14008 14008 14008 14008 14008 14008 14008 14008 14008 14008 14008 14008 14008 14008 14008 14008 14008 14008 14008 14008 14008
				14008 14008 14008 14008 14008 14008 14008 14008 14008 14008 14008 14008 14008 14008 14008 14008 14008 14008 14008 14008 14008 14008 14008 14008 14008 14008 14008 14008 14008 14008 14008 14008 14008 14008 14008 14008 14008 14008 14008 14008
				14008 14008 14008>;

			PS_Config_Lmt_Short_Rawdata_N = <
				10100 10100 10100 10100 10100 10100 10100 10100 10100 10100 10100 10100 10100 10100 10100 10100 10100 10100 10100 10100 10100 10100 10100 10100 10100 10100 10100 10100 10100 10100 10100 10100 10100 10100 10100 10100 10100 10100 10100 10100
				10100 10100 10100 10100 10100 10100 10100 10100 10100 10100 10100 10100 10100 10100 10100 10100 10100 10100 10100 10100 10100 10100 10100 10100 10100 10100 10100 10100 10100 10100 10100 10100 10100 10100 10100 10100 10100 10100 10100 10100
				10100 10100 10100 10100 10100 10100 10100 10100 10100 10100 10100 10100 10100 10100 10100 10100 10100 10100 10100 10100 10100 10100 10100 10100 10100 10100 10100 10100 10100 10100 10100 10100 10100 10100 10100 10100 10100 10100 10100 10100
				10100 10100 10100 10100 10100 10100 10100 10100 10100 10100 10100 10100 10100 10100 10100 10100 10100 10100 10100 10100 10100 10100 10100 10100 10100 10100 10100 10100 10100 10100 10100 10100 10100 10100 10100 10100 10100 10100 10100 10100
				10100 10100 10100 10100 10100 10100 10100 10100 10100 10100 10100 10100 10100 10100 10100 10100 10100 10100 10100 10100 10100 10100 10100 10100 10100 10100 10100 10100 10100 10100 10100 10100 10100 10100 10100 10100 10100 10100 10100 10100
				10100 10100 10100 10100 10100 10100 10100 10100 10100 10100 10100 10100 10100 10100 10100 10100 10100 10100 10100 10100 10100 10100 10100 10100 10100 10100 10100 10100 10100 10100 10100 10100 10100 10100 10100 10100 10100 10100 10100 10100
				10100 10100 10100 10100 10100 10100 10100 10100 10100 10100 10100 10100 10100 10100 10100 10100 10100 10100 10100 10100 10100 10100 10100 10100 10100 10100 10100 10100 10100 10100 10100 10100 10100 10100 10100 10100 10100 10100 10100 10100
				10100 10100 10100 10100 10100 10100 10100 10100 10100 10100 10100 10100 10100 10100 10100 10100 10100 10100 10100 10100 10100 10100 10100 10100 10100 10100 10100 10100 10100 10100 10100 10100 10100 10100 10100 10100 10100 10100 10100 10100
				10100 10100 10100 10100 10100 10100 10100 10100 10100 10100 10100 10100 10100 10100 10100 10100 10100 10100 10100 10100 10100 10100 10100 10100 10100 10100 10100 10100 10100 10100 10100 10100 10100 10100 10100 10100 10100 10100 10100 10100
				10100 10100 10100 10100 10100 10100 10100 10100 10100 10100 10100 10100 10100 10100 10100 10100 10100 10100 10100 10100 10100 10100 10100 10100 10100 10100 10100 10100 10100 10100 10100 10100 10100 10100 10100 10100 10100 10100 10100 10100
				10100 10100 10100 10100 10100 10100 10100 10100 10100 10100 10100 10100 10100 10100 10100 10100 10100 10100 10100 10100 10100 10100 10100 10100 10100 10100 10100 10100 10100 10100 10100 10100 10100 10100 10100 10100 10100 10100 10100 10100
				10100 10100 10100 10100 10100 10100 10100 10100 10100 10100 10100 10100 10100 10100 10100 10100 10100 10100 10100 10100 10100 10100 10100 10100 10100 10100 10100 10100 10100 10100 10100 10100 10100 10100 10100 10100 10100 10100 10100 10100
				10100 10100 10100 10100 10100 10100 10100 10100 10100 10100 10100 10100 10100 10100 10100 10100 10100 10100 10100 10100 10100 10100 10100 10100 10100 10100 10100 10100 10100 10100 10100 10100 10100 10100 10100 10100 10100 10100 10100 10100
				10100 10100 10100 10100 10100 10100 10100 10100 10100 10100 10100 10100 10100 10100 10100 10100 10100 10100 10100 10100 10100 10100 10100 10100 10100 10100 10100 10100 10100 10100 10100 10100 10100 10100 10100 10100 10100 10100 10100 10100
				10100 10100 10100 10100 10100 10100 10100 10100 10100 10100 10100 10100 10100 10100 10100 10100 10100 10100 10100 10100 10100 10100 10100 10100 10100 10100 10100 10100 10100 10100 10100 10100 10100 10100 10100 10100 10100 10100 10100 10100
				10100 10100 10100 10100 10100 10100 10100 10100 10100 10100 10100 10100 10100 10100 10100 10100 10100 10100 10100 10100 10100 10100 10100 10100 10100 10100 10100 10100 10100 10100 10100 10100 10100 10100 10100 10100 10100 10100 10100 10100
				10100 10100 10100 10100 10100 10100 10100 10100 10100 10100 10100 10100 10100 10100 10100 10100 10100 10100 10100 10100 10100 10100 10100 10100 10100 10100 10100 10100 10100 10100 10100 10100 10100 10100 10100 10100 10100 10100 10100 10100
				10100 10100 10100 10100 10100 10100 10100 10100 10100 10100 10100 10100 10100 10100 10100 10100 10100 10100 10100 10100 10100 10100 10100 10100 10100 10100 10100 10100 10100 10100 10100 10100 10100 10100 10100 10100 10100 10100 10100 10100
				10100 10100 10100 10100 10100 10100 10100 10100 10100 10100 10100 10100 10100 10100 10100 10100 10100 10100 10100 10100 10100 10100 10100 10100 10100 10100 10100 10100 10100 10100 10100 10100 10100 10100 10100 10100 10100 10100 10100 10100
				10100 10100 10100 10100 10100 10100 10100 10100 10100 10100 10100 10100 10100 10100 10100 10100 10100 10100 10100 10100 10100 10100 10100 10100 10100 10100 10100 10100 10100 10100 10100 10100 10100 10100 10100 10100 10100 10100 10100 10100
				10100 10100 10100 10100 10100 10100 10100 10100 10100 10100 10100 10100 10100 10100 10100 10100 10100 10100 10100 10100 10100 10100 10100 10100 10100 10100 10100 10100 10100 10100 10100 10100 10100 10100 10100 10100 10100 10100 10100 10100
				10100 10100 10100 10100 10100 10100 10100 10100 10100 10100 10100 10100 10100 10100 10100 10100 10100 10100 10100 10100 10100 10100 10100 10100 10100 10100 10100 10100 10100 10100 10100 10100 10100 10100 10100 10100 10100 10100 10100 10100
				10100 10100 10100 10100 10100 10100 10100 10100 10100 10100 10100 10100 10100 10100 10100 10100 10100 10100 10100 10100 10100 10100 10100 10100 10100 10100 10100 10100 10100 10100 10100 10100 10100 10100 10100 10100 10100 10100 10100 10100
				10100 10100 10100 10100 10100 10100 10100 10100 10100 10100 10100 10100 10100 10100 10100 10100 10100 10100 10100 10100 10100 10100 10100 10100 10100 10100 10100 10100 10100 10100 10100 10100 10100 10100 10100 10100 10100 10100 10100 10100
				10100 10100 10100 10100 10100 10100 10100 10100 10100 10100 10100 10100 10100 10100 10100 10100 10100 10100 10100 10100 10100 10100 10100 10100 10100 10100 10100 10100 10100 10100 10100 10100 10100 10100 10100 10100 10100 10100 10100 10100
				10100 10100 10100 10100 10100 10100 10100 10100 10100 10100 10100 10100 10100 10100 10100 10100 10100 10100 10100 10100 10100 10100 10100 10100 10100 10100 10100 10100 10100 10100 10100 10100 10100 10100 10100 10100 10100 10100 10100 10100
				10100 10100 10100 10100 10100 10100 10100 10100 10100 10100 10100 10100 10100 10100 10100 10100 10100 10100 10100 10100 10100 10100 10100 10100 10100 10100 10100 10100 10100 10100 10100 10100 10100 10100 10100 10100 10100 10100 10100 10100
				10100 10100 10100 10100 10100 10100 10100 10100 10100 10100 10100 10100 10100 10100 10100 10100 10100 10100 10100 10100 10100 10100 10100 10100 10100 10100 10100 10100 10100 10100 10100 10100 10100 10100 10100 10100 10100 10100 10100 10100
				10100 10100 10100 10100 10100 10100 10100 10100 10100 10100 10100 10100 10100 10100 10100 10100 10100 10100 10100 10100 10100 10100 10100 10100 10100 10100 10100 10100 10100 10100 10100 10100 10100 10100 10100 10100 10100 10100 10100 10100
				10100 10100 10100 10100 10100 10100 10100 10100 10100 10100 10100 10100 10100 10100 10100 10100 10100 10100 10100 10100 10100 10100 10100 10100 10100 10100 10100 10100 10100 10100 10100 10100 10100 10100 10100 10100 10100 10100 10100 10100
				10100 10100 10100 10100 10100 10100 10100 10100 10100 10100 10100 10100 10100 10100 10100 10100 10100 10100 10100 10100 10100 10100 10100 10100 10100 10100 10100 10100 10100 10100 10100 10100 10100 10100 10100 10100 10100 10100 10100 10100
				10100 10100 10100 10100 10100 10100 10100 10100 10100 10100 10100 10100 10100 10100 10100 10100 10100 10100 10100 10100 10100 10100 10100 10100 10100 10100 10100 10100 10100 10100 10100 10100 10100 10100 10100 10100 10100 10100 10100 10100
				10100 10100 10100 10100 10100 10100 10100 10100 10100 10100 10100 10100 10100 10100 10100 10100 10100 10100 10100 10100 10100 10100 10100 10100 10100 10100 10100 10100 10100 10100 10100 10100 10100 10100 10100 10100 10100 10100 10100 10100
				10100 10100 10100 10100 10100 10100 10100 10100 10100 10100 10100 10100 10100 10100 10100 10100 10100 10100 10100 10100 10100 10100 10100 10100 10100 10100 10100 10100 10100 10100 10100 10100 10100 10100 10100 10100 10100 10100 10100 10100
				10100 10100 10100 10100 10100 10100 10100 10100 10100 10100 10100 10100 10100 10100 10100 10100 10100 10100 10100 10100 10100 10100 10100 10100 10100 10100 10100 10100 10100 10100 10100 10100 10100 10100 10100 10100 10100 10100 10100 10100
				10100 10100 10100 10100 10100 10100 10100 10100 10100 10100 10100 10100 10100 10100 10100 10100 10100 10100 10100 10100 10100 10100 10100 10100 10100 10100 10100 10100 10100 10100 10100 10100 10100 10100 10100 10100 10100 10100 10100 10100
				10100 10100 10100 10100 10100 10100 10100 10100 10100 10100 10100 10100 10100 10100 10100 10100 10100 10100 10100 10100 10100 10100 10100 10100 10100 10100 10100 10100 10100 10100 10100 10100 10100 10100 10100 10100 10100 10100 10100 10100
				10100 10100 10100 10100 10100 10100 10100 10100 10100 10100 10100 10100 10100 10100 10100 10100 10100 10100 10100 10100 10100 10100 10100 10100 10100 10100 10100 10100 10100 10100 10100 10100 10100 10100 10100 10100 10100 10100 10100 10100
				10100 10100 10100 10100 10100 10100 10100 10100 10100 10100 10100 10100 10100 10100 10100 10100 10100 10100 10100 10100 10100 10100 10100 10100 10100 10100 10100 10100 10100 10100 10100 10100 10100 10100 10100 10100 10100 10100 10100 10100
				10100 10100 10100 10100 10100 10100 10100 10100 10100 10100 10100 10100 10100 10100 10100 10100 10100 10100 10100 10100 10100 10100 10100 10100 10100 10100 10100 10100 10100 10100 10100 10100 10100 10100 10100 10100 10100 10100 10100 10100
				10100 10100 10100 10100 10100 10100 10100 10100 10100 10100 10100 10100 10100 10100 10100 10100 10100 10100 10100 10100 10100 10100 10100 10100 10100 10100 10100 10100 10100 10100 10100 10100 10100 10100 10100 10100 10100 10100 10100 10100
				10100 10100 10100 10100 10100 10100 10100 10100 10100 10100 10100 10100 10100 10100 10100 10100 10100 10100 10100 10100 10100 10100 10100 10100 10100 10100 10100 10100 10100 10100 10100 10100 10100 10100 10100 10100 10100 10100 10100 10100
				10100 10100 10100 10100 10100 10100 10100 10100 10100 10100 10100 10100 10100 10100 10100 10100 10100 10100 10100 10100 10100 10100 10100 10100 10100 10100 10100 10100 10100 10100 10100 10100 10100 10100 10100 10100 10100 10100 10100 10100
				10100 10100 10100 10100 10100 10100 10100 10100 10100 10100 10100 10100 10100 10100 10100 10100 10100 10100 10100 10100 10100 10100 10100 10100 10100 10100 10100 10100 10100 10100 10100 10100 10100 10100 10100 10100 10100 10100 10100 10100
				10100 10100 10100 10100 10100 10100 10100 10100 10100 10100 10100 10100 10100 10100 10100 10100 10100 10100 10100 10100 10100 10100 10100 10100 10100 10100 10100 10100 10100 10100 10100 10100 10100 10100 10100 10100 10100 10100 10100 10100
				10100 10100 10100 10100 10100 10100 10100 10100 10100 10100 10100 10100 10100 10100 10100 10100 10100 10100 10100 10100 10100 10100 10100 10100 10100 10100 10100 10100 10100 10100 10100 10100 10100 10100 10100 10100 10100 10100 10100 10100
				10100 10100 10100 10100 10100 10100 10100 10100 10100 10100 10100 10100 10100 10100 10100 10100 10100 10100 10100 10100 10100 10100 10100 10100 10100 10100 10100 10100 10100 10100 10100 10100 10100 10100 10100 10100 10100 10100 10100 10100
				10100 10100 10100 10100 10100 10100 10100 10100 10100 10100 10100 10100 10100 10100 10100 10100 10100 10100 10100 10100 10100 10100 10100 10100 10100 10100 10100 10100 10100 10100 10100 10100 10100 10100 10100 10100 10100 10100 10100 10100
				10100 10100 10100 10100 10100 10100 10100 10100 10100 10100 10100 10100 10100 10100 10100 10100 10100 10100 10100 10100 10100 10100 10100 10100 10100 10100 10100 10100 10100 10100 10100 10100 10100 10100 10100 10100 10100 10100 10100 10100
				10100 10100 10100 10100 10100 10100 10100 10100 10100 10100 10100 10100 10100 10100 10100 10100 10100 10100 10100 10100 10100 10100 10100 10100 10100 10100 10100 10100 10100 10100 10100 10100 10100 10100 10100 10100 10100 10100 10100 10100
				10100 10100 10100 10100 10100 10100 10100 10100 10100 10100 10100 10100 10100 10100 10100 10100 10100 10100 10100 10100 10100 10100 10100 10100 10100 10100 10100 10100 10100 10100 10100 10100 10100 10100 10100 10100 10100 10100 10100 10100
				10100 10100 10100 10100 10100 10100 10100 10100 10100 10100 10100 10100 10100 10100 10100 10100 10100 10100 10100 10100 10100 10100 10100 10100 10100 10100 10100 10100 10100 10100 10100 10100 10100 10100 10100 10100 10100 10100 10100 10100
				10100 10100 10100 10100 10100 10100 10100 10100 10100 10100 10100 10100 10100 10100 10100 10100 10100 10100 10100 10100 10100 10100 10100 10100 10100 10100 10100 10100 10100 10100 10100 10100 10100 10100 10100 10100 10100 10100 10100 10100
				10100 10100 10100 10100 10100 10100 10100 10100 10100 10100 10100 10100 10100 10100 10100 10100 10100 10100 10100 10100 10100 10100 10100 10100 10100 10100 10100 10100 10100 10100 10100 10100 10100 10100 10100 10100 10100 10100 10100 10100
				10100 10100 10100 10100 10100 10100 10100 10100 10100 10100 10100 10100 10100 10100 10100 10100 10100 10100 10100 10100 10100 10100 10100 10100 10100 10100 10100 10100 10100 10100 10100 10100 10100 10100 10100 10100 10100 10100 10100 10100
				10100 10100 10100 10100 10100 10100 10100 10100 10100 10100 10100 10100 10100 10100 10100 10100 10100 10100 10100 10100 10100 10100 10100 10100 10100 10100 10100 10100 10100 10100 10100 10100 10100 10100 10100 10100 10100 10100 10100 10100
				10100 10100 10100 10100 10100 10100 10100 10100 10100 10100 10100 10100 10100 10100 10100 10100 10100 10100 10100 10100 10100 10100 10100 10100 10100 10100 10100 10100 10100 10100 10100 10100 10100 10100 10100 10100 10100 10100 10100 10100
				10100 10100 10100 10100 10100 10100 10100 10100 10100 10100 10100 10100 10100 10100 10100 10100 10100 10100 10100 10100 10100 10100 10100 10100 10100 10100 10100 10100 10100 10100 10100 10100 10100 10100 10100 10100 10100 10100 10100 10100
				10100 10100 10100 10100 10100 10100 10100 10100 10100 10100 10100 10100 10100 10100 10100 10100 10100 10100 10100 10100 10100 10100 10100 10100 10100 10100 10100 10100 10100 10100 10100 10100 10100 10100 10100 10100 10100 10100 10100 10100
				10100 10100 10100 10100 10100 10100 10100 10100 10100 10100 10100 10100 10100 10100 10100 10100 10100 10100 10100 10100 10100 10100 10100 10100 10100 10100 10100 10100 10100 10100 10100 10100 10100 10100 10100 10100 10100 10100 10100 10100
				10100 10100 10100 10100 10100 10100 10100 10100 10100 10100 10100 10100 10100 10100 10100 10100 10100 10100 10100 10100 10100 10100 10100 10100 10100 10100 10100 10100 10100 10100 10100 10100 10100 10100 10100 10100 10100 10100 10100 10100
				10100 10100 10100 10100 10100 10100 10100 10100 10100 10100 10100 10100 10100 10100 10100 10100 10100 10100 10100 10100 10100 10100 10100 10100 10100 10100 10100 10100 10100 10100 10100 10100 10100 10100 10100 10100 10100 10100 10100 10100
				10100 10100 10100 10100 10100 10100 10100 10100 10100 10100 10100 10100 10100 10100 10100 10100 10100 10100 10100 10100 10100 10100 10100 10100 10100 10100 10100 10100 10100 10100 10100 10100 10100 10100 10100 10100 10100 10100 10100 10100
				10100 10100 10100 10100 10100 10100 10100 10100 10100 10100 10100 10100 10100 10100 10100 10100 10100 10100 10100 10100 10100 10100 10100 10100 10100 10100 10100 10100 10100 10100 10100 10100 10100 10100 10100 10100 10100 10100 10100 10100
				10100 10100 10100>;

			PS_Config_Lmt_Open_Rawdata_P = <
				3390 3437 3438 3441 3455 3452 3472 3474 3456 3444 3421 3420 3397 3396 3400 3399 3309 3318 3320 3326 3341 3343 3364 3358 3354 3337 3346 3340 3329 3326 3326 3350
				3270 3313 3311 3316 3327 3332 3340 3351 3270 3245 3234 3217 3203 3192 3187 3193 3228 3239 3235 3246 3257 3264 3273 3281 3249 3248 3249 3248 3236 3225 3217 3242
				3448 3488 3491 3495 3498 3497 3497 3515 3393 3361 3357 3344 3334 3330 3330 3336 3330 3334 3340 3348 3360 3368 3368 3382 3392 3368 3365 3360 3357 3350 3358 3388
				3304 3336 3337 3344 3350 3358 3362 3376 3325 3322 3315 3305 3295 3287 3287 3295 3232 3245 3242 3249 3259 3267 3271 3285 3281 3270 3263 3255 3242 3231 3231 3250
				3379 3396 3400 3402 3404 3402 3411 3421 3376 3360 3344 3343 3329 3323 3322 3326 3326 3326 3327 3334 3340 3336 3348 3354 3364 3347 3347 3340 3339 3336 3351 3388
				3438 3459 3458 3469 3473 3480 3491 3504 3427 3418 3403 3389 3376 3368 3374 3374 3395 3410 3411 3416 3424 3428 3444 3451 3323 3318 3313 3306 3292 3292 3299 3323
				3368 3388 3376 3374 3365 3374 3371 3390 3337 3318 3309 3308 3298 3298 3294 3292 3368 3371 3369 3371 3369 3376 3376 3390 3306 3284 3278 3284 3276 3264 3273 3304
				3369 3402 3410 3407 3414 3424 3434 3449 3420 3416 3403 3399 3379 3371 3379 3371 3413 3411 3417 3421 3430 3439 3449 3456 3428 3421 3413 3409 3392 3390 3400 3424
				3322 3355 3354 3354 3360 3351 3362 3368 3333 3323 3313 3312 3294 3291 3295 3294 3208 3208 3207 3208 3214 3211 3227 3236 3297 3287 3290 3291 3281 3284 3278 3316
				3435 3483 3474 3479 3490 3488 3500 3519 3460 3455 3452 3427 3414 3404 3406 3399 3357 3365 3368 3374 3386 3379 3390 3399 3410 3410 3404 3385 3382 3368 3375 3390
				3441 3466 3460 3452 3455 3455 3459 3472 3432 3421 3416 3403 3396 3396 3402 3392 3337 3358 3354 3353 3371 3362 3379 3382 3406 3389 3382 3372 3372 3365 3379 3400
				3402 3427 3428 3427 3428 3438 3444 3448 3294 3292 3273 3270 3252 3253 3248 3246 3353 3357 3367 3368 3381 3393 3399 3411 3312 3309 3295 3290 3281 3281 3283 3306
				3441 3476 3474 3477 3486 3486 3497 3501 3445 3432 3424 3421 3407 3406 3406 3389 3329 3348 3347 3350 3358 3365 3379 3379 3413 3397 3388 3388 3374 3375 3379 3389
				3340 3371 3374 3379 3388 3390 3393 3407 3407 3386 3385 3376 3361 3360 3353 3334 3311 3326 3315 3323 3337 3344 3346 3365 3267 3260 3263 3259 3239 3236 3242 3246
				3425 3465 3463 3458 3458 3465 3463 3483 3493 3479 3474 3463 3458 3449 3452 3432 3351 3364 3355 3365 3371 3371 3374 3395 3486 3465 3463 3458 3446 3445 3458 3455
				3421 3466 3466 3460 3469 3480 3486 3498 3480 3481 3472 3459 3442 3438 3431 3417 3365 3390 3393 3392 3411 3413 3430 3442 3409 3402 3396 3389 3374 3374 3371 3382
				3327 3379 3372 3361 3367 3365 3364 3385 3378 3365 3361 3351 3340 3340 3334 3329 3320 3333 3334 3327 3344 3341 3351 3367 3325 3309 3305 3302 3295 3298 3295 3312
				3474 3526 3521 3514 3528 3529 3540 3542 3446 3435 3418 3409 3403 3393 3396 3375 3340 3368 3364 3369 3385 3386 3402 3403 3407 3390 3376 3374 3362 3357 3357 3357
				3385 3421 3421 3418 3418 3427 3430 3424 3334 3329 3313 3305 3298 3298 3301 3274 3379 3392 3388 3385 3390 3390 3390 3404 3308 3292 3281 3278 3273 3270 3283 3290
				3432 3474 3472 3474 3474 3483 3488 3505 3490 3480 3473 3463 3446 3441 3444 3421 3417 3434 3438 3449 3453 3459 3466 3476 3399 3385 3379 3376 3357 3348 3353 3346
				3463 3512 3502 3497 3498 3502 3511 3523 3462 3438 3430 3424 3410 3410 3411 3385 3402 3427 3425 3420 3435 3441 3449 3453 3424 3406 3400 3404 3390 3381 3390 3395
				3369 3427 3424 3410 3418 3417 3431 3449 3390 3385 3375 3369 3360 3357 3362 3336 3301 3334 3337 3336 3350 3354 3360 3369 3264 3253 3253 3245 3229 3220 3227 3217
				3432 3494 3488 3488 3488 3481 3500 3511 3421 3411 3406 3393 3388 3379 3388 3357 3404 3438 3431 3427 3439 3427 3448 3466 3435 3420 3420 3413 3407 3404 3406 3396
				3354 3400 3400 3399 3407 3404 3421 3427 3336 3339 3329 3319 3316 3312 3306 3287 3332 3353 3350 3355 3360 3357 3365 3372 3354 3347 3346 3340 3334 3334 3336 3339
				3469 3516 3536 3530 3533 3533 3546 3551 3453 3437 3430 3421 3416 3418 3388 3365 3376 3403 3424 3418 3424 3428 3435 3446 3424 3407 3403 3399 3392 3390 3381 3390
				3453 3502 3518 3519 3528 3533 3540 3549 3449 3435 3427 3418 3404 3406 3389 3346 3385 3406 3427 3435 3444 3451 3459 3463 3435 3427 3427 3420 3407 3395 3386 3375
				3364 3404 3410 3406 3411 3411 3414 3424 3374 3365 3357 3357 3343 3346 3336 3299 3305 3337 3354 3350 3360 3368 3376 3390 3319 3304 3309 3301 3298 3302 3285 3281
				3430 3488 3512 3511 3522 3526 3536 3535 3458 3451 3451 3438 3418 3417 3392 3348 3416 3449 3472 3472 3488 3488 3501 3508 3418 3407 3420 3409 3393 3396 3376 3362
				3406 3460 3477 3469 3473 3472 3472 3488 3325 3315 3311 3309 3295 3301 3276 3243 3337 3365 3375 3367 3376 3374 3381 3404 3326 3313 3309 3309 3304 3305 3291 3276
				3414 3469 3486 3483 3495 3501 3516 3522 3480 3480 3472 3455 3446 3441 3410 3382 3364 3390 3417 3417 3431 3439 3455 3466 3483 3476 3469 3462 3458 3456 3432 3430
				3481 3521 3540 3539 3542 3539 3547 3558 3416 3410 3404 3390 3379 3379 3353 3323 3365 3396 3425 3418 3427 3424 3434 3453 3399 3399 3399 3390 3388 3389 3358 3353
				3329 3372 3400 3396 3399 3400 3416 3418 3350 3343 3334 3329 3320 3318 3292 3253 3299 3326 3353 3354 3362 3368 3382 3389 3333 3323 3323 3319 3304 3304 3281 3280
				3456 3497 3528 3523 3526 3535 3543 3547 3543 3528 3519 3516 3504 3502 3469 3432 3374 3399 3427 3423 3435 3442 3455 3460 3407 3397 3396 3399 3388 3388 3355 3350
				3379 3423 3448 3446 3451 3460 3463 3474 3382 3371 3371 3357 3340 3329 3302 3273 3273 3298 3327 3332 3336 3347 3350 3358 3390 3385 3385 3376 3369 3360 3336 3320
				3441 3497 3514 3516 3521 3532 3535 3556 3535 3516 3521 3514 3498 3497 3466 3427 3382 3411 3442 3441 3458 3463 3470 3490 3476 3459 3458 3455 3452 3446 3418 3403
				3460 3516 3556 3547 3556 3564 3567 3575 3476 3469 3458 3449 3430 3417 3385 3346 3379 3409 3442 3446 3459 3458 3470 3473 3414 3411 3404 3407 3396 3386 3360 3357
				3337 3389 3406 3411 3410 3416 3425 3435 3418 3410 3406 3400 3395 3392 3365 3333 3263 3287 3319 3322 3333 3330 3344 3357 3390 3382 3375 3378 3371 3368 3334 3330
				3476 3521 3550 3550 3561 3571 3584 3586 3474 3466 3459 3442 3434 3421 3393 3348 3379 3404 3449 3462 3474 3479 3494 3497 3413 3404 3404 3399 3390 3368 3344 3323
				3361 3404 3428 3439 3438 3446 3449 3459 3367 3364 3354 3343 3340 3327 3306 3277 3287 3309 3334 3341 3351 3357 3367 3383 3385 3375 3383 3381 3376 3365 3334 3323
				3374 3417 3445 3455 3462 3473 3477 3476 3483 3472 3463 3462 3445 3424 3389 3347 3357 3381 3410 3421 3432 3435 3455 3453 3448 3437 3432 3437 3421 3397 3367 3350
				3438 3483 3507 3514 3519 3521 3530 3550 3477 3463 3452 3449 3442 3416 3386 3348 3351 3379 3402 3410 3427 3431 3439 3459 3452 3434 3435 3432 3423 3404 3375 3357
				3332 3396 3413 3420 3435 3435 3449 3455 3379 3371 3368 3361 3353 3332 3302 3266 3248 3270 3301 3311 3327 3341 3348 3360 3295 3284 3290 3283 3284 3257 3242 3222
				3404 3444 3469 3486 3483 3480 3484 3501 3511 3505 3491 3481 3477 3455 3424 3397 3347 3371 3402 3421 3432 3435 3446 3466 3439 3431 3432 3424 3417 3393 3368 3340
				3297 3348 3372 3393 3404 3410 3421 3421 3383 3382 3371 3368 3358 3332 3304 3266 3295 3312 3340 3365 3376 3371 3386 3388 3347 3341 3340 3340 3323 3304 3264 3253
				3507 3543 3570 3578 3584 3581 3584 3602 3438 3430 3423 3423 3416 3389 3357 3312 3418 3441 3467 3486 3501 3502 3514 3528 3430 3420 3416 3420 3418 3381 3357 3340
				3448 3497 3522 3547 3554 3565 3567 3564 3508 3494 3491 3490 3483 3451 3427 3385 3336 3361 3396 3425 3431 3444 3458 3459 3483 3466 3462 3451 3446 3407 3374 3346
				3365 3404 3428 3444 3452 3453 3452 3463 3396 3393 3393 3376 3378 3348 3322 3291 3220 3248 3276 3304 3311 3316 3318 3332 3306 3295 3298 3292 3290 3259 3232 3217
				3399 3451 3477 3505 3515 3522 3530 3530 3505 3500 3488 3474 3463 3434 3402 3368 3402 3427 3460 3495 3512 3511 3525 3509 3402 3400 3390 3389 3374 3334 3312 3290
				3287 3325 3344 3367 3371 3371 3378 3389 3360 3348 3340 3339 3326 3298 3273 3231 3284 3306 3343 3368 3381 3382 3385 3390 3273 3270 3270 3273 3266 3225 3203 3171
				3459 3488 3516 3546 3543 3553 3563 3564 3505 3494 3483 3480 3472 3438 3400 3325 3357 3402 3432 3452 3449 3459 3466 3459 3455 3442 3435 3428 3431 3392 3357 3332
				5120 5120 5120>;

			PS_Config_Lmt_Open_Rawdata_N = <
				1453 1473 1473 1474 1480 1479 1488 1489 1481 1476 1466 1465 1456 1455 1457 1456 1418 1422 1423 1425 1432 1432 1441 1439 1437 1430 1434 1431 1426 1425 1425 1435
				1401 1420 1419 1421 1426 1428 1431 1436 1401 1390 1386 1378 1372 1368 1366 1368 1383 1388 1386 1391 1396 1399 1402 1406 1392 1392 1392 1392 1387 1382 1378 1389
				1477 1495 1496 1498 1499 1498 1498 1506 1454 1440 1438 1433 1429 1427 1427 1429 1427 1429 1431 1435 1440 1443 1443 1449 1453 1443 1442 1440 1438 1435 1439 1452
				1416 1429 1430 1433 1435 1439 1441 1447 1425 1423 1420 1416 1412 1408 1408 1412 1385 1390 1389 1392 1396 1400 1402 1408 1406 1401 1398 1395 1389 1384 1384 1393
				1448 1455 1457 1458 1459 1458 1462 1466 1447 1440 1433 1432 1426 1424 1423 1425 1425 1425 1426 1429 1431 1429 1435 1437 1441 1434 1434 1431 1431 1429 1436 1452
				1473 1482 1482 1486 1488 1491 1496 1501 1468 1465 1458 1452 1447 1443 1446 1446 1455 1461 1462 1464 1467 1469 1476 1479 1424 1422 1420 1417 1411 1411 1414 1424
				1443 1452 1447 1446 1442 1446 1444 1453 1430 1422 1418 1417 1413 1413 1411 1411 1443 1444 1444 1444 1444 1447 1447 1453 1417 1407 1405 1407 1404 1399 1402 1416
				1444 1458 1461 1460 1463 1467 1471 1478 1465 1464 1458 1456 1448 1444 1448 1444 1462 1462 1464 1466 1470 1474 1478 1481 1469 1466 1462 1461 1453 1453 1457 1467
				1423 1438 1437 1437 1440 1436 1441 1443 1428 1424 1420 1419 1411 1410 1412 1411 1375 1375 1374 1375 1377 1376 1383 1387 1413 1408 1410 1410 1406 1407 1405 1421
				1472 1492 1489 1491 1495 1495 1500 1508 1483 1480 1479 1468 1463 1459 1459 1456 1438 1442 1443 1446 1451 1448 1453 1456 1461 1461 1459 1450 1449 1443 1446 1453
				1474 1485 1483 1479 1480 1480 1482 1488 1471 1466 1464 1458 1455 1455 1458 1453 1430 1439 1437 1437 1444 1441 1448 1449 1459 1452 1449 1445 1445 1442 1448 1457
				1458 1468 1469 1468 1469 1473 1476 1477 1411 1411 1402 1401 1393 1394 1392 1391 1437 1438 1443 1443 1449 1454 1456 1462 1419 1418 1412 1410 1406 1406 1407 1417
				1474 1489 1489 1490 1494 1494 1498 1500 1476 1471 1467 1466 1460 1459 1459 1452 1426 1435 1434 1435 1439 1442 1448 1448 1462 1456 1452 1452 1446 1446 1448 1452
				1431 1444 1446 1448 1452 1453 1454 1460 1460 1451 1450 1447 1440 1440 1437 1429 1419 1425 1420 1424 1430 1433 1434 1442 1400 1397 1398 1396 1388 1387 1389 1391
				1468 1485 1484 1482 1482 1485 1484 1492 1497 1491 1489 1484 1482 1478 1479 1471 1436 1441 1438 1442 1444 1444 1446 1455 1494 1485 1484 1482 1477 1476 1482 1480
				1466 1485 1485 1483 1486 1491 1494 1499 1491 1492 1488 1482 1475 1473 1470 1464 1442 1453 1454 1453 1462 1462 1470 1475 1461 1458 1455 1452 1446 1446 1444 1449
				1426 1448 1445 1440 1443 1442 1441 1450 1447 1442 1440 1436 1431 1431 1429 1426 1423 1428 1429 1426 1433 1432 1436 1443 1425 1418 1416 1415 1412 1413 1412 1419
				1489 1511 1509 1506 1512 1512 1517 1518 1477 1472 1465 1461 1458 1454 1455 1446 1431 1443 1441 1444 1450 1451 1458 1458 1460 1453 1447 1446 1441 1438 1438 1438
				1450 1466 1466 1465 1465 1468 1470 1467 1429 1426 1420 1416 1413 1413 1414 1403 1448 1453 1452 1450 1453 1453 1453 1459 1417 1411 1406 1405 1402 1401 1407 1410
				1471 1489 1488 1489 1489 1492 1495 1502 1495 1491 1488 1484 1477 1474 1476 1466 1464 1471 1473 1478 1480 1482 1485 1489 1456 1450 1448 1447 1438 1435 1437 1434
				1484 1505 1501 1498 1499 1501 1504 1510 1483 1473 1470 1467 1461 1461 1462 1450 1458 1468 1468 1465 1472 1474 1478 1480 1467 1459 1457 1459 1453 1449 1453 1455
				1444 1468 1467 1461 1465 1464 1470 1478 1453 1450 1446 1444 1440 1438 1441 1429 1414 1429 1430 1429 1435 1437 1440 1444 1399 1394 1394 1390 1384 1380 1383 1378
				1471 1497 1495 1495 1495 1492 1500 1504 1466 1462 1459 1454 1452 1448 1452 1438 1459 1473 1470 1468 1474 1468 1477 1485 1472 1465 1465 1462 1460 1459 1459 1455
				1437 1457 1457 1456 1460 1459 1466 1468 1429 1431 1426 1422 1421 1419 1417 1408 1428 1437 1435 1438 1440 1438 1442 1445 1437 1434 1434 1431 1429 1429 1429 1431
				1486 1507 1515 1513 1514 1514 1519 1522 1480 1473 1470 1466 1464 1465 1452 1442 1447 1458 1467 1465 1467 1469 1472 1477 1467 1460 1458 1456 1453 1453 1449 1453
				1480 1501 1507 1508 1512 1514 1517 1521 1478 1472 1468 1465 1459 1459 1452 1434 1450 1459 1468 1472 1476 1479 1482 1484 1472 1468 1468 1465 1460 1455 1451 1446
				1441 1459 1461 1459 1462 1462 1463 1467 1446 1442 1438 1438 1432 1434 1429 1414 1416 1430 1437 1435 1440 1443 1447 1453 1422 1416 1418 1414 1413 1415 1408 1406
				1470 1495 1505 1504 1509 1511 1515 1515 1482 1479 1479 1473 1465 1464 1453 1435 1464 1478 1488 1488 1495 1495 1500 1503 1465 1460 1465 1461 1454 1455 1447 1441
				1459 1483 1490 1486 1488 1488 1488 1495 1425 1420 1419 1418 1412 1414 1404 1390 1430 1442 1446 1443 1447 1446 1449 1459 1425 1420 1418 1418 1416 1416 1410 1404
				1463 1486 1494 1492 1498 1500 1507 1509 1491 1491 1488 1480 1477 1474 1461 1449 1441 1453 1464 1464 1470 1474 1480 1485 1492 1489 1486 1483 1482 1481 1471 1470
				1492 1509 1517 1516 1518 1516 1520 1525 1464 1461 1459 1453 1448 1448 1437 1424 1442 1455 1468 1465 1468 1467 1471 1480 1456 1456 1456 1453 1452 1452 1439 1437
				1426 1445 1457 1455 1456 1457 1464 1465 1435 1432 1429 1426 1423 1422 1411 1394 1414 1425 1437 1437 1441 1443 1449 1452 1428 1424 1424 1422 1416 1416 1406 1405
				1481 1498 1512 1510 1511 1515 1518 1520 1518 1512 1508 1507 1501 1501 1486 1471 1446 1456 1468 1467 1472 1475 1480 1483 1460 1456 1455 1456 1452 1452 1438 1435
				1448 1467 1477 1477 1479 1483 1484 1489 1449 1444 1444 1438 1431 1426 1415 1402 1402 1413 1426 1428 1429 1434 1435 1439 1453 1450 1450 1447 1444 1440 1429 1423
				1474 1498 1506 1507 1509 1513 1515 1524 1515 1507 1509 1506 1499 1498 1485 1468 1449 1462 1475 1474 1482 1484 1487 1495 1489 1482 1482 1480 1479 1477 1465 1458
				1483 1507 1524 1520 1524 1527 1528 1532 1489 1486 1482 1478 1470 1464 1450 1434 1448 1461 1475 1477 1482 1482 1487 1488 1463 1462 1459 1460 1455 1451 1440 1438
				1430 1452 1459 1462 1461 1464 1468 1472 1465 1461 1459 1457 1455 1453 1442 1428 1398 1408 1422 1423 1428 1427 1433 1438 1453 1449 1446 1447 1444 1443 1429 1427
				1489 1509 1521 1521 1526 1530 1536 1537 1489 1485 1482 1475 1471 1466 1454 1435 1448 1459 1478 1483 1489 1491 1497 1498 1462 1459 1459 1456 1453 1443 1433 1424
				1440 1459 1469 1474 1473 1477 1478 1482 1443 1441 1437 1432 1431 1426 1417 1404 1408 1418 1429 1432 1436 1438 1443 1450 1450 1446 1450 1449 1447 1442 1429 1424
				1446 1464 1476 1480 1483 1488 1490 1489 1492 1488 1484 1483 1476 1467 1452 1434 1438 1449 1461 1466 1471 1472 1480 1480 1477 1473 1471 1473 1466 1456 1443 1435
				1473 1492 1503 1506 1508 1509 1513 1521 1490 1484 1479 1478 1475 1464 1451 1435 1436 1448 1458 1461 1468 1470 1474 1482 1479 1471 1472 1471 1467 1459 1446 1438
				1428 1455 1462 1465 1472 1472 1478 1480 1448 1444 1443 1440 1437 1428 1415 1399 1392 1401 1414 1419 1426 1432 1435 1440 1412 1407 1410 1407 1407 1396 1389 1381
				1459 1476 1486 1494 1492 1491 1493 1500 1504 1502 1496 1492 1490 1480 1467 1456 1434 1444 1458 1466 1471 1472 1477 1485 1474 1470 1471 1467 1464 1454 1443 1431
				1413 1435 1445 1454 1459 1461 1466 1466 1450 1449 1444 1443 1439 1428 1416 1399 1412 1419 1431 1442 1447 1444 1451 1452 1434 1432 1431 1431 1424 1416 1399 1394
				1503 1518 1530 1533 1536 1534 1536 1543 1473 1470 1467 1467 1464 1452 1438 1419 1465 1474 1486 1494 1500 1501 1506 1512 1470 1465 1464 1465 1465 1449 1438 1431
				1477 1498 1509 1520 1523 1528 1528 1527 1503 1497 1496 1495 1492 1479 1468 1450 1429 1440 1455 1468 1470 1476 1482 1482 1492 1485 1483 1479 1477 1460 1446 1434
				1442 1459 1469 1476 1479 1480 1479 1484 1455 1454 1454 1447 1447 1435 1423 1410 1380 1392 1404 1416 1419 1421 1422 1428 1417 1412 1413 1411 1410 1396 1385 1378
				1456 1479 1490 1502 1506 1509 1513 1513 1502 1500 1495 1489 1484 1471 1458 1443 1458 1468 1483 1498 1505 1504 1510 1504 1458 1457 1453 1452 1446 1429 1419 1410
				1408 1425 1433 1443 1444 1444 1447 1452 1440 1435 1431 1431 1425 1413 1402 1384 1407 1417 1432 1443 1449 1449 1450 1453 1402 1401 1401 1402 1399 1382 1372 1359
				1482 1495 1507 1519 1518 1522 1527 1527 1502 1497 1492 1491 1488 1473 1457 1425 1438 1458 1471 1479 1478 1482 1485 1482 1480 1475 1472 1469 1470 1453 1438 1428
				(-511) (-511) (-511)>;

			PS_Config_Lmt_FW_Rawdata_P = <
				548 543 557 560 555 557 571 560 544 569 546 543 568 550 553 558 554 553 553 550 550 557 537 560 554 554 550 550 555 548 541 571
				553 560 558 539 540 539 546 547 547 546 553 551 557 558 557 548 550 547 546 560 551 550 551 557 551 565 554 550 558 558 551 543
				546 551 558 553 564 548 555 557 561 551 551 554 540 557 555 558 544 541 555 544 547 540 548 554 554 555 547 548 558 551 560 561
				540 571 546 543 546 544 551 553 553 548 554 539 553 551 548 541 536 560 554 564 565 537 547 555 546 551 551 561 550 557 548 546
				546 564 547 557 572 553 565 560 557 554 548 555 550 564 546 558 551 547 543 541 546 546 548 557 561 544 578 561 554 561 557 546
				544 541 553 546 555 546 569 564 554 558 543 554 557 557 551 564 567 550 547 541 557 560 558 558 539 543 555 555 544 554 550 550
				543 541 553 562 561 565 562 548 546 557 558 551 540 553 539 553 546 572 560 550 550 555 554 558 561 536 572 569 557 560 554 560
				569 568 546 547 548 550 565 562 537 576 544 540 548 540 544 557 567 547 557 553 539 534 546 557 539 551 560 560 557 550 548 546
				553 546 553 544 547 546 544 543 558 539 553 553 539 550 558 558 555 546 541 541 540 554 558 562 544 561 543 541 540 548 544 553
				555 553 555 550 561 558 534 568 539 534 567 562 541 550 553 550 553 553 548 555 553 551 543 547 548 536 571 569 550 557 551 561
				558 550 554 544 554 554 547 553 558 560 543 546 530 539 541 547 539 543 550 564 557 555 553 561 561 544 558 550 562 569 554 551
				530 564 540 540 551 554 544 540 551 555 557 567 548 555 551 558 544 539 557 551 567 564 543 548 557 550 551 551 548 539 543 562
				533 536 548 557 561 557 551 541 541 530 565 565 551 555 541 541 540 550 557 555 553 550 554 550 567 557 547 551 540 557 555 564
				560 551 551 551 562 571 554 541 540 541 568 560 547 550 551 555 561 561 544 560 547 547 569 574 551 550 534 533 526 562 567 554
				543 544 547 548 550 548 547 543 554 544 541 557 551 554 548 546 564 561 548 554 562 539 560 550 537 569 564 560 554 564 553 553
				558 555 562 541 551 558 544 534 539 539 554 557 534 548 541 546 541 560 562 562 578 543 558 553 561 555 529 536 575 529 571 546
				557 554 557 558 555 554 550 546 543 555 547 543 561 544 540 550 547 546 540 547 554 562 567 534 551 558 548 553 541 541 543 558
				550 541 547 553 553 539 551 557 555 557 546 548 553 560 561 546 557 569 543 541 560 541 551 560 554 548 544 551 555 554 555 547
				558 543 547 539 567 568 551 550 564 557 553 553 540 553 544 553 550 555 551 543 555 555 550 543 548 539 543 561 550 543 539 567
				547 537 557 543 564 548 548 547 553 572 544 534 560 558 555 533 555 551 558 551 544 562 560 560 536 539 565 564 541 543 543 565
				540 547 557 548 555 560 557 553 537 560 557 554 540 554 557 548 546 547 553 546 565 546 548 551 553 561 544 540 557 546 551 548
				571 543 555 553 547 550 553 537 554 554 554 553 550 541 536 564 548 564 548 561 544 558 565 567 560 561 553 541 554 550 557 550
				534 561 560 554 543 550 567 569 539 537 557 560 546 548 548 553 550 555 560 560 571 547 546 557 550 546 539 554 553 558 544 558
				547 574 534 541 554 562 558 555 565 574 555 551 537 541 536 544 562 544 555 551 548 547 560 565 561 560 553 554 553 554 548 537
				567 539 551 540 550 557 565 554 565 555 551 541 544 562 555 553 550 554 540 544 562 571 527 541 547 553 569 568 550 569 548 551
				560 548 551 548 564 539 551 544 557 547 558 546 561 550 543 561 568 541 548 548 547 553 569 564 539 540 534 571 541 555 565 557
				565 554 546 540 541 544 555 554 551 551 548 551 560 543 544 554 547 557 553 553 547 560 564 536 546 550 539 539 561 554 537 532
				565 557 547 564 550 551 551 554 547 544 551 557 550 546 541 543 546 551 546 557 555 555 550 551 540 550 561 560 550 547 554 554
				561 553 551 546 544 551 561 550 554 550 548 553 550 548 544 561 540 560 557 554 568 561 546 553 550 544 558 561 561 560 547 543
				557 561 557 554 557 550 544 551 557 548 558 551 557 558 534 544 561 557 553 548 550 561 565 550 551 557 551 557 541 555 548 560
				561 550 572 574 543 548 548 550 547 541 555 548 533 543 558 560 543 565 548 555 557 557 565 546 551 557 546 548 560 555 558 560
				551 548 546 548 565 553 564 564 553 560 561 554 548 547 541 555 555 558 564 547 539 548 557 567 561 561 541 547 551 546 550 561
				550 560 554 550 551 550 558 564 551 550 540 553 557 553 543 554 541 546 540 541 558 550 554 551 547 548 551 565 547 546 543 540
				557 550 557 547 550 551 547 544 550 544 544 551 553 550 558 551 554 548 537 543 554 555 553 548 558 555 548 546 550 555 551 554
				562 547 551 550 550 560 547 561 569 555 560 551 533 558 541 544 565 551 547 561 547 548 547 555 567 550 546 550 548 548 553 546
				554 546 548 575 533 544 553 555 555 561 541 560 557 555 560 540 553 558 553 547 555 554 548 540 562 555 554 558 555 547 548 562
				541 543 558 560 555 551 553 562 558 554 554 560 557 539 564 543 550 567 544 543 540 546 551 544 553 560 551 555 557 534 534 554
				557 536 550 558 555 553 555 555 560 561 555 548 551 558 555 551 560 555 560 553 557 551 548 553 560 557 548 554 550 540 537 534
				557 551 561 550 550 548 554 562 548 553 557 555 548 574 569 571 553 548 551 562 548 541 544 554 557 555 547 546 540 554 544 544
				557 544 554 551 550 548 551 565 551 551 540 540 565 539 548 551 554 548 547 554 546 534 547 561 544 547 553 546 541 548 555 553
				548 553 555 553 546 543 553 546 551 558 541 569 561 530 557 546 565 560 548 565 564 541 543 532 557 546 550 544 543 555 569 540
				562 561 546 562 565 537 543 558 561 569 562 551 558 540 546 561 546 557 551 567 572 543 548 565 553 558 561 555 558 555 554 539
				558 544 550 558 569 546 558 554 540 544 536 564 547 554 558 554 551 541 558 544 550 565 553 550 550 540 541 562 554 557 565 551
				574 562 560 561 564 544 547 567 547 546 544 546 557 555 579 541 546 546 539 561 540 550 562 543 540 550 543 550 539 565 557 574
				546 562 560 555 560 553 560 546 574 564 557 555 551 540 572 555 557 561 557 543 539 546 560 561 547 546 558 557 554 548 550 565
				553 543 539 560 554 547 554 551 553 562 564 548 561 575 572 546 561 554 541 546 554 568 548 575 558 557 561 561 562 571 576 554
				574 560 534 571 554 553 553 548 565 560 565 557 561 557 550 558 565 557 546 572 561 554 558 553 550 551 557 555 543 558 547 553
				555 550 551 555 532 551 553 544 541 551 553 558 544 548 550 551 557 554 560 554 560 564 560 553 555 562 561 564 564 565 571 543
				537 560 550 560 554 550 555 550 540 540 540 551 546 554 557 562 550 553 537 569 537 550 555 555 546 539 539 546 548 553 544 551
				546 557 548 541 548 550 547 567 546 546 543 551 560 551 551 564 567 551 555 558 543 565 569 554 544 537 540 546 567 567 572 550
				3840 3840 3840>;

			PS_Config_Lmt_FW_Rawdata_N = <
				235 232 238 240 238 238 244 240 233 244 234 232 243 235 237 239 237 237 237 235 235 238 230 240 237 237 235 235 238 235 232 244
				237 240 239 231 231 231 234 234 234 234 237 236 238 239 238 235 235 234 234 240 236 235 236 238 236 242 237 235 239 239 236 232
				234 236 239 237 241 235 238 238 240 236 236 237 231 238 238 239 233 232 238 233 234 231 235 237 237 238 234 235 239 236 240 240
				231 244 234 232 234 233 236 237 237 235 237 231 237 236 235 232 229 240 237 241 242 230 234 238 234 236 236 240 235 238 235 234
				234 241 234 238 245 237 242 240 238 237 235 238 235 241 234 239 236 234 232 232 234 234 235 238 240 233 247 240 237 240 238 234
				233 232 237 234 238 234 244 241 237 239 232 237 238 238 236 241 243 235 234 232 238 240 239 239 231 232 238 238 233 237 235 235
				232 232 237 241 240 242 241 235 234 238 239 236 231 237 231 237 234 245 240 235 235 238 237 239 240 229 245 244 238 240 237 240
				244 243 234 234 235 235 242 241 230 247 233 231 235 231 233 238 243 234 238 237 231 229 234 238 231 236 240 240 238 235 235 234
				237 234 237 233 234 234 233 232 239 231 237 237 231 235 239 239 238 234 232 232 231 237 239 241 233 240 232 232 231 235 233 237
				238 237 238 235 240 239 229 243 231 229 243 241 232 235 237 235 237 237 235 238 237 236 232 234 235 229 244 244 235 238 236 240
				239 235 237 233 237 237 234 237 239 240 232 234 227 231 232 234 231 232 235 241 238 238 237 240 240 233 239 235 241 244 237 236
				227 241 231 231 236 237 233 231 236 238 238 243 235 238 236 239 233 231 238 236 243 241 232 235 238 235 236 236 235 231 232 241
				228 229 235 238 240 238 236 232 232 227 242 242 236 238 232 232 231 235 238 238 237 235 237 235 243 238 234 236 231 238 238 241
				240 236 236 236 241 244 237 232 231 232 243 240 234 235 236 238 240 240 233 240 234 234 244 246 236 235 229 228 225 241 243 237
				232 233 234 235 235 235 234 232 237 233 232 238 236 237 235 234 241 240 235 237 241 231 240 235 230 244 241 240 237 241 237 237
				239 238 241 232 236 239 233 229 231 231 237 238 229 235 232 234 232 240 241 241 247 232 239 237 240 238 226 229 246 226 244 234
				238 237 238 239 238 237 235 234 232 238 234 232 240 233 231 235 234 234 231 234 237 241 243 229 236 239 235 237 232 232 232 239
				235 232 234 237 237 231 236 238 238 238 234 235 237 240 240 234 238 244 232 232 240 232 236 240 237 235 233 236 238 237 238 234
				239 232 234 231 243 243 236 235 241 238 237 237 231 237 233 237 235 238 236 232 238 238 235 232 235 231 232 240 235 232 231 243
				234 230 238 232 241 235 235 234 237 245 233 229 240 239 238 228 238 236 239 236 233 241 240 240 229 231 242 241 232 232 232 242
				231 234 238 235 238 240 238 237 230 240 238 237 231 237 238 235 234 234 237 234 242 234 235 236 237 240 233 231 238 234 236 235
				244 232 238 237 234 235 237 230 237 237 237 237 235 232 229 241 235 241 235 240 233 239 242 243 240 240 237 232 237 235 238 235
				229 240 240 237 232 235 243 244 231 230 238 240 234 235 235 237 235 238 240 240 244 234 234 238 235 234 231 237 237 239 233 239
				234 246 229 232 237 241 239 238 242 246 238 236 230 232 229 233 241 233 238 236 235 234 240 242 240 240 237 237 237 237 235 230
				243 231 236 231 235 238 242 237 242 238 236 232 233 241 238 237 235 237 231 233 241 244 226 232 234 237 244 243 235 244 235 236
				240 235 236 235 241 231 236 233 238 234 239 234 240 235 232 240 243 232 235 235 234 237 244 241 231 231 229 244 232 238 242 238
				242 237 234 231 232 233 238 237 236 236 235 236 240 232 233 237 234 238 237 237 234 240 241 229 234 235 231 231 240 237 230 228
				242 238 234 241 235 236 236 237 234 233 236 238 235 234 232 232 234 236 234 238 238 238 235 236 231 235 240 240 235 234 237 237
				240 237 236 234 233 236 240 235 237 235 235 237 235 235 233 240 231 240 238 237 243 240 234 237 235 233 239 240 240 240 234 232
				238 240 238 237 238 235 233 236 238 235 239 236 238 239 229 233 240 238 237 235 235 240 242 235 236 238 236 238 232 238 235 240
				240 235 245 246 232 235 235 235 234 232 238 235 228 232 239 240 232 242 235 238 238 238 242 234 236 238 234 235 240 238 239 240
				236 235 234 235 242 237 241 241 237 240 240 237 235 234 232 238 238 239 241 234 231 235 238 243 240 240 232 234 236 234 235 240
				235 240 237 235 236 235 239 241 236 235 231 237 238 237 232 237 232 234 231 232 239 235 237 236 234 235 236 242 234 234 232 231
				238 235 238 234 235 236 234 233 235 233 233 236 237 235 239 236 237 235 230 232 237 238 237 235 239 238 235 234 235 238 236 237
				241 234 236 235 235 240 234 240 244 238 240 236 228 239 232 233 242 236 234 240 234 235 234 238 243 235 234 235 235 235 237 234
				237 234 235 246 228 233 237 238 238 240 232 240 238 238 240 231 237 239 237 234 238 237 235 231 241 238 237 239 238 234 235 241
				232 232 239 240 238 236 237 241 239 237 237 240 238 231 241 232 235 243 233 232 231 234 236 233 237 240 236 238 238 229 229 237
				238 229 235 239 238 237 238 238 240 240 238 235 236 239 238 236 240 238 240 237 238 236 235 237 240 238 235 237 235 231 230 229
				238 236 240 235 235 235 237 241 235 237 238 238 235 246 244 244 237 235 236 241 235 232 233 237 238 238 234 234 231 237 233 233
				238 233 237 236 235 235 236 242 236 236 231 231 242 231 235 236 237 235 234 237 234 229 234 240 233 234 237 234 232 235 238 237
				235 237 238 237 234 232 237 234 236 239 232 244 240 227 238 234 242 240 235 242 241 232 232 228 238 234 235 233 232 238 244 231
				241 240 234 241 242 230 232 239 240 244 241 236 239 231 234 240 234 238 236 243 245 232 235 242 237 239 240 238 239 238 237 231
				239 233 235 239 244 234 239 237 231 233 229 241 234 237 239 237 236 232 239 233 235 242 237 235 235 231 232 241 237 238 242 236
				246 241 240 240 241 233 234 243 234 234 233 234 238 238 248 232 234 234 231 240 231 235 241 232 231 235 232 235 231 242 238 246
				234 241 240 238 240 237 240 234 246 241 238 238 236 231 245 238 238 240 238 232 231 234 240 240 234 234 239 238 237 235 235 242
				237 232 231 240 237 234 237 236 237 241 241 235 240 246 245 234 240 237 232 234 237 243 235 246 239 238 240 240 241 244 247 237
				246 240 229 244 237 237 237 235 242 240 242 238 240 238 235 239 242 238 234 245 240 237 239 237 235 236 238 238 232 239 234 237
				238 235 236 238 228 236 237 233 232 236 237 239 233 235 235 236 238 237 240 237 240 241 240 237 238 241 240 241 241 242 244 232
				230 240 235 240 237 235 238 235 231 231 231 236 234 237 238 241 235 237 230 244 230 235 238 238 234 231 231 234 235 237 233 236
				234 238 235 232 235 235 234 243 234 234 232 236 240 236 236 241 243 236 238 239 232 242 244 237 233 230 231 234 243 243 245 235
				240 240 240>;

			PS_Config_Lmt_FW_CC_P = <
				197 190 190 189 189 189 189 189 191 190 190 190 189 189 190 190 191 190 190 190 190 189 190 189 194 193 191 191 190 191 191 195
				198 193 194 193 194 194 194 194 193 193 191 191 190 190 190 191 195 194 195 194 195 195 195 195 194 193 193 193 191 191 193 197
				222 211 211 211 211 211 211 211 209 208 208 208 207 207 208 213 213 208 208 208 208 208 208 208 209 208 208 208 207 207 208 218
				211 207 207 207 207 207 208 208 208 208 207 207 205 205 205 207 208 207 207 207 207 207 207 208 208 207 207 207 205 207 207 209
				209 205 207 205 205 205 207 207 205 205 204 204 202 202 204 204 207 207 207 207 207 207 207 207 207 207 205 205 205 205 205 209
				211 207 208 208 208 208 208 208 211 211 209 209 209 209 209 209 211 211 211 211 211 211 211 211 209 209 208 208 208 207 207 211
				213 208 209 208 208 208 209 209 209 208 208 208 207 207 208 208 211 209 209 209 209 209 209 209 209 209 208 208 208 208 208 212
				208 204 205 205 205 205 205 205 208 208 208 208 207 207 207 208 205 204 205 205 205 205 207 207 207 205 205 205 204 205 204 208
				213 209 209 211 211 211 211 211 211 209 209 209 209 209 209 209 208 208 208 208 208 208 208 209 211 209 209 209 209 209 209 213
				212 207 207 207 208 208 208 208 209 209 208 208 208 208 208 208 208 208 208 208 208 208 209 209 208 209 208 208 208 208 208 212
				212 208 208 208 208 208 208 208 209 209 209 209 209 209 209 209 207 207 207 207 207 207 208 208 208 208 208 208 208 208 208 212
				216 212 212 212 212 212 213 213 209 209 209 208 208 208 208 208 211 211 211 211 211 211 212 212 209 211 209 209 209 209 209 212
				211 207 207 207 207 207 207 208 211 211 209 209 209 209 209 209 207 208 208 208 208 208 208 209 208 208 208 208 208 208 208 211
				213 211 211 211 211 211 211 212 211 211 209 209 209 209 209 209 209 209 209 209 209 211 211 211 209 209 209 208 208 208 208 211
				213 209 209 209 211 211 211 211 211 211 209 209 209 209 209 209 211 211 211 211 211 212 212 212 213 212 212 212 212 212 212 216
				211 208 208 208 208 208 209 209 209 209 208 208 208 208 208 208 207 207 207 207 208 208 208 208 209 209 209 209 208 209 209 212
				211 208 208 208 208 208 209 209 208 208 207 207 207 207 207 207 208 208 208 208 208 209 209 209 209 208 208 208 208 208 208 211
				213 211 211 211 211 212 212 212 213 212 212 212 211 211 211 211 209 209 211 211 211 212 212 212 212 212 212 211 211 211 211 213
				215 211 211 211 211 211 212 212 211 211 211 211 209 209 211 209 208 208 208 208 209 209 209 209 212 212 211 211 211 211 211 213
				212 209 209 209 209 209 209 209 211 209 209 209 208 209 208 208 208 208 208 208 209 209 209 209 209 209 209 209 208 208 208 211
				215 211 211 211 211 211 211 211 211 209 208 208 208 208 208 207 208 208 208 208 208 209 209 209 209 208 208 208 208 208 208 211
				213 211 211 211 211 211 211 212 213 213 212 212 212 212 212 211 211 211 212 211 212 212 212 212 211 211 211 211 211 211 211 213
				212 208 209 209 209 209 209 209 209 209 208 208 208 208 208 207 208 208 208 208 208 209 209 209 211 211 211 209 209 209 209 212
				215 212 213 212 213 213 213 213 209 209 209 209 209 209 209 208 211 212 212 212 213 213 213 213 212 212 212 211 211 211 211 213
				211 208 209 209 209 209 209 211 209 209 208 208 208 208 208 211 208 208 209 208 209 209 209 211 209 209 208 208 208 208 208 215
				218 209 211 211 211 211 212 212 211 211 209 209 209 209 208 207 213 211 211 211 211 212 212 212 212 213 212 212 212 212 211 213
				218 215 216 216 216 216 216 216 215 215 215 213 213 213 212 212 212 213 215 215 215 215 215 216 215 215 215 213 213 213 213 216
				213 211 212 212 212 212 212 212 212 212 211 211 211 211 209 208 208 208 209 209 209 211 211 211 211 211 211 211 209 209 208 211
				215 211 212 212 212 212 212 213 209 209 209 209 208 208 208 207 209 211 212 211 212 212 212 212 211 211 211 211 209 211 209 212
				216 212 213 215 215 215 216 216 213 213 213 213 212 212 212 211 212 212 213 213 213 215 215 215 213 213 213 213 212 212 212 213
				215 212 212 212 213 213 213 215 212 212 211 211 211 211 209 208 209 211 212 212 212 212 212 213 212 212 212 212 212 212 211 213
				213 211 212 212 212 213 213 213 213 212 212 212 212 212 211 209 211 212 212 213 213 213 213 213 212 212 211 211 211 211 208 211
				215 211 213 213 213 213 213 215 212 212 212 211 211 211 209 208 211 212 213 213 213 213 213 213 212 212 212 212 211 211 209 212
				215 212 213 213 213 215 215 215 213 213 213 212 212 212 211 209 212 213 215 215 215 215 216 216 212 212 212 212 212 211 209 212
				215 212 213 213 215 215 215 215 213 213 213 212 212 212 211 209 209 211 212 212 212 212 212 213 213 213 213 212 212 212 211 213
				216 213 215 215 216 216 216 216 212 212 212 211 211 211 209 208 211 212 213 215 215 215 216 216 213 213 213 212 212 212 211 213
				213 211 211 212 212 212 212 212 213 213 212 212 212 212 211 209 209 209 211 212 212 212 212 212 213 213 213 212 212 212 209 213
				215 212 212 213 213 213 213 213 215 215 215 213 213 213 212 211 209 211 212 213 213 213 213 213 213 213 213 212 212 212 211 213
				218 215 215 216 216 216 216 216 216 216 215 215 215 213 212 211 213 215 216 216 218 218 218 218 216 216 216 216 216 215 213 218
				213 211 212 212 213 213 213 213 213 213 213 213 212 212 209 208 209 211 212 212 213 213 213 213 212 212 212 212 212 211 209 212
				216 212 213 215 215 215 215 216 212 212 212 211 211 211 209 208 208 209 211 211 211 211 212 212 212 212 212 212 211 211 208 211
				218 215 216 216 218 218 218 218 216 216 216 216 216 215 212 212 212 213 215 216 216 216 216 218 218 218 218 218 218 216 215 218
				218 213 215 216 216 216 216 218 216 216 216 215 216 215 212 212 212 213 215 215 216 216 216 218 215 215 215 215 215 213 212 215
				215 212 213 213 215 215 215 215 215 215 213 213 213 212 211 211 212 213 215 215 215 216 216 216 216 216 216 216 215 213 213 215
				218 215 216 218 218 218 218 219 213 213 213 213 213 212 211 209 212 213 215 216 216 216 216 218 218 218 216 218 216 216 215 218
				218 215 216 218 218 218 218 219 218 218 218 218 218 215 213 212 212 213 215 216 216 216 218 218 216 216 216 216 216 215 213 218
				216 213 215 215 215 216 216 216 216 216 216 216 216 216 213 213 211 212 213 215 215 216 216 218 216 216 216 216 218 216 215 218
				224 215 216 218 218 218 218 219 218 218 216 216 216 215 213 218 220 215 216 218 218 218 218 219 218 218 218 218 216 216 215 223
				213 211 212 212 213 213 213 215 213 213 213 213 213 212 211 212 211 213 213 215 215 215 216 218 213 215 215 215 215 215 213 218
				216 213 213 215 215 215 216 219 215 215 215 215 215 213 212 215 211 212 213 215 216 216 216 220 213 213 213 213 213 213 212 216
				314 314 314>;

			PS_Config_Lmt_FW_CC_N = <
				88 85 85 84 84 84 84 84 86 85 85 85 84 84 85 85 86 85 85 85 85 84 85 84 87 86 86 86 85 86 86 88
				89 86 87 86 87 87 87 87 86 86 86 86 85 85 85 86 88 87 88 87 88 88 88 88 87 86 86 86 86 86 86 88
				99 94 94 94 94 94 94 94 94 93 93 93 93 93 93 96 96 93 93 93 93 93 93 93 94 93 93 93 93 93 93 97
				94 93 93 93 93 93 93 93 93 93 93 93 92 92 92 93 93 93 93 93 93 93 93 93 93 93 93 93 92 93 93 94
				94 92 93 92 92 92 93 93 92 92 91 91 91 91 91 91 93 93 93 93 93 93 93 93 93 93 92 92 92 92 92 94
				94 93 93 93 93 93 93 93 94 94 94 94 94 94 94 94 94 94 94 94 94 94 94 94 94 94 93 93 93 93 93 94
				96 93 94 93 93 93 94 94 94 93 93 93 93 93 93 93 94 94 94 94 94 94 94 94 94 94 93 93 93 93 93 95
				93 91 92 92 92 92 92 92 93 93 93 93 93 93 93 93 92 91 92 92 92 92 93 93 93 92 92 92 91 92 91 93
				96 94 94 94 94 94 94 94 94 94 94 94 94 94 94 94 93 93 93 93 93 93 93 94 94 94 94 94 94 94 94 96
				95 93 93 93 93 93 93 93 94 94 93 93 93 93 93 93 93 93 93 93 93 93 94 94 93 94 93 93 93 93 93 95
				95 93 93 93 93 93 93 93 94 94 94 94 94 94 94 94 93 93 93 93 93 93 93 93 93 93 93 93 93 93 93 95
				97 95 95 95 95 95 96 96 94 94 94 93 93 93 93 93 94 94 94 94 94 94 95 95 94 94 94 94 94 94 94 95
				94 93 93 93 93 93 93 93 94 94 94 94 94 94 94 94 93 93 93 93 93 93 93 94 93 93 93 93 93 93 93 94
				96 94 94 94 94 94 94 95 94 94 94 94 94 94 94 94 94 94 94 94 94 94 94 94 94 94 94 93 93 93 93 94
				96 94 94 94 94 94 94 94 94 94 94 94 94 94 94 94 94 94 94 94 94 95 95 95 96 95 95 95 95 95 95 97
				94 93 93 93 93 93 94 94 94 94 93 93 93 93 93 93 93 93 93 93 93 93 93 93 94 94 94 94 93 94 94 95
				94 93 93 93 93 93 94 94 93 93 93 93 93 93 93 93 93 93 93 93 93 94 94 94 94 93 93 93 93 93 93 94
				96 94 94 94 94 95 95 95 96 95 95 95 94 94 94 94 94 94 94 94 94 95 95 95 95 95 95 94 94 94 94 96
				96 94 94 94 94 94 95 95 94 94 94 94 94 94 94 94 93 93 93 93 94 94 94 94 95 95 94 94 94 94 94 96
				95 94 94 94 94 94 94 94 94 94 94 94 93 94 93 93 93 93 93 93 94 94 94 94 94 94 94 94 93 93 93 94
				96 94 94 94 94 94 94 94 94 94 93 93 93 93 93 93 93 93 93 93 93 94 94 94 94 93 93 93 93 93 93 94
				96 94 94 94 94 94 94 95 96 96 95 95 95 95 95 94 94 94 95 94 95 95 95 95 94 94 94 94 94 94 94 96
				95 93 94 94 94 94 94 94 94 94 93 93 93 93 93 93 93 93 93 93 93 94 94 94 94 94 94 94 94 94 94 95
				96 95 96 95 96 96 96 96 94 94 94 94 94 94 94 93 94 95 95 95 96 96 96 96 95 95 95 94 94 94 94 96
				94 93 94 94 94 94 94 94 94 94 93 93 93 93 93 94 93 93 94 93 94 94 94 94 94 94 93 93 93 93 93 96
				97 94 94 94 94 94 95 95 94 94 94 94 94 94 93 93 96 94 94 94 94 95 95 95 95 96 95 95 95 95 94 96
				97 96 97 97 97 97 97 97 96 96 96 96 96 96 95 95 95 96 96 96 96 96 96 97 96 96 96 96 96 96 96 97
				96 94 95 95 95 95 95 95 95 95 94 94 94 94 94 93 93 93 94 94 94 94 94 94 94 94 94 94 94 94 93 94
				96 94 95 95 95 95 95 96 94 94 94 94 93 93 93 93 94 94 95 94 95 95 95 95 94 94 94 94 94 94 94 95
				97 95 96 96 96 96 97 97 96 96 96 96 95 95 95 94 95 95 96 96 96 96 96 96 96 96 96 96 95 95 95 96
				96 95 95 95 96 96 96 96 95 95 94 94 94 94 94 93 94 94 95 95 95 95 95 96 95 95 95 95 95 95 94 96
				96 94 95 95 95 96 96 96 96 95 95 95 95 95 94 94 94 95 95 96 96 96 96 96 95 95 94 94 94 94 93 94
				96 94 96 96 96 96 96 96 95 95 95 94 94 94 94 93 94 95 96 96 96 96 96 96 95 95 95 95 94 94 94 95
				96 95 96 96 96 96 96 96 96 96 96 95 95 95 94 94 95 96 96 96 96 96 97 97 95 95 95 95 95 94 94 95
				96 95 96 96 96 96 96 96 96 96 96 95 95 95 94 94 94 94 95 95 95 95 95 96 96 96 96 95 95 95 94 96
				97 96 96 96 97 97 97 97 95 95 95 94 94 94 94 93 94 95 96 96 96 96 97 97 96 96 96 95 95 95 94 96
				96 94 94 95 95 95 95 95 96 96 95 95 95 95 94 94 94 94 94 95 95 95 95 95 96 96 96 95 95 95 94 96
				96 95 95 96 96 96 96 96 96 96 96 96 96 96 95 94 94 94 95 96 96 96 96 96 96 96 96 95 95 95 94 96
				97 96 96 97 97 97 97 97 97 97 96 96 96 96 95 94 96 96 97 97 97 97 97 97 97 97 97 97 97 96 96 97
				96 94 95 95 96 96 96 96 96 96 96 96 95 95 94 93 94 94 95 95 96 96 96 96 95 95 95 95 95 94 94 95
				97 95 96 96 96 96 96 97 95 95 95 94 94 94 94 93 93 94 94 94 94 94 95 95 95 95 95 95 94 94 93 94
				97 96 97 97 97 97 97 97 97 97 97 97 97 96 95 95 95 96 96 97 97 97 97 97 97 97 97 97 97 97 96 97
				97 96 96 97 97 97 97 97 97 97 97 96 97 96 95 95 95 96 96 96 97 97 97 97 96 96 96 96 96 96 95 96
				96 95 96 96 96 96 96 96 96 96 96 96 96 95 94 94 95 96 96 96 96 97 97 97 97 97 97 97 96 96 96 96
				97 96 97 97 97 97 97 98 96 96 96 96 96 95 94 94 95 96 96 97 97 97 97 97 97 97 97 97 97 97 96 97
				97 96 97 97 97 97 97 98 97 97 97 97 97 96 96 95 95 96 96 97 97 97 97 97 97 97 97 97 97 96 96 97
				97 96 96 96 96 97 97 97 97 97 97 97 97 97 96 96 94 95 96 96 96 97 97 97 97 97 97 97 97 97 96 97
				101 96 97 97 97 97 97 98 97 97 97 97 97 96 96 97 99 96 97 97 97 97 97 98 97 97 97 97 97 97 96 100
				96 94 95 95 96 96 96 96 96 96 96 96 96 95 94 95 94 96 96 96 96 96 97 97 96 96 96 96 96 96 96 97
				97 96 96 96 96 96 97 98 96 96 96 96 96 96 95 96 94 95 96 96 97 97 97 99 96 96 96 96 96 96 95 97
				0 0 0>;

			PS_Config_Lmt_FW_Diff_P = <
				50 50 50 50 50 50 50 50 50 50 50 50 50 50 50 50 50 50 50 50 50 50 50 50 50 50 50 50 50 50 50 50
				50 50 50 50 50 50 50 50 50 50 50 50 50 50 50 50 50 50 50 50 50 50 50 50 50 50 50 50 50 50 50 50
				50 50 50 50 50 50 50 50 50 50 50 50 50 50 50 50 50 50 50 50 50 50 50 50 50 50 50 50 50 50 50 50
				50 50 50 50 50 50 50 50 50 50 50 50 50 50 50 50 50 50 50 50 50 50 50 50 50 50 50 50 50 50 50 50
				50 50 50 50 50 50 50 50 50 50 50 50 50 50 50 50 50 50 50 50 50 50 50 50 50 50 50 50 50 50 50 50
				50 50 50 50 50 50 50 50 50 50 50 50 50 50 50 50 50 50 50 50 50 50 50 50 50 50 50 50 50 50 50 50
				50 50 50 50 50 50 50 50 50 50 50 50 50 50 50 50 50 50 50 50 50 50 50 50 50 50 50 50 50 50 50 50
				50 50 50 50 50 50 50 50 50 50 50 50 50 50 50 50 50 50 50 50 50 50 50 50 50 50 50 50 50 50 50 50
				50 50 50 50 50 50 50 50 50 50 50 50 50 50 50 50 50 50 50 50 50 50 50 50 50 50 50 50 50 50 50 50
				50 50 50 50 50 50 50 50 50 50 50 50 50 50 50 50 50 50 50 50 50 50 50 50 50 50 50 50 50 50 50 50
				50 50 50 50 50 50 50 50 50 50 50 50 50 50 50 50 50 50 50 50 50 50 50 50 50 50 50 50 50 50 50 50
				50 50 50 50 50 50 50 50 50 50 50 50 50 50 50 50 50 50 50 50 50 50 50 50 50 50 50 50 50 50 50 50
				50 50 50 50 50 50 50 50 50 50 50 50 50 50 50 50 50 50 50 50 50 50 50 50 50 50 50 50 50 50 50 50
				50 50 50 50 50 50 50 50 50 50 50 50 50 50 50 50 50 50 50 50 50 50 50 50 50 50 50 50 50 50 50 50
				50 50 50 50 50 50 50 50 50 50 50 50 50 50 50 50 50 50 50 50 50 50 50 50 50 50 50 50 50 50 50 50
				50 50 50 50 50 50 50 50 50 50 50 50 50 50 50 50 50 50 50 50 50 50 50 50 50 50 50 50 50 50 50 50
				50 50 50 50 50 50 50 50 50 50 50 50 50 50 50 50 50 50 50 50 50 50 50 50 50 50 50 50 50 50 50 50
				50 50 50 50 50 50 50 50 50 50 50 50 50 50 50 50 50 50 50 50 50 50 50 50 50 50 50 50 50 50 50 50
				50 50 50 50 50 50 50 50 50 50 50 50 50 50 50 50 50 50 50 50 50 50 50 50 50 50 50 50 50 50 50 50
				50 50 50 50 50 50 50 50 50 50 50 50 50 50 50 50 50 50 50 50 50 50 50 50 50 50 50 50 50 50 50 50
				50 50 50 50 50 50 50 50 50 50 50 50 50 50 50 50 50 50 50 50 50 50 50 50 50 50 50 50 50 50 50 50
				50 50 50 50 50 50 50 50 50 50 50 50 50 50 50 50 50 50 50 50 50 50 50 50 50 50 50 50 50 50 50 50
				50 50 50 50 50 50 50 50 50 50 50 50 50 50 50 50 50 50 50 50 50 50 50 50 50 50 50 50 50 50 50 50
				50 50 50 50 50 50 50 50 50 50 50 50 50 50 50 50 50 50 50 50 50 50 50 50 50 50 50 50 50 50 50 50
				50 50 50 50 50 50 50 50 50 50 50 50 50 50 50 50 50 50 50 50 50 50 50 50 50 50 50 50 50 50 50 50
				50 50 50 50 50 50 50 50 50 50 50 50 50 50 50 50 50 50 50 50 50 50 50 50 50 50 50 50 50 50 50 50
				50 50 50 50 50 50 50 50 50 50 50 50 50 50 50 50 50 50 50 50 50 50 50 50 50 50 50 50 50 50 50 50
				50 50 50 50 50 50 50 50 50 50 50 50 50 50 50 50 50 50 50 50 50 50 50 50 50 50 50 50 50 50 50 50
				50 50 50 50 50 50 50 50 50 50 50 50 50 50 50 50 50 50 50 50 50 50 50 50 50 50 50 50 50 50 50 50
				50 50 50 50 50 50 50 50 50 50 50 50 50 50 50 50 50 50 50 50 50 50 50 50 50 50 50 50 50 50 50 50
				50 50 50 50 50 50 50 50 50 50 50 50 50 50 50 50 50 50 50 50 50 50 50 50 50 50 50 50 50 50 50 50
				50 50 50 50 50 50 50 50 50 50 50 50 50 50 50 50 50 50 50 50 50 50 50 50 50 50 50 50 50 50 50 50
				50 50 50 50 50 50 50 50 50 50 50 50 50 50 50 50 50 50 50 50 50 50 50 50 50 50 50 50 50 50 50 50
				50 50 50 50 50 50 50 50 50 50 50 50 50 50 50 50 50 50 50 50 50 50 50 50 50 50 50 50 50 50 50 50
				50 50 50 50 50 50 50 50 50 50 50 50 50 50 50 50 50 50 50 50 50 50 50 50 50 50 50 50 50 50 50 50
				50 50 50 50 50 50 50 50 50 50 50 50 50 50 50 50 50 50 50 50 50 50 50 50 50 50 50 50 50 50 50 50
				50 50 50 50 50 50 50 50 50 50 50 50 50 50 50 50 50 50 50 50 50 50 50 50 50 50 50 50 50 50 50 50
				50 50 50 50 50 50 50 50 50 50 50 50 50 50 50 50 50 50 50 50 50 50 50 50 50 50 50 50 50 50 50 50
				50 50 50 50 50 50 50 50 50 50 50 50 50 50 50 50 50 50 50 50 50 50 50 50 50 50 50 50 50 50 50 50
				50 50 50 50 50 50 50 50 50 50 50 50 50 50 50 50 50 50 50 50 50 50 50 50 50 50 50 50 50 50 50 50
				50 50 50 50 50 50 50 50 50 50 50 50 50 50 50 50 50 50 50 50 50 50 50 50 50 50 50 50 50 50 50 50
				50 50 50 50 50 50 50 50 50 50 50 50 50 50 50 50 50 50 50 50 50 50 50 50 50 50 50 50 50 50 50 50
				50 50 50 50 50 50 50 50 50 50 50 50 50 50 50 50 50 50 50 50 50 50 50 50 50 50 50 50 50 50 50 50
				50 50 50 50 50 50 50 50 50 50 50 50 50 50 50 50 50 50 50 50 50 50 50 50 50 50 50 50 50 50 50 50
				50 50 50 50 50 50 50 50 50 50 50 50 50 50 50 50 50 50 50 50 50 50 50 50 50 50 50 50 50 50 50 50
				50 50 50 50 50 50 50 50 50 50 50 50 50 50 50 50 50 50 50 50 50 50 50 50 50 50 50 50 50 50 50 50
				50 50 50 50 50 50 50 50 50 50 50 50 50 50 50 50 50 50 50 50 50 50 50 50 50 50 50 50 50 50 50 50
				50 50 50 50 50 50 50 50 50 50 50 50 50 50 50 50 50 50 50 50 50 50 50 50 50 50 50 50 50 50 50 50
				50 50 50 50 50 50 50 50 50 50 50 50 50 50 50 50 50 50 50 50 50 50 50 50 50 50 50 50 50 50 50 50
				50 50 50 50 50 50 50 50 50 50 50 50 50 50 50 50 50 50 50 50 50 50 50 50 50 50 50 50 50 50 50 50
				75 75 75>;

			PS_Config_Lmt_FW_Diff_N = <
				(-50) (-50) (-50) (-50) (-50) (-50) (-50) (-50) (-50) (-50) (-50) (-50) (-50) (-50) (-50) (-50) (-50) (-50) (-50) (-50) (-50) (-50) (-50) (-50) (-50) (-50) (-50) (-50) (-50) (-50) (-50) (-50) (-50) (-50) (-50) (-50) (-50) (-50) (-50) (-50)
				(-50) (-50) (-50) (-50) (-50) (-50) (-50) (-50) (-50) (-50) (-50) (-50) (-50) (-50) (-50) (-50) (-50) (-50) (-50) (-50) (-50) (-50) (-50) (-50) (-50) (-50) (-50) (-50) (-50) (-50) (-50) (-50) (-50) (-50) (-50) (-50) (-50) (-50) (-50) (-50)
				(-50) (-50) (-50) (-50) (-50) (-50) (-50) (-50) (-50) (-50) (-50) (-50) (-50) (-50) (-50) (-50) (-50) (-50) (-50) (-50) (-50) (-50) (-50) (-50) (-50) (-50) (-50) (-50) (-50) (-50) (-50) (-50) (-50) (-50) (-50) (-50) (-50) (-50) (-50) (-50)
				(-50) (-50) (-50) (-50) (-50) (-50) (-50) (-50) (-50) (-50) (-50) (-50) (-50) (-50) (-50) (-50) (-50) (-50) (-50) (-50) (-50) (-50) (-50) (-50) (-50) (-50) (-50) (-50) (-50) (-50) (-50) (-50) (-50) (-50) (-50) (-50) (-50) (-50) (-50) (-50)
				(-50) (-50) (-50) (-50) (-50) (-50) (-50) (-50) (-50) (-50) (-50) (-50) (-50) (-50) (-50) (-50) (-50) (-50) (-50) (-50) (-50) (-50) (-50) (-50) (-50) (-50) (-50) (-50) (-50) (-50) (-50) (-50) (-50) (-50) (-50) (-50) (-50) (-50) (-50) (-50)
				(-50) (-50) (-50) (-50) (-50) (-50) (-50) (-50) (-50) (-50) (-50) (-50) (-50) (-50) (-50) (-50) (-50) (-50) (-50) (-50) (-50) (-50) (-50) (-50) (-50) (-50) (-50) (-50) (-50) (-50) (-50) (-50) (-50) (-50) (-50) (-50) (-50) (-50) (-50) (-50)
				(-50) (-50) (-50) (-50) (-50) (-50) (-50) (-50) (-50) (-50) (-50) (-50) (-50) (-50) (-50) (-50) (-50) (-50) (-50) (-50) (-50) (-50) (-50) (-50) (-50) (-50) (-50) (-50) (-50) (-50) (-50) (-50) (-50) (-50) (-50) (-50) (-50) (-50) (-50) (-50)
				(-50) (-50) (-50) (-50) (-50) (-50) (-50) (-50) (-50) (-50) (-50) (-50) (-50) (-50) (-50) (-50) (-50) (-50) (-50) (-50) (-50) (-50) (-50) (-50) (-50) (-50) (-50) (-50) (-50) (-50) (-50) (-50) (-50) (-50) (-50) (-50) (-50) (-50) (-50) (-50)
				(-50) (-50) (-50) (-50) (-50) (-50) (-50) (-50) (-50) (-50) (-50) (-50) (-50) (-50) (-50) (-50) (-50) (-50) (-50) (-50) (-50) (-50) (-50) (-50) (-50) (-50) (-50) (-50) (-50) (-50) (-50) (-50) (-50) (-50) (-50) (-50) (-50) (-50) (-50) (-50)
				(-50) (-50) (-50) (-50) (-50) (-50) (-50) (-50) (-50) (-50) (-50) (-50) (-50) (-50) (-50) (-50) (-50) (-50) (-50) (-50) (-50) (-50) (-50) (-50) (-50) (-50) (-50) (-50) (-50) (-50) (-50) (-50) (-50) (-50) (-50) (-50) (-50) (-50) (-50) (-50)
				(-50) (-50) (-50) (-50) (-50) (-50) (-50) (-50) (-50) (-50) (-50) (-50) (-50) (-50) (-50) (-50) (-50) (-50) (-50) (-50) (-50) (-50) (-50) (-50) (-50) (-50) (-50) (-50) (-50) (-50) (-50) (-50) (-50) (-50) (-50) (-50) (-50) (-50) (-50) (-50)
				(-50) (-50) (-50) (-50) (-50) (-50) (-50) (-50) (-50) (-50) (-50) (-50) (-50) (-50) (-50) (-50) (-50) (-50) (-50) (-50) (-50) (-50) (-50) (-50) (-50) (-50) (-50) (-50) (-50) (-50) (-50) (-50) (-50) (-50) (-50) (-50) (-50) (-50) (-50) (-50)
				(-50) (-50) (-50) (-50) (-50) (-50) (-50) (-50) (-50) (-50) (-50) (-50) (-50) (-50) (-50) (-50) (-50) (-50) (-50) (-50) (-50) (-50) (-50) (-50) (-50) (-50) (-50) (-50) (-50) (-50) (-50) (-50) (-50) (-50) (-50) (-50) (-50) (-50) (-50) (-50)
				(-50) (-50) (-50) (-50) (-50) (-50) (-50) (-50) (-50) (-50) (-50) (-50) (-50) (-50) (-50) (-50) (-50) (-50) (-50) (-50) (-50) (-50) (-50) (-50) (-50) (-50) (-50) (-50) (-50) (-50) (-50) (-50) (-50) (-50) (-50) (-50) (-50) (-50) (-50) (-50)
				(-50) (-50) (-50) (-50) (-50) (-50) (-50) (-50) (-50) (-50) (-50) (-50) (-50) (-50) (-50) (-50) (-50) (-50) (-50) (-50) (-50) (-50) (-50) (-50) (-50) (-50) (-50) (-50) (-50) (-50) (-50) (-50) (-50) (-50) (-50) (-50) (-50) (-50) (-50) (-50)
				(-50) (-50) (-50) (-50) (-50) (-50) (-50) (-50) (-50) (-50) (-50) (-50) (-50) (-50) (-50) (-50) (-50) (-50) (-50) (-50) (-50) (-50) (-50) (-50) (-50) (-50) (-50) (-50) (-50) (-50) (-50) (-50) (-50) (-50) (-50) (-50) (-50) (-50) (-50) (-50)
				(-50) (-50) (-50) (-50) (-50) (-50) (-50) (-50) (-50) (-50) (-50) (-50) (-50) (-50) (-50) (-50) (-50) (-50) (-50) (-50) (-50) (-50) (-50) (-50) (-50) (-50) (-50) (-50) (-50) (-50) (-50) (-50) (-50) (-50) (-50) (-50) (-50) (-50) (-50) (-50)
				(-50) (-50) (-50) (-50) (-50) (-50) (-50) (-50) (-50) (-50) (-50) (-50) (-50) (-50) (-50) (-50) (-50) (-50) (-50) (-50) (-50) (-50) (-50) (-50) (-50) (-50) (-50) (-50) (-50) (-50) (-50) (-50) (-50) (-50) (-50) (-50) (-50) (-50) (-50) (-50)
				(-50) (-50) (-50) (-50) (-50) (-50) (-50) (-50) (-50) (-50) (-50) (-50) (-50) (-50) (-50) (-50) (-50) (-50) (-50) (-50) (-50) (-50) (-50) (-50) (-50) (-50) (-50) (-50) (-50) (-50) (-50) (-50) (-50) (-50) (-50) (-50) (-50) (-50) (-50) (-50)
				(-50) (-50) (-50) (-50) (-50) (-50) (-50) (-50) (-50) (-50) (-50) (-50) (-50) (-50) (-50) (-50) (-50) (-50) (-50) (-50) (-50) (-50) (-50) (-50) (-50) (-50) (-50) (-50) (-50) (-50) (-50) (-50) (-50) (-50) (-50) (-50) (-50) (-50) (-50) (-50)
				(-50) (-50) (-50) (-50) (-50) (-50) (-50) (-50) (-50) (-50) (-50) (-50) (-50) (-50) (-50) (-50) (-50) (-50) (-50) (-50) (-50) (-50) (-50) (-50) (-50) (-50) (-50) (-50) (-50) (-50) (-50) (-50) (-50) (-50) (-50) (-50) (-50) (-50) (-50) (-50)
				(-50) (-50) (-50) (-50) (-50) (-50) (-50) (-50) (-50) (-50) (-50) (-50) (-50) (-50) (-50) (-50) (-50) (-50) (-50) (-50) (-50) (-50) (-50) (-50) (-50) (-50) (-50) (-50) (-50) (-50) (-50) (-50) (-50) (-50) (-50) (-50) (-50) (-50) (-50) (-50)
				(-50) (-50) (-50) (-50) (-50) (-50) (-50) (-50) (-50) (-50) (-50) (-50) (-50) (-50) (-50) (-50) (-50) (-50) (-50) (-50) (-50) (-50) (-50) (-50) (-50) (-50) (-50) (-50) (-50) (-50) (-50) (-50) (-50) (-50) (-50) (-50) (-50) (-50) (-50) (-50)
				(-50) (-50) (-50) (-50) (-50) (-50) (-50) (-50) (-50) (-50) (-50) (-50) (-50) (-50) (-50) (-50) (-50) (-50) (-50) (-50) (-50) (-50) (-50) (-50) (-50) (-50) (-50) (-50) (-50) (-50) (-50) (-50) (-50) (-50) (-50) (-50) (-50) (-50) (-50) (-50)
				(-50) (-50) (-50) (-50) (-50) (-50) (-50) (-50) (-50) (-50) (-50) (-50) (-50) (-50) (-50) (-50) (-50) (-50) (-50) (-50) (-50) (-50) (-50) (-50) (-50) (-50) (-50) (-50) (-50) (-50) (-50) (-50) (-50) (-50) (-50) (-50) (-50) (-50) (-50) (-50)
				(-50) (-50) (-50) (-50) (-50) (-50) (-50) (-50) (-50) (-50) (-50) (-50) (-50) (-50) (-50) (-50) (-50) (-50) (-50) (-50) (-50) (-50) (-50) (-50) (-50) (-50) (-50) (-50) (-50) (-50) (-50) (-50) (-50) (-50) (-50) (-50) (-50) (-50) (-50) (-50)
				(-50) (-50) (-50) (-50) (-50) (-50) (-50) (-50) (-50) (-50) (-50) (-50) (-50) (-50) (-50) (-50) (-50) (-50) (-50) (-50) (-50) (-50) (-50) (-50) (-50) (-50) (-50) (-50) (-50) (-50) (-50) (-50) (-50) (-50) (-50) (-50) (-50) (-50) (-50) (-50)
				(-50) (-50) (-50) (-50) (-50) (-50) (-50) (-50) (-50) (-50) (-50) (-50) (-50) (-50) (-50) (-50) (-50) (-50) (-50) (-50) (-50) (-50) (-50) (-50) (-50) (-50) (-50) (-50) (-50) (-50) (-50) (-50) (-50) (-50) (-50) (-50) (-50) (-50) (-50) (-50)
				(-50) (-50) (-50) (-50) (-50) (-50) (-50) (-50) (-50) (-50) (-50) (-50) (-50) (-50) (-50) (-50) (-50) (-50) (-50) (-50) (-50) (-50) (-50) (-50) (-50) (-50) (-50) (-50) (-50) (-50) (-50) (-50) (-50) (-50) (-50) (-50) (-50) (-50) (-50) (-50)
				(-50) (-50) (-50) (-50) (-50) (-50) (-50) (-50) (-50) (-50) (-50) (-50) (-50) (-50) (-50) (-50) (-50) (-50) (-50) (-50) (-50) (-50) (-50) (-50) (-50) (-50) (-50) (-50) (-50) (-50) (-50) (-50) (-50) (-50) (-50) (-50) (-50) (-50) (-50) (-50)
				(-50) (-50) (-50) (-50) (-50) (-50) (-50) (-50) (-50) (-50) (-50) (-50) (-50) (-50) (-50) (-50) (-50) (-50) (-50) (-50) (-50) (-50) (-50) (-50) (-50) (-50) (-50) (-50) (-50) (-50) (-50) (-50) (-50) (-50) (-50) (-50) (-50) (-50) (-50) (-50)
				(-50) (-50) (-50) (-50) (-50) (-50) (-50) (-50) (-50) (-50) (-50) (-50) (-50) (-50) (-50) (-50) (-50) (-50) (-50) (-50) (-50) (-50) (-50) (-50) (-50) (-50) (-50) (-50) (-50) (-50) (-50) (-50) (-50) (-50) (-50) (-50) (-50) (-50) (-50) (-50)
				(-50) (-50) (-50) (-50) (-50) (-50) (-50) (-50) (-50) (-50) (-50) (-50) (-50) (-50) (-50) (-50) (-50) (-50) (-50) (-50) (-50) (-50) (-50) (-50) (-50) (-50) (-50) (-50) (-50) (-50) (-50) (-50) (-50) (-50) (-50) (-50) (-50) (-50) (-50) (-50)
				(-50) (-50) (-50) (-50) (-50) (-50) (-50) (-50) (-50) (-50) (-50) (-50) (-50) (-50) (-50) (-50) (-50) (-50) (-50) (-50) (-50) (-50) (-50) (-50) (-50) (-50) (-50) (-50) (-50) (-50) (-50) (-50) (-50) (-50) (-50) (-50) (-50) (-50) (-50) (-50)
				(-50) (-50) (-50) (-50) (-50) (-50) (-50) (-50) (-50) (-50) (-50) (-50) (-50) (-50) (-50) (-50) (-50) (-50) (-50) (-50) (-50) (-50) (-50) (-50) (-50) (-50) (-50) (-50) (-50) (-50) (-50) (-50) (-50) (-50) (-50) (-50) (-50) (-50) (-50) (-50)
				(-50) (-50) (-50) (-50) (-50) (-50) (-50) (-50) (-50) (-50) (-50) (-50) (-50) (-50) (-50) (-50) (-50) (-50) (-50) (-50) (-50) (-50) (-50) (-50) (-50) (-50) (-50) (-50) (-50) (-50) (-50) (-50) (-50) (-50) (-50) (-50) (-50) (-50) (-50) (-50)
				(-50) (-50) (-50) (-50) (-50) (-50) (-50) (-50) (-50) (-50) (-50) (-50) (-50) (-50) (-50) (-50) (-50) (-50) (-50) (-50) (-50) (-50) (-50) (-50) (-50) (-50) (-50) (-50) (-50) (-50) (-50) (-50) (-50) (-50) (-50) (-50) (-50) (-50) (-50) (-50)
				(-50) (-50) (-50) (-50) (-50) (-50) (-50) (-50) (-50) (-50) (-50) (-50) (-50) (-50) (-50) (-50) (-50) (-50) (-50) (-50) (-50) (-50) (-50) (-50) (-50) (-50) (-50) (-50) (-50) (-50) (-50) (-50) (-50) (-50) (-50) (-50) (-50) (-50) (-50) (-50)
				(-50) (-50) (-50) (-50) (-50) (-50) (-50) (-50) (-50) (-50) (-50) (-50) (-50) (-50) (-50) (-50) (-50) (-50) (-50) (-50) (-50) (-50) (-50) (-50) (-50) (-50) (-50) (-50) (-50) (-50) (-50) (-50) (-50) (-50) (-50) (-50) (-50) (-50) (-50) (-50)
				(-50) (-50) (-50) (-50) (-50) (-50) (-50) (-50) (-50) (-50) (-50) (-50) (-50) (-50) (-50) (-50) (-50) (-50) (-50) (-50) (-50) (-50) (-50) (-50) (-50) (-50) (-50) (-50) (-50) (-50) (-50) (-50) (-50) (-50) (-50) (-50) (-50) (-50) (-50) (-50)
				(-50) (-50) (-50) (-50) (-50) (-50) (-50) (-50) (-50) (-50) (-50) (-50) (-50) (-50) (-50) (-50) (-50) (-50) (-50) (-50) (-50) (-50) (-50) (-50) (-50) (-50) (-50) (-50) (-50) (-50) (-50) (-50) (-50) (-50) (-50) (-50) (-50) (-50) (-50) (-50)
				(-50) (-50) (-50) (-50) (-50) (-50) (-50) (-50) (-50) (-50) (-50) (-50) (-50) (-50) (-50) (-50) (-50) (-50) (-50) (-50) (-50) (-50) (-50) (-50) (-50) (-50) (-50) (-50) (-50) (-50) (-50) (-50) (-50) (-50) (-50) (-50) (-50) (-50) (-50) (-50)
				(-50) (-50) (-50) (-50) (-50) (-50) (-50) (-50) (-50) (-50) (-50) (-50) (-50) (-50) (-50) (-50) (-50) (-50) (-50) (-50) (-50) (-50) (-50) (-50) (-50) (-50) (-50) (-50) (-50) (-50) (-50) (-50) (-50) (-50) (-50) (-50) (-50) (-50) (-50) (-50)
				(-50) (-50) (-50) (-50) (-50) (-50) (-50) (-50) (-50) (-50) (-50) (-50) (-50) (-50) (-50) (-50) (-50) (-50) (-50) (-50) (-50) (-50) (-50) (-50) (-50) (-50) (-50) (-50) (-50) (-50) (-50) (-50) (-50) (-50) (-50) (-50) (-50) (-50) (-50) (-50)
				(-50) (-50) (-50) (-50) (-50) (-50) (-50) (-50) (-50) (-50) (-50) (-50) (-50) (-50) (-50) (-50) (-50) (-50) (-50) (-50) (-50) (-50) (-50) (-50) (-50) (-50) (-50) (-50) (-50) (-50) (-50) (-50) (-50) (-50) (-50) (-50) (-50) (-50) (-50) (-50)
				(-50) (-50) (-50) (-50) (-50) (-50) (-50) (-50) (-50) (-50) (-50) (-50) (-50) (-50) (-50) (-50) (-50) (-50) (-50) (-50) (-50) (-50) (-50) (-50) (-50) (-50) (-50) (-50) (-50) (-50) (-50) (-50) (-50) (-50) (-50) (-50) (-50) (-50) (-50) (-50)
				(-50) (-50) (-50) (-50) (-50) (-50) (-50) (-50) (-50) (-50) (-50) (-50) (-50) (-50) (-50) (-50) (-50) (-50) (-50) (-50) (-50) (-50) (-50) (-50) (-50) (-50) (-50) (-50) (-50) (-50) (-50) (-50) (-50) (-50) (-50) (-50) (-50) (-50) (-50) (-50)
				(-50) (-50) (-50) (-50) (-50) (-50) (-50) (-50) (-50) (-50) (-50) (-50) (-50) (-50) (-50) (-50) (-50) (-50) (-50) (-50) (-50) (-50) (-50) (-50) (-50) (-50) (-50) (-50) (-50) (-50) (-50) (-50) (-50) (-50) (-50) (-50) (-50) (-50) (-50) (-50)
				(-50) (-50) (-50) (-50) (-50) (-50) (-50) (-50) (-50) (-50) (-50) (-50) (-50) (-50) (-50) (-50) (-50) (-50) (-50) (-50) (-50) (-50) (-50) (-50) (-50) (-50) (-50) (-50) (-50) (-50) (-50) (-50) (-50) (-50) (-50) (-50) (-50) (-50) (-50) (-50)
				(-50) (-50) (-50) (-50) (-50) (-50) (-50) (-50) (-50) (-50) (-50) (-50) (-50) (-50) (-50) (-50) (-50) (-50) (-50) (-50) (-50) (-50) (-50) (-50) (-50) (-50) (-50) (-50) (-50) (-50) (-50) (-50) (-50) (-50) (-50) (-50) (-50) (-50) (-50) (-50)
				(-50) (-50) (-50) (-50) (-50) (-50) (-50) (-50) (-50) (-50) (-50) (-50) (-50) (-50) (-50) (-50) (-50) (-50) (-50) (-50) (-50) (-50) (-50) (-50) (-50) (-50) (-50) (-50) (-50) (-50) (-50) (-50) (-50) (-50) (-50) (-50) (-50) (-50) (-50) (-50)
				(-50) (-50) (-50) (-50) (-50) (-50) (-50) (-50) (-50) (-50) (-50) (-50) (-50) (-50) (-50) (-50) (-50) (-50) (-50) (-50) (-50) (-50) (-50) (-50) (-50) (-50) (-50) (-50) (-50) (-50) (-50) (-50) (-50) (-50) (-50) (-50) (-50) (-50) (-50) (-50)
				(-50) (-50) (-50) (-50) (-50) (-50) (-50) (-50) (-50) (-50) (-50) (-50) (-50) (-50) (-50) (-50) (-50) (-50) (-50) (-50) (-50) (-50) (-50) (-50) (-50) (-50) (-50) (-50) (-50) (-50) (-50) (-50) (-50) (-50) (-50) (-50) (-50) (-50) (-50) (-50)
				(-50) (-50) (-50) (-50) (-50) (-50) (-50) (-50) (-50) (-50) (-50) (-50) (-50) (-50) (-50) (-50) (-50) (-50) (-50) (-50) (-50) (-50) (-50) (-50) (-50) (-50) (-50) (-50) (-50) (-50) (-50) (-50) (-50) (-50) (-50) (-50) (-50) (-50) (-50) (-50)
				(-50) (-50) (-50) (-50) (-50) (-50) (-50) (-50) (-50) (-50) (-50) (-50) (-50) (-50) (-50) (-50) (-50) (-50) (-50) (-50) (-50) (-50) (-50) (-50) (-50) (-50) (-50) (-50) (-50) (-50) (-50) (-50) (-50) (-50) (-50) (-50) (-50) (-50) (-50) (-50)
				(-50) (-50) (-50) (-50) (-50) (-50) (-50) (-50) (-50) (-50) (-50) (-50) (-50) (-50) (-50) (-50) (-50) (-50) (-50) (-50) (-50) (-50) (-50) (-50) (-50) (-50) (-50) (-50) (-50) (-50) (-50) (-50) (-50) (-50) (-50) (-50) (-50) (-50) (-50) (-50)
				(-50) (-50) (-50) (-50) (-50) (-50) (-50) (-50) (-50) (-50) (-50) (-50) (-50) (-50) (-50) (-50) (-50) (-50) (-50) (-50) (-50) (-50) (-50) (-50) (-50) (-50) (-50) (-50) (-50) (-50) (-50) (-50) (-50) (-50) (-50) (-50) (-50) (-50) (-50) (-50)
				(-50) (-50) (-50) (-50) (-50) (-50) (-50) (-50) (-50) (-50) (-50) (-50) (-50) (-50) (-50) (-50) (-50) (-50) (-50) (-50) (-50) (-50) (-50) (-50) (-50) (-50) (-50) (-50) (-50) (-50) (-50) (-50) (-50) (-50) (-50) (-50) (-50) (-50) (-50) (-50)
				(-50) (-50) (-50) (-50) (-50) (-50) (-50) (-50) (-50) (-50) (-50) (-50) (-50) (-50) (-50) (-50) (-50) (-50) (-50) (-50) (-50) (-50) (-50) (-50) (-50) (-50) (-50) (-50) (-50) (-50) (-50) (-50) (-50) (-50) (-50) (-50) (-50) (-50) (-50) (-50)
				(-50) (-50) (-50) (-50) (-50) (-50) (-50) (-50) (-50) (-50) (-50) (-50) (-50) (-50) (-50) (-50) (-50) (-50) (-50) (-50) (-50) (-50) (-50) (-50) (-50) (-50) (-50) (-50) (-50) (-50) (-50) (-50) (-50) (-50) (-50) (-50) (-50) (-50) (-50) (-50)
				(-50) (-50) (-50) (-50) (-50) (-50) (-50) (-50) (-50) (-50) (-50) (-50) (-50) (-50) (-50) (-50) (-50) (-50) (-50) (-50) (-50) (-50) (-50) (-50) (-50) (-50) (-50) (-50) (-50) (-50) (-50) (-50) (-50) (-50) (-50) (-50) (-50) (-50) (-50) (-50)
				(-50) (-50) (-50) (-50) (-50) (-50) (-50) (-50) (-50) (-50) (-50) (-50) (-50) (-50) (-50) (-50) (-50) (-50) (-50) (-50) (-50) (-50) (-50) (-50) (-50) (-50) (-50) (-50) (-50) (-50) (-50) (-50) (-50) (-50) (-50) (-50) (-50) (-50) (-50) (-50)
				(-50) (-50) (-50) (-50) (-50) (-50) (-50) (-50) (-50) (-50) (-50) (-50) (-50) (-50) (-50) (-50) (-50) (-50) (-50) (-50) (-50) (-50) (-50) (-50) (-50) (-50) (-50) (-50) (-50) (-50) (-50) (-50) (-50) (-50) (-50) (-50) (-50) (-50) (-50) (-50)
				(-50) (-50) (-50) (-50) (-50) (-50) (-50) (-50) (-50) (-50) (-50) (-50) (-50) (-50) (-50) (-50) (-50) (-50) (-50) (-50) (-50) (-50) (-50) (-50) (-50) (-50) (-50) (-50) (-50) (-50) (-50) (-50) (-50) (-50) (-50) (-50) (-50) (-50) (-50) (-50)
				(-75) (-75) (-75)>;

			PS_Config_Lmt_PenTipX_FW_Raw_P = <
				600 600 600 600 600 600 600 600 600 600 600 600 600 600 600 600 600 600 600 600 600 600 600 600 600 600 600 600 600 600 600 600 600 600 600 600 600 600 600 600
				600 600 600 600 600 600 600 600 600 600 600 600 600 600 600 600 600 600 600 600 600 600 600 600 600 600 600 600 600 600 600 600 600 600 600 600 600 600 600 600
				600 600 600 600 600 600 600 600 600 600 600 600 600 600 600 600 600 600 600 600 600 600 600 600 600 600 600 600 600 600 600 600 600 600 600 600 600 600 600 600
				600 600 600 600 600 600 600 600 600 600 600 600 600 600 600 600 600 600 600 600 600 600 600 600 600 600 600 600 600 600 600 600 600 600 600 600 600 600 600 600
				600 600 600 600 600 600 600 600 600 600 600 600 600 600 600 600 600 600 600 600 600 600 600 600 600 600 600 600 600 600 600 600 600 600 600 600 600 600 600 600
				600 600 600 600 600 600 600 600 600 600 600 600 600 600 600 600 600 600 600 600 600 600 600 600 600 600 600 600 600 600 600 600 600 600 600 600 600 600 600 600
				600 600 600 600 600 600 600 600 600 600 600 600 600 600 600 600 600 600 600 600 600 600 600 600 600 600 600 600 600 600 600 600 600 600 600 600 600 600 600 600
				600 600 600 600 600 600 600 600 600 600 600 600 600 600 600 600 600 600 600 600 600 600 600 600 600 600 600 600 600 600 600 600 600 600 600 600 600 600 600 600
				600 600 600 600 600 600 600 600 600 600 600 600 600 600 600 600 600 600 600 600 600 600 600 600 600 600 600 600 600 600 600 600 600 600 600 600 600 600 600 600
				600 600 600 600 600 600 600 600 600 600 600 600 600 600 600 600 600 600 600 600 600 600 600 600 600 600 600 600 600 600 600 600 600 600 600 600 600 600 600 600
				600 600 600 600 600 600 600 600 600 600 600 600 600 600 600 600 600 600 600 600 600 600 600 600 600 600 600 600 600 600 600 600 600 600 600 600 600 600 600 600
				600 600 600 600 600 600 600 600 600 600 600 600 600 600 600 600 600 600 600 600 600 600 600 600 600 600 600 600 600 600 600 600 600 600 600 600 600 600 600 600>;

			PS_Config_Lmt_PenTipX_FW_Raw_N = <
				0 0 0 0 0 0 0 0 0 0 0 0 0 0 0 0 0 0 0 0 0 0 0 0 0 0 0 0 0 0 0 0 0 0 0 0 0 0 0 0
				0 0 0 0 0 0 0 0 0 0 0 0 0 0 0 0 0 0 0 0 0 0 0 0 0 0 0 0 0 0 0 0 0 0 0 0 0 0 0 0
				0 0 0 0 0 0 0 0 0 0 0 0 0 0 0 0 0 0 0 0 0 0 0 0 0 0 0 0 0 0 0 0 0 0 0 0 0 0 0 0
				0 0 0 0 0 0 0 0 0 0 0 0 0 0 0 0 0 0 0 0 0 0 0 0 0 0 0 0 0 0 0 0 0 0 0 0 0 0 0 0
				0 0 0 0 0 0 0 0 0 0 0 0 0 0 0 0 0 0 0 0 0 0 0 0 0 0 0 0 0 0 0 0 0 0 0 0 0 0 0 0
				0 0 0 0 0 0 0 0 0 0 0 0 0 0 0 0 0 0 0 0 0 0 0 0 0 0 0 0 0 0 0 0 0 0 0 0 0 0 0 0
				0 0 0 0 0 0 0 0 0 0 0 0 0 0 0 0 0 0 0 0 0 0 0 0 0 0 0 0 0 0 0 0 0 0 0 0 0 0 0 0
				0 0 0 0 0 0 0 0 0 0 0 0 0 0 0 0 0 0 0 0 0 0 0 0 0 0 0 0 0 0 0 0 0 0 0 0 0 0 0 0
				0 0 0 0 0 0 0 0 0 0 0 0 0 0 0 0 0 0 0 0 0 0 0 0 0 0 0 0 0 0 0 0 0 0 0 0 0 0 0 0
				0 0 0 0 0 0 0 0 0 0 0 0 0 0 0 0 0 0 0 0 0 0 0 0 0 0 0 0 0 0 0 0 0 0 0 0 0 0 0 0
				0 0 0 0 0 0 0 0 0 0 0 0 0 0 0 0 0 0 0 0 0 0 0 0 0 0 0 0 0 0 0 0 0 0 0 0 0 0 0 0
				0 0 0 0 0 0 0 0 0 0 0 0 0 0 0 0 0 0 0 0 0 0 0 0 0 0 0 0 0 0 0 0 0 0 0 0 0 0 0 0>;

			PS_Config_Lmt_PenTipY_FW_Raw_P = <
				600 600 600 600 600 600 600 600
				600 600 600 600 600 600 600 600
				600 600 600 600 600 600 600 600
				600 600 600 600 600 600 600 600
				600 600 600 600 600 600 600 600
				600 600 600 600 600 600 600 600
				600 600 600 600 600 600 600 600
				600 600 600 600 600 600 600 600
				600 600 600 600 600 600 600 600
				600 600 600 600 600 600 600 600
				600 600 600 600 600 600 600 600
				600 600 600 600 600 600 600 600
				600 600 600 600 600 600 600 600
				600 600 600 600 600 600 600 600
				600 600 600 600 600 600 600 600
				600 600 600 600 600 600 600 600
				600 600 600 600 600 600 600 600
				600 600 600 600 600 600 600 600
				600 600 600 600 600 600 600 600
				600 600 600 600 600 600 600 600
				600 600 600 600 600 600 600 600
				600 600 600 600 600 600 600 600
				600 600 600 600 600 600 600 600
				600 600 600 600 600 600 600 600
				600 600 600 600 600 600 600 600
				600 600 600 600 600 600 600 600
				600 600 600 600 600 600 600 600
				600 600 600 600 600 600 600 600
				600 600 600 600 600 600 600 600
				600 600 600 600 600 600 600 600
				600 600 600 600 600 600 600 600
				600 600 600 600 600 600 600 600
				600 600 600 600 600 600 600 600
				600 600 600 600 600 600 600 600
				600 600 600 600 600 600 600 600
				600 600 600 600 600 600 600 600
				600 600 600 600 600 600 600 600
				600 600 600 600 600 600 600 600
				600 600 600 600 600 600 600 600
				600 600 600 600 600 600 600 600
				600 600 600 600 600 600 600 600
				600 600 600 600 600 600 600 600
				600 600 600 600 600 600 600 600
				600 600 600 600 600 600 600 600
				600 600 600 600 600 600 600 600
				600 600 600 600 600 600 600 600
				600 600 600 600 600 600 600 600
				600 600 600 600 600 600 600 600
				600 600 600 600 600 600 600 600
				600 600 600 600 600 600 600 600
				600 600 600 600 600 600 600 600
				600 600 600 600 600 600 600 600
				600 600 600 600 600 600 600 600
				600 600 600 600 600 600 600 600
				600 600 600 600 600 600 600 600
				600 600 600 600 600 600 600 600
				600 600 600 600 600 600 600 600
				600 600 600 600 600 600 600 600
				600 600 600 600 600 600 600 600
				600 600 600 600 600 600 600 600
				600 600 600 600 600 600 600 600
				600 600 600 600 600 600 600 600
				600 600 600 600 600 600 600 600
				600 600 600 600 600 600 600 600>;

			PS_Config_Lmt_PenTipY_FW_Raw_N = <
				0 0 0 0 0 0 0 0
				0 0 0 0 0 0 0 0
				0 0 0 0 0 0 0 0
				0 0 0 0 0 0 0 0
				0 0 0 0 0 0 0 0
				0 0 0 0 0 0 0 0
				0 0 0 0 0 0 0 0
				0 0 0 0 0 0 0 0
				0 0 0 0 0 0 0 0
				0 0 0 0 0 0 0 0
				0 0 0 0 0 0 0 0
				0 0 0 0 0 0 0 0
				0 0 0 0 0 0 0 0
				0 0 0 0 0 0 0 0
				0 0 0 0 0 0 0 0
				0 0 0 0 0 0 0 0
				0 0 0 0 0 0 0 0
				0 0 0 0 0 0 0 0
				0 0 0 0 0 0 0 0
				0 0 0 0 0 0 0 0
				0 0 0 0 0 0 0 0
				0 0 0 0 0 0 0 0
				0 0 0 0 0 0 0 0
				0 0 0 0 0 0 0 0
				0 0 0 0 0 0 0 0
				0 0 0 0 0 0 0 0
				0 0 0 0 0 0 0 0
				0 0 0 0 0 0 0 0
				0 0 0 0 0 0 0 0
				0 0 0 0 0 0 0 0
				0 0 0 0 0 0 0 0
				0 0 0 0 0 0 0 0
				0 0 0 0 0 0 0 0
				0 0 0 0 0 0 0 0
				0 0 0 0 0 0 0 0
				0 0 0 0 0 0 0 0
				0 0 0 0 0 0 0 0
				0 0 0 0 0 0 0 0
				0 0 0 0 0 0 0 0
				0 0 0 0 0 0 0 0
				0 0 0 0 0 0 0 0
				0 0 0 0 0 0 0 0
				0 0 0 0 0 0 0 0
				0 0 0 0 0 0 0 0
				0 0 0 0 0 0 0 0
				0 0 0 0 0 0 0 0
				0 0 0 0 0 0 0 0
				0 0 0 0 0 0 0 0
				0 0 0 0 0 0 0 0
				0 0 0 0 0 0 0 0
				0 0 0 0 0 0 0 0
				0 0 0 0 0 0 0 0
				0 0 0 0 0 0 0 0
				0 0 0 0 0 0 0 0
				0 0 0 0 0 0 0 0
				0 0 0 0 0 0 0 0
				0 0 0 0 0 0 0 0
				0 0 0 0 0 0 0 0
				0 0 0 0 0 0 0 0
				0 0 0 0 0 0 0 0
				0 0 0 0 0 0 0 0
				0 0 0 0 0 0 0 0
				0 0 0 0 0 0 0 0
				0 0 0 0 0 0 0 0>;

			PS_Config_Lmt_PenRingX_FW_Raw_P = <
				600 600 600 600 600 600 600 600 600 600 600 600 600 600 600 600 600 600 600 600 600 600 600 600 600 600 600 600 600 600 600 600 600 600 600 600 600 600 600 600
				600 600 600 600 600 600 600 600 600 600 600 600 600 600 600 600 600 600 600 600 600 600 600 600 600 600 600 600 600 600 600 600 600 600 600 600 600 600 600 600
				600 600 600 600 600 600 600 600 600 600 600 600 600 600 600 600 600 600 600 600 600 600 600 600 600 600 600 600 600 600 600 600 600 600 600 600 600 600 600 600
				600 600 600 600 600 600 600 600 600 600 600 600 600 600 600 600 600 600 600 600 600 600 600 600 600 600 600 600 600 600 600 600 600 600 600 600 600 600 600 600
				600 600 600 600 600 600 600 600 600 600 600 600 600 600 600 600 600 600 600 600 600 600 600 600 600 600 600 600 600 600 600 600 600 600 600 600 600 600 600 600
				600 600 600 600 600 600 600 600 600 600 600 600 600 600 600 600 600 600 600 600 600 600 600 600 600 600 600 600 600 600 600 600 600 600 600 600 600 600 600 600
				600 600 600 600 600 600 600 600 600 600 600 600 600 600 600 600 600 600 600 600 600 600 600 600 600 600 600 600 600 600 600 600 600 600 600 600 600 600 600 600
				600 600 600 600 600 600 600 600 600 600 600 600 600 600 600 600 600 600 600 600 600 600 600 600 600 600 600 600 600 600 600 600 600 600 600 600 600 600 600 600
				600 600 600 600 600 600 600 600 600 600 600 600 600 600 600 600 600 600 600 600 600 600 600 600 600 600 600 600 600 600 600 600 600 600 600 600 600 600 600 600
				600 600 600 600 600 600 600 600 600 600 600 600 600 600 600 600 600 600 600 600 600 600 600 600 600 600 600 600 600 600 600 600 600 600 600 600 600 600 600 600
				600 600 600 600 600 600 600 600 600 600 600 600 600 600 600 600 600 600 600 600 600 600 600 600 600 600 600 600 600 600 600 600 600 600 600 600 600 600 600 600
				600 600 600 600 600 600 600 600 600 600 600 600 600 600 600 600 600 600 600 600 600 600 600 600 600 600 600 600 600 600 600 600 600 600 600 600 600 600 600 600>;

			PS_Config_Lmt_PenRingX_FW_Raw_N = <
				0 0 0 0 0 0 0 0 0 0 0 0 0 0 0 0 0 0 0 0 0 0 0 0 0 0 0 0 0 0 0 0 0 0 0 0 0 0 0 0
				0 0 0 0 0 0 0 0 0 0 0 0 0 0 0 0 0 0 0 0 0 0 0 0 0 0 0 0 0 0 0 0 0 0 0 0 0 0 0 0
				0 0 0 0 0 0 0 0 0 0 0 0 0 0 0 0 0 0 0 0 0 0 0 0 0 0 0 0 0 0 0 0 0 0 0 0 0 0 0 0
				0 0 0 0 0 0 0 0 0 0 0 0 0 0 0 0 0 0 0 0 0 0 0 0 0 0 0 0 0 0 0 0 0 0 0 0 0 0 0 0
				0 0 0 0 0 0 0 0 0 0 0 0 0 0 0 0 0 0 0 0 0 0 0 0 0 0 0 0 0 0 0 0 0 0 0 0 0 0 0 0
				0 0 0 0 0 0 0 0 0 0 0 0 0 0 0 0 0 0 0 0 0 0 0 0 0 0 0 0 0 0 0 0 0 0 0 0 0 0 0 0
				0 0 0 0 0 0 0 0 0 0 0 0 0 0 0 0 0 0 0 0 0 0 0 0 0 0 0 0 0 0 0 0 0 0 0 0 0 0 0 0
				0 0 0 0 0 0 0 0 0 0 0 0 0 0 0 0 0 0 0 0 0 0 0 0 0 0 0 0 0 0 0 0 0 0 0 0 0 0 0 0
				0 0 0 0 0 0 0 0 0 0 0 0 0 0 0 0 0 0 0 0 0 0 0 0 0 0 0 0 0 0 0 0 0 0 0 0 0 0 0 0
				0 0 0 0 0 0 0 0 0 0 0 0 0 0 0 0 0 0 0 0 0 0 0 0 0 0 0 0 0 0 0 0 0 0 0 0 0 0 0 0
				0 0 0 0 0 0 0 0 0 0 0 0 0 0 0 0 0 0 0 0 0 0 0 0 0 0 0 0 0 0 0 0 0 0 0 0 0 0 0 0
				0 0 0 0 0 0 0 0 0 0 0 0 0 0 0 0 0 0 0 0 0 0 0 0 0 0 0 0 0 0 0 0 0 0 0 0 0 0 0 0>;

			PS_Config_Lmt_PenRingY_FW_Raw_P = <
				600 600 600 600 600 600 600 600
				600 600 600 600 600 600 600 600
				600 600 600 600 600 600 600 600
				600 600 600 600 600 600 600 600
				600 600 600 600 600 600 600 600
				600 600 600 600 600 600 600 600
				600 600 600 600 600 600 600 600
				600 600 600 600 600 600 600 600
				600 600 600 600 600 600 600 600
				600 600 600 600 600 600 600 600
				600 600 600 600 600 600 600 600
				600 600 600 600 600 600 600 600
				600 600 600 600 600 600 600 600
				600 600 600 600 600 600 600 600
				600 600 600 600 600 600 600 600
				600 600 600 600 600 600 600 600
				600 600 600 600 600 600 600 600
				600 600 600 600 600 600 600 600
				600 600 600 600 600 600 600 600
				600 600 600 600 600 600 600 600
				600 600 600 600 600 600 600 600
				600 600 600 600 600 600 600 600
				600 600 600 600 600 600 600 600
				600 600 600 600 600 600 600 600
				600 600 600 600 600 600 600 600
				600 600 600 600 600 600 600 600
				600 600 600 600 600 600 600 600
				600 600 600 600 600 600 600 600
				600 600 600 600 600 600 600 600
				600 600 600 600 600 600 600 600
				600 600 600 600 600 600 600 600
				600 600 600 600 600 600 600 600
				600 600 600 600 600 600 600 600
				600 600 600 600 600 600 600 600
				600 600 600 600 600 600 600 600
				600 600 600 600 600 600 600 600
				600 600 600 600 600 600 600 600
				600 600 600 600 600 600 600 600
				600 600 600 600 600 600 600 600
				600 600 600 600 600 600 600 600
				600 600 600 600 600 600 600 600
				600 600 600 600 600 600 600 600
				600 600 600 600 600 600 600 600
				600 600 600 600 600 600 600 600
				600 600 600 600 600 600 600 600
				600 600 600 600 600 600 600 600
				600 600 600 600 600 600 600 600
				600 600 600 600 600 600 600 600
				600 600 600 600 600 600 600 600
				600 600 600 600 600 600 600 600
				600 600 600 600 600 600 600 600
				600 600 600 600 600 600 600 600
				600 600 600 600 600 600 600 600
				600 600 600 600 600 600 600 600
				600 600 600 600 600 600 600 600
				600 600 600 600 600 600 600 600
				600 600 600 600 600 600 600 600
				600 600 600 600 600 600 600 600
				600 600 600 600 600 600 600 600
				600 600 600 600 600 600 600 600
				600 600 600 600 600 600 600 600
				600 600 600 600 600 600 600 600
				600 600 600 600 600 600 600 600
				600 600 600 600 600 600 600 600>;

			PS_Config_Lmt_PenRingY_FW_Raw_N = <
				0 0 0 0 0 0 0 0
				0 0 0 0 0 0 0 0
				0 0 0 0 0 0 0 0
				0 0 0 0 0 0 0 0
				0 0 0 0 0 0 0 0
				0 0 0 0 0 0 0 0
				0 0 0 0 0 0 0 0
				0 0 0 0 0 0 0 0
				0 0 0 0 0 0 0 0
				0 0 0 0 0 0 0 0
				0 0 0 0 0 0 0 0
				0 0 0 0 0 0 0 0
				0 0 0 0 0 0 0 0
				0 0 0 0 0 0 0 0
				0 0 0 0 0 0 0 0
				0 0 0 0 0 0 0 0
				0 0 0 0 0 0 0 0
				0 0 0 0 0 0 0 0
				0 0 0 0 0 0 0 0
				0 0 0 0 0 0 0 0
				0 0 0 0 0 0 0 0
				0 0 0 0 0 0 0 0
				0 0 0 0 0 0 0 0
				0 0 0 0 0 0 0 0
				0 0 0 0 0 0 0 0
				0 0 0 0 0 0 0 0
				0 0 0 0 0 0 0 0
				0 0 0 0 0 0 0 0
				0 0 0 0 0 0 0 0
				0 0 0 0 0 0 0 0
				0 0 0 0 0 0 0 0
				0 0 0 0 0 0 0 0
				0 0 0 0 0 0 0 0
				0 0 0 0 0 0 0 0
				0 0 0 0 0 0 0 0
				0 0 0 0 0 0 0 0
				0 0 0 0 0 0 0 0
				0 0 0 0 0 0 0 0
				0 0 0 0 0 0 0 0
				0 0 0 0 0 0 0 0
				0 0 0 0 0 0 0 0
				0 0 0 0 0 0 0 0
				0 0 0 0 0 0 0 0
				0 0 0 0 0 0 0 0
				0 0 0 0 0 0 0 0
				0 0 0 0 0 0 0 0
				0 0 0 0 0 0 0 0
				0 0 0 0 0 0 0 0
				0 0 0 0 0 0 0 0
				0 0 0 0 0 0 0 0
				0 0 0 0 0 0 0 0
				0 0 0 0 0 0 0 0
				0 0 0 0 0 0 0 0
				0 0 0 0 0 0 0 0
				0 0 0 0 0 0 0 0
				0 0 0 0 0 0 0 0
				0 0 0 0 0 0 0 0
				0 0 0 0 0 0 0 0
				0 0 0 0 0 0 0 0
				0 0 0 0 0 0 0 0
				0 0 0 0 0 0 0 0
				0 0 0 0 0 0 0 0
				0 0 0 0 0 0 0 0
				0 0 0 0 0 0 0 0>;

			PS_Config_Lmt_PenTipX_FW_Diff_P = <
				600 600 600 600 600 600 600 600 600 600 600 600 600 600 600 600 600 600 600 600 600 600 600 600 600 600 600 600 600 600 600 600 600 600 600 600 600 600 600 600
				600 600 600 600 600 600 600 600 600 600 600 600 600 600 600 600 600 600 600 600 600 600 600 600 600 600 600 600 600 600 600 600 600 600 600 600 600 600 600 600
				600 600 600 600 600 600 600 600 600 600 600 600 600 600 600 600 600 600 600 600 600 600 600 600 600 600 600 600 600 600 600 600 600 600 600 600 600 600 600 600
				600 600 600 600 600 600 600 600 600 600 600 600 600 600 600 600 600 600 600 600 600 600 600 600 600 600 600 600 600 600 600 600 600 600 600 600 600 600 600 600
				600 600 600 600 600 600 600 600 600 600 600 600 600 600 600 600 600 600 600 600 600 600 600 600 600 600 600 600 600 600 600 600 600 600 600 600 600 600 600 600
				600 600 600 600 600 600 600 600 600 600 600 600 600 600 600 600 600 600 600 600 600 600 600 600 600 600 600 600 600 600 600 600 600 600 600 600 600 600 600 600
				600 600 600 600 600 600 600 600 600 600 600 600 600 600 600 600 600 600 600 600 600 600 600 600 600 600 600 600 600 600 600 600 600 600 600 600 600 600 600 600
				600 600 600 600 600 600 600 600 600 600 600 600 600 600 600 600 600 600 600 600 600 600 600 600 600 600 600 600 600 600 600 600 600 600 600 600 600 600 600 600
				600 600 600 600 600 600 600 600 600 600 600 600 600 600 600 600 600 600 600 600 600 600 600 600 600 600 600 600 600 600 600 600 600 600 600 600 600 600 600 600
				600 600 600 600 600 600 600 600 600 600 600 600 600 600 600 600 600 600 600 600 600 600 600 600 600 600 600 600 600 600 600 600 600 600 600 600 600 600 600 600
				600 600 600 600 600 600 600 600 600 600 600 600 600 600 600 600 600 600 600 600 600 600 600 600 600 600 600 600 600 600 600 600 600 600 600 600 600 600 600 600
				600 600 600 600 600 600 600 600 600 600 600 600 600 600 600 600 600 600 600 600 600 600 600 600 600 600 600 600 600 600 600 600 600 600 600 600 600 600 600 600>;

			PS_Config_Lmt_PenTipX_FW_Diff_N = <
				(-600) (-600) (-600) (-600) (-600) (-600) (-600) (-600) (-600) (-600) (-600) (-600) (-600) (-600) (-600) (-600) (-600) (-600) (-600) (-600) (-600) (-600) (-600) (-600) (-600) (-600) (-600) (-600) (-600) (-600) (-600) (-600) (-600) (-600) (-600) (-600) (-600) (-600) (-600) (-600)
				(-600) (-600) (-600) (-600) (-600) (-600) (-600) (-600) (-600) (-600) (-600) (-600) (-600) (-600) (-600) (-600) (-600) (-600) (-600) (-600) (-600) (-600) (-600) (-600) (-600) (-600) (-600) (-600) (-600) (-600) (-600) (-600) (-600) (-600) (-600) (-600) (-600) (-600) (-600) (-600)
				(-600) (-600) (-600) (-600) (-600) (-600) (-600) (-600) (-600) (-600) (-600) (-600) (-600) (-600) (-600) (-600) (-600) (-600) (-600) (-600) (-600) (-600) (-600) (-600) (-600) (-600) (-600) (-600) (-600) (-600) (-600) (-600) (-600) (-600) (-600) (-600) (-600) (-600) (-600) (-600)
				(-600) (-600) (-600) (-600) (-600) (-600) (-600) (-600) (-600) (-600) (-600) (-600) (-600) (-600) (-600) (-600) (-600) (-600) (-600) (-600) (-600) (-600) (-600) (-600) (-600) (-600) (-600) (-600) (-600) (-600) (-600) (-600) (-600) (-600) (-600) (-600) (-600) (-600) (-600) (-600)
				(-600) (-600) (-600) (-600) (-600) (-600) (-600) (-600) (-600) (-600) (-600) (-600) (-600) (-600) (-600) (-600) (-600) (-600) (-600) (-600) (-600) (-600) (-600) (-600) (-600) (-600) (-600) (-600) (-600) (-600) (-600) (-600) (-600) (-600) (-600) (-600) (-600) (-600) (-600) (-600)
				(-600) (-600) (-600) (-600) (-600) (-600) (-600) (-600) (-600) (-600) (-600) (-600) (-600) (-600) (-600) (-600) (-600) (-600) (-600) (-600) (-600) (-600) (-600) (-600) (-600) (-600) (-600) (-600) (-600) (-600) (-600) (-600) (-600) (-600) (-600) (-600) (-600) (-600) (-600) (-600)
				(-600) (-600) (-600) (-600) (-600) (-600) (-600) (-600) (-600) (-600) (-600) (-600) (-600) (-600) (-600) (-600) (-600) (-600) (-600) (-600) (-600) (-600) (-600) (-600) (-600) (-600) (-600) (-600) (-600) (-600) (-600) (-600) (-600) (-600) (-600) (-600) (-600) (-600) (-600) (-600)
				(-600) (-600) (-600) (-600) (-600) (-600) (-600) (-600) (-600) (-600) (-600) (-600) (-600) (-600) (-600) (-600) (-600) (-600) (-600) (-600) (-600) (-600) (-600) (-600) (-600) (-600) (-600) (-600) (-600) (-600) (-600) (-600) (-600) (-600) (-600) (-600) (-600) (-600) (-600) (-600)
				(-600) (-600) (-600) (-600) (-600) (-600) (-600) (-600) (-600) (-600) (-600) (-600) (-600) (-600) (-600) (-600) (-600) (-600) (-600) (-600) (-600) (-600) (-600) (-600) (-600) (-600) (-600) (-600) (-600) (-600) (-600) (-600) (-600) (-600) (-600) (-600) (-600) (-600) (-600) (-600)
				(-600) (-600) (-600) (-600) (-600) (-600) (-600) (-600) (-600) (-600) (-600) (-600) (-600) (-600) (-600) (-600) (-600) (-600) (-600) (-600) (-600) (-600) (-600) (-600) (-600) (-600) (-600) (-600) (-600) (-600) (-600) (-600) (-600) (-600) (-600) (-600) (-600) (-600) (-600) (-600)
				(-600) (-600) (-600) (-600) (-600) (-600) (-600) (-600) (-600) (-600) (-600) (-600) (-600) (-600) (-600) (-600) (-600) (-600) (-600) (-600) (-600) (-600) (-600) (-600) (-600) (-600) (-600) (-600) (-600) (-600) (-600) (-600) (-600) (-600) (-600) (-600) (-600) (-600) (-600) (-600)
				(-600) (-600) (-600) (-600) (-600) (-600) (-600) (-600) (-600) (-600) (-600) (-600) (-600) (-600) (-600) (-600) (-600) (-600) (-600) (-600) (-600) (-600) (-600) (-600) (-600) (-600) (-600) (-600) (-600) (-600) (-600) (-600) (-600) (-600) (-600) (-600) (-600) (-600) (-600) (-600)>;

			PS_Config_Lmt_PenTipY_FW_Diff_P = <
				600 600 600 600 600 600 600 600
				600 600 600 600 600 600 600 600
				600 600 600 600 600 600 600 600
				600 600 600 600 600 600 600 600
				600 600 600 600 600 600 600 600
				600 600 600 600 600 600 600 600
				600 600 600 600 600 600 600 600
				600 600 600 600 600 600 600 600
				600 600 600 600 600 600 600 600
				600 600 600 600 600 600 600 600
				600 600 600 600 600 600 600 600
				600 600 600 600 600 600 600 600
				600 600 600 600 600 600 600 600
				600 600 600 600 600 600 600 600
				600 600 600 600 600 600 600 600
				600 600 600 600 600 600 600 600
				600 600 600 600 600 600 600 600
				600 600 600 600 600 600 600 600
				600 600 600 600 600 600 600 600
				600 600 600 600 600 600 600 600
				600 600 600 600 600 600 600 600
				600 600 600 600 600 600 600 600
				600 600 600 600 600 600 600 600
				600 600 600 600 600 600 600 600
				600 600 600 600 600 600 600 600
				600 600 600 600 600 600 600 600
				600 600 600 600 600 600 600 600
				600 600 600 600 600 600 600 600
				600 600 600 600 600 600 600 600
				600 600 600 600 600 600 600 600
				600 600 600 600 600 600 600 600
				600 600 600 600 600 600 600 600
				600 600 600 600 600 600 600 600
				600 600 600 600 600 600 600 600
				600 600 600 600 600 600 600 600
				600 600 600 600 600 600 600 600
				600 600 600 600 600 600 600 600
				600 600 600 600 600 600 600 600
				600 600 600 600 600 600 600 600
				600 600 600 600 600 600 600 600
				600 600 600 600 600 600 600 600
				600 600 600 600 600 600 600 600
				600 600 600 600 600 600 600 600
				600 600 600 600 600 600 600 600
				600 600 600 600 600 600 600 600
				600 600 600 600 600 600 600 600
				600 600 600 600 600 600 600 600
				600 600 600 600 600 600 600 600
				600 600 600 600 600 600 600 600
				600 600 600 600 600 600 600 600
				600 600 600 600 600 600 600 600
				600 600 600 600 600 600 600 600
				600 600 600 600 600 600 600 600
				600 600 600 600 600 600 600 600
				600 600 600 600 600 600 600 600
				600 600 600 600 600 600 600 600
				600 600 600 600 600 600 600 600
				600 600 600 600 600 600 600 600
				600 600 600 600 600 600 600 600
				600 600 600 600 600 600 600 600
				600 600 600 600 600 600 600 600
				600 600 600 600 600 600 600 600
				600 600 600 600 600 600 600 600
				600 600 600 600 600 600 600 600>;

			PS_Config_Lmt_PenTipY_FW_Diff_N = <
				(-600) (-600) (-600) (-600) (-600) (-600) (-600) (-600)
				(-600) (-600) (-600) (-600) (-600) (-600) (-600) (-600)
				(-600) (-600) (-600) (-600) (-600) (-600) (-600) (-600)
				(-600) (-600) (-600) (-600) (-600) (-600) (-600) (-600)
				(-600) (-600) (-600) (-600) (-600) (-600) (-600) (-600)
				(-600) (-600) (-600) (-600) (-600) (-600) (-600) (-600)
				(-600) (-600) (-600) (-600) (-600) (-600) (-600) (-600)
				(-600) (-600) (-600) (-600) (-600) (-600) (-600) (-600)
				(-600) (-600) (-600) (-600) (-600) (-600) (-600) (-600)
				(-600) (-600) (-600) (-600) (-600) (-600) (-600) (-600)
				(-600) (-600) (-600) (-600) (-600) (-600) (-600) (-600)
				(-600) (-600) (-600) (-600) (-600) (-600) (-600) (-600)
				(-600) (-600) (-600) (-600) (-600) (-600) (-600) (-600)
				(-600) (-600) (-600) (-600) (-600) (-600) (-600) (-600)
				(-600) (-600) (-600) (-600) (-600) (-600) (-600) (-600)
				(-600) (-600) (-600) (-600) (-600) (-600) (-600) (-600)
				(-600) (-600) (-600) (-600) (-600) (-600) (-600) (-600)
				(-600) (-600) (-600) (-600) (-600) (-600) (-600) (-600)
				(-600) (-600) (-600) (-600) (-600) (-600) (-600) (-600)
				(-600) (-600) (-600) (-600) (-600) (-600) (-600) (-600)
				(-600) (-600) (-600) (-600) (-600) (-600) (-600) (-600)
				(-600) (-600) (-600) (-600) (-600) (-600) (-600) (-600)
				(-600) (-600) (-600) (-600) (-600) (-600) (-600) (-600)
				(-600) (-600) (-600) (-600) (-600) (-600) (-600) (-600)
				(-600) (-600) (-600) (-600) (-600) (-600) (-600) (-600)
				(-600) (-600) (-600) (-600) (-600) (-600) (-600) (-600)
				(-600) (-600) (-600) (-600) (-600) (-600) (-600) (-600)
				(-600) (-600) (-600) (-600) (-600) (-600) (-600) (-600)
				(-600) (-600) (-600) (-600) (-600) (-600) (-600) (-600)
				(-600) (-600) (-600) (-600) (-600) (-600) (-600) (-600)
				(-600) (-600) (-600) (-600) (-600) (-600) (-600) (-600)
				(-600) (-600) (-600) (-600) (-600) (-600) (-600) (-600)
				(-600) (-600) (-600) (-600) (-600) (-600) (-600) (-600)
				(-600) (-600) (-600) (-600) (-600) (-600) (-600) (-600)
				(-600) (-600) (-600) (-600) (-600) (-600) (-600) (-600)
				(-600) (-600) (-600) (-600) (-600) (-600) (-600) (-600)
				(-600) (-600) (-600) (-600) (-600) (-600) (-600) (-600)
				(-600) (-600) (-600) (-600) (-600) (-600) (-600) (-600)
				(-600) (-600) (-600) (-600) (-600) (-600) (-600) (-600)
				(-600) (-600) (-600) (-600) (-600) (-600) (-600) (-600)
				(-600) (-600) (-600) (-600) (-600) (-600) (-600) (-600)
				(-600) (-600) (-600) (-600) (-600) (-600) (-600) (-600)
				(-600) (-600) (-600) (-600) (-600) (-600) (-600) (-600)
				(-600) (-600) (-600) (-600) (-600) (-600) (-600) (-600)
				(-600) (-600) (-600) (-600) (-600) (-600) (-600) (-600)
				(-600) (-600) (-600) (-600) (-600) (-600) (-600) (-600)
				(-600) (-600) (-600) (-600) (-600) (-600) (-600) (-600)
				(-600) (-600) (-600) (-600) (-600) (-600) (-600) (-600)
				(-600) (-600) (-600) (-600) (-600) (-600) (-600) (-600)
				(-600) (-600) (-600) (-600) (-600) (-600) (-600) (-600)
				(-600) (-600) (-600) (-600) (-600) (-600) (-600) (-600)
				(-600) (-600) (-600) (-600) (-600) (-600) (-600) (-600)
				(-600) (-600) (-600) (-600) (-600) (-600) (-600) (-600)
				(-600) (-600) (-600) (-600) (-600) (-600) (-600) (-600)
				(-600) (-600) (-600) (-600) (-600) (-600) (-600) (-600)
				(-600) (-600) (-600) (-600) (-600) (-600) (-600) (-600)
				(-600) (-600) (-600) (-600) (-600) (-600) (-600) (-600)
				(-600) (-600) (-600) (-600) (-600) (-600) (-600) (-600)
				(-600) (-600) (-600) (-600) (-600) (-600) (-600) (-600)
				(-600) (-600) (-600) (-600) (-600) (-600) (-600) (-600)
				(-600) (-600) (-600) (-600) (-600) (-600) (-600) (-600)
				(-600) (-600) (-600) (-600) (-600) (-600) (-600) (-600)
				(-600) (-600) (-600) (-600) (-600) (-600) (-600) (-600)
				(-600) (-600) (-600) (-600) (-600) (-600) (-600) (-600)>;

			PS_Config_Lmt_PenRingX_FW_Diff_P = <
				600 600 600 600 600 600 600 600 600 600 600 600 600 600 600 600 600 600 600 600 600 600 600 600 600 600 600 600 600 600 600 600 600 600 600 600 600 600 600 600
				600 600 600 600 600 600 600 600 600 600 600 600 600 600 600 600 600 600 600 600 600 600 600 600 600 600 600 600 600 600 600 600 600 600 600 600 600 600 600 600
				600 600 600 600 600 600 600 600 600 600 600 600 600 600 600 600 600 600 600 600 600 600 600 600 600 600 600 600 600 600 600 600 600 600 600 600 600 600 600 600
				600 600 600 600 600 600 600 600 600 600 600 600 600 600 600 600 600 600 600 600 600 600 600 600 600 600 600 600 600 600 600 600 600 600 600 600 600 600 600 600
				600 600 600 600 600 600 600 600 600 600 600 600 600 600 600 600 600 600 600 600 600 600 600 600 600 600 600 600 600 600 600 600 600 600 600 600 600 600 600 600
				600 600 600 600 600 600 600 600 600 600 600 600 600 600 600 600 600 600 600 600 600 600 600 600 600 600 600 600 600 600 600 600 600 600 600 600 600 600 600 600
				600 600 600 600 600 600 600 600 600 600 600 600 600 600 600 600 600 600 600 600 600 600 600 600 600 600 600 600 600 600 600 600 600 600 600 600 600 600 600 600
				600 600 600 600 600 600 600 600 600 600 600 600 600 600 600 600 600 600 600 600 600 600 600 600 600 600 600 600 600 600 600 600 600 600 600 600 600 600 600 600
				600 600 600 600 600 600 600 600 600 600 600 600 600 600 600 600 600 600 600 600 600 600 600 600 600 600 600 600 600 600 600 600 600 600 600 600 600 600 600 600
				600 600 600 600 600 600 600 600 600 600 600 600 600 600 600 600 600 600 600 600 600 600 600 600 600 600 600 600 600 600 600 600 600 600 600 600 600 600 600 600
				600 600 600 600 600 600 600 600 600 600 600 600 600 600 600 600 600 600 600 600 600 600 600 600 600 600 600 600 600 600 600 600 600 600 600 600 600 600 600 600
				600 600 600 600 600 600 600 600 600 600 600 600 600 600 600 600 600 600 600 600 600 600 600 600 600 600 600 600 600 600 600 600 600 600 600 600 600 600 600 600>;

			PS_Config_Lmt_PenRingX_FW_Diff_N = <
				(-600) (-600) (-600) (-600) (-600) (-600) (-600) (-600) (-600) (-600) (-600) (-600) (-600) (-600) (-600) (-600) (-600) (-600) (-600) (-600) (-600) (-600) (-600) (-600) (-600) (-600) (-600) (-600) (-600) (-600) (-600) (-600) (-600) (-600) (-600) (-600) (-600) (-600) (-600) (-600)
				(-600) (-600) (-600) (-600) (-600) (-600) (-600) (-600) (-600) (-600) (-600) (-600) (-600) (-600) (-600) (-600) (-600) (-600) (-600) (-600) (-600) (-600) (-600) (-600) (-600) (-600) (-600) (-600) (-600) (-600) (-600) (-600) (-600) (-600) (-600) (-600) (-600) (-600) (-600) (-600)
				(-600) (-600) (-600) (-600) (-600) (-600) (-600) (-600) (-600) (-600) (-600) (-600) (-600) (-600) (-600) (-600) (-600) (-600) (-600) (-600) (-600) (-600) (-600) (-600) (-600) (-600) (-600) (-600) (-600) (-600) (-600) (-600) (-600) (-600) (-600) (-600) (-600) (-600) (-600) (-600)
				(-600) (-600) (-600) (-600) (-600) (-600) (-600) (-600) (-600) (-600) (-600) (-600) (-600) (-600) (-600) (-600) (-600) (-600) (-600) (-600) (-600) (-600) (-600) (-600) (-600) (-600) (-600) (-600) (-600) (-600) (-600) (-600) (-600) (-600) (-600) (-600) (-600) (-600) (-600) (-600)
				(-600) (-600) (-600) (-600) (-600) (-600) (-600) (-600) (-600) (-600) (-600) (-600) (-600) (-600) (-600) (-600) (-600) (-600) (-600) (-600) (-600) (-600) (-600) (-600) (-600) (-600) (-600) (-600) (-600) (-600) (-600) (-600) (-600) (-600) (-600) (-600) (-600) (-600) (-600) (-600)
				(-600) (-600) (-600) (-600) (-600) (-600) (-600) (-600) (-600) (-600) (-600) (-600) (-600) (-600) (-600) (-600) (-600) (-600) (-600) (-600) (-600) (-600) (-600) (-600) (-600) (-600) (-600) (-600) (-600) (-600) (-600) (-600) (-600) (-600) (-600) (-600) (-600) (-600) (-600) (-600)
				(-600) (-600) (-600) (-600) (-600) (-600) (-600) (-600) (-600) (-600) (-600) (-600) (-600) (-600) (-600) (-600) (-600) (-600) (-600) (-600) (-600) (-600) (-600) (-600) (-600) (-600) (-600) (-600) (-600) (-600) (-600) (-600) (-600) (-600) (-600) (-600) (-600) (-600) (-600) (-600)
				(-600) (-600) (-600) (-600) (-600) (-600) (-600) (-600) (-600) (-600) (-600) (-600) (-600) (-600) (-600) (-600) (-600) (-600) (-600) (-600) (-600) (-600) (-600) (-600) (-600) (-600) (-600) (-600) (-600) (-600) (-600) (-600) (-600) (-600) (-600) (-600) (-600) (-600) (-600) (-600)
				(-600) (-600) (-600) (-600) (-600) (-600) (-600) (-600) (-600) (-600) (-600) (-600) (-600) (-600) (-600) (-600) (-600) (-600) (-600) (-600) (-600) (-600) (-600) (-600) (-600) (-600) (-600) (-600) (-600) (-600) (-600) (-600) (-600) (-600) (-600) (-600) (-600) (-600) (-600) (-600)
				(-600) (-600) (-600) (-600) (-600) (-600) (-600) (-600) (-600) (-600) (-600) (-600) (-600) (-600) (-600) (-600) (-600) (-600) (-600) (-600) (-600) (-600) (-600) (-600) (-600) (-600) (-600) (-600) (-600) (-600) (-600) (-600) (-600) (-600) (-600) (-600) (-600) (-600) (-600) (-600)
				(-600) (-600) (-600) (-600) (-600) (-600) (-600) (-600) (-600) (-600) (-600) (-600) (-600) (-600) (-600) (-600) (-600) (-600) (-600) (-600) (-600) (-600) (-600) (-600) (-600) (-600) (-600) (-600) (-600) (-600) (-600) (-600) (-600) (-600) (-600) (-600) (-600) (-600) (-600) (-600)
				(-600) (-600) (-600) (-600) (-600) (-600) (-600) (-600) (-600) (-600) (-600) (-600) (-600) (-600) (-600) (-600) (-600) (-600) (-600) (-600) (-600) (-600) (-600) (-600) (-600) (-600) (-600) (-600) (-600) (-600) (-600) (-600) (-600) (-600) (-600) (-600) (-600) (-600) (-600) (-600)>;

			PS_Config_Lmt_PenRingY_FW_Diff_P = <
				600 600 600 600 600 600 600 600
				600 600 600 600 600 600 600 600
				600 600 600 600 600 600 600 600
				600 600 600 600 600 600 600 600
				600 600 600 600 600 600 600 600
				600 600 600 600 600 600 600 600
				600 600 600 600 600 600 600 600
				600 600 600 600 600 600 600 600
				600 600 600 600 600 600 600 600
				600 600 600 600 600 600 600 600
				600 600 600 600 600 600 600 600
				600 600 600 600 600 600 600 600
				600 600 600 600 600 600 600 600
				600 600 600 600 600 600 600 600
				600 600 600 600 600 600 600 600
				600 600 600 600 600 600 600 600
				600 600 600 600 600 600 600 600
				600 600 600 600 600 600 600 600
				600 600 600 600 600 600 600 600
				600 600 600 600 600 600 600 600
				600 600 600 600 600 600 600 600
				600 600 600 600 600 600 600 600
				600 600 600 600 600 600 600 600
				600 600 600 600 600 600 600 600
				600 600 600 600 600 600 600 600
				600 600 600 600 600 600 600 600
				600 600 600 600 600 600 600 600
				600 600 600 600 600 600 600 600
				600 600 600 600 600 600 600 600
				600 600 600 600 600 600 600 600
				600 600 600 600 600 600 600 600
				600 600 600 600 600 600 600 600
				600 600 600 600 600 600 600 600
				600 600 600 600 600 600 600 600
				600 600 600 600 600 600 600 600
				600 600 600 600 600 600 600 600
				600 600 600 600 600 600 600 600
				600 600 600 600 600 600 600 600
				600 600 600 600 600 600 600 600
				600 600 600 600 600 600 600 600
				600 600 600 600 600 600 600 600
				600 600 600 600 600 600 600 600
				600 600 600 600 600 600 600 600
				600 600 600 600 600 600 600 600
				600 600 600 600 600 600 600 600
				600 600 600 600 600 600 600 600
				600 600 600 600 600 600 600 600
				600 600 600 600 600 600 600 600
				600 600 600 600 600 600 600 600
				600 600 600 600 600 600 600 600
				600 600 600 600 600 600 600 600
				600 600 600 600 600 600 600 600
				600 600 600 600 600 600 600 600
				600 600 600 600 600 600 600 600
				600 600 600 600 600 600 600 600
				600 600 600 600 600 600 600 600
				600 600 600 600 600 600 600 600
				600 600 600 600 600 600 600 600
				600 600 600 600 600 600 600 600
				600 600 600 600 600 600 600 600
				600 600 600 600 600 600 600 600
				600 600 600 600 600 600 600 600
				600 600 600 600 600 600 600 600
				600 600 600 600 600 600 600 600>;

			PS_Config_Lmt_PenRingY_FW_Diff_N = <
				(-600) (-600) (-600) (-600) (-600) (-600) (-600) (-600)
				(-600) (-600) (-600) (-600) (-600) (-600) (-600) (-600)
				(-600) (-600) (-600) (-600) (-600) (-600) (-600) (-600)
				(-600) (-600) (-600) (-600) (-600) (-600) (-600) (-600)
				(-600) (-600) (-600) (-600) (-600) (-600) (-600) (-600)
				(-600) (-600) (-600) (-600) (-600) (-600) (-600) (-600)
				(-600) (-600) (-600) (-600) (-600) (-600) (-600) (-600)
				(-600) (-600) (-600) (-600) (-600) (-600) (-600) (-600)
				(-600) (-600) (-600) (-600) (-600) (-600) (-600) (-600)
				(-600) (-600) (-600) (-600) (-600) (-600) (-600) (-600)
				(-600) (-600) (-600) (-600) (-600) (-600) (-600) (-600)
				(-600) (-600) (-600) (-600) (-600) (-600) (-600) (-600)
				(-600) (-600) (-600) (-600) (-600) (-600) (-600) (-600)
				(-600) (-600) (-600) (-600) (-600) (-600) (-600) (-600)
				(-600) (-600) (-600) (-600) (-600) (-600) (-600) (-600)
				(-600) (-600) (-600) (-600) (-600) (-600) (-600) (-600)
				(-600) (-600) (-600) (-600) (-600) (-600) (-600) (-600)
				(-600) (-600) (-600) (-600) (-600) (-600) (-600) (-600)
				(-600) (-600) (-600) (-600) (-600) (-600) (-600) (-600)
				(-600) (-600) (-600) (-600) (-600) (-600) (-600) (-600)
				(-600) (-600) (-600) (-600) (-600) (-600) (-600) (-600)
				(-600) (-600) (-600) (-600) (-600) (-600) (-600) (-600)
				(-600) (-600) (-600) (-600) (-600) (-600) (-600) (-600)
				(-600) (-600) (-600) (-600) (-600) (-600) (-600) (-600)
				(-600) (-600) (-600) (-600) (-600) (-600) (-600) (-600)
				(-600) (-600) (-600) (-600) (-600) (-600) (-600) (-600)
				(-600) (-600) (-600) (-600) (-600) (-600) (-600) (-600)
				(-600) (-600) (-600) (-600) (-600) (-600) (-600) (-600)
				(-600) (-600) (-600) (-600) (-600) (-600) (-600) (-600)
				(-600) (-600) (-600) (-600) (-600) (-600) (-600) (-600)
				(-600) (-600) (-600) (-600) (-600) (-600) (-600) (-600)
				(-600) (-600) (-600) (-600) (-600) (-600) (-600) (-600)
				(-600) (-600) (-600) (-600) (-600) (-600) (-600) (-600)
				(-600) (-600) (-600) (-600) (-600) (-600) (-600) (-600)
				(-600) (-600) (-600) (-600) (-600) (-600) (-600) (-600)
				(-600) (-600) (-600) (-600) (-600) (-600) (-600) (-600)
				(-600) (-600) (-600) (-600) (-600) (-600) (-600) (-600)
				(-600) (-600) (-600) (-600) (-600) (-600) (-600) (-600)
				(-600) (-600) (-600) (-600) (-600) (-600) (-600) (-600)
				(-600) (-600) (-600) (-600) (-600) (-600) (-600) (-600)
				(-600) (-600) (-600) (-600) (-600) (-600) (-600) (-600)
				(-600) (-600) (-600) (-600) (-600) (-600) (-600) (-600)
				(-600) (-600) (-600) (-600) (-600) (-600) (-600) (-600)
				(-600) (-600) (-600) (-600) (-600) (-600) (-600) (-600)
				(-600) (-600) (-600) (-600) (-600) (-600) (-600) (-600)
				(-600) (-600) (-600) (-600) (-600) (-600) (-600) (-600)
				(-600) (-600) (-600) (-600) (-600) (-600) (-600) (-600)
				(-600) (-600) (-600) (-600) (-600) (-600) (-600) (-600)
				(-600) (-600) (-600) (-600) (-600) (-600) (-600) (-600)
				(-600) (-600) (-600) (-600) (-600) (-600) (-600) (-600)
				(-600) (-600) (-600) (-600) (-600) (-600) (-600) (-600)
				(-600) (-600) (-600) (-600) (-600) (-600) (-600) (-600)
				(-600) (-600) (-600) (-600) (-600) (-600) (-600) (-600)
				(-600) (-600) (-600) (-600) (-600) (-600) (-600) (-600)
				(-600) (-600) (-600) (-600) (-600) (-600) (-600) (-600)
				(-600) (-600) (-600) (-600) (-600) (-600) (-600) (-600)
				(-600) (-600) (-600) (-600) (-600) (-600) (-600) (-600)
				(-600) (-600) (-600) (-600) (-600) (-600) (-600) (-600)
				(-600) (-600) (-600) (-600) (-600) (-600) (-600) (-600)
				(-600) (-600) (-600) (-600) (-600) (-600) (-600) (-600)
				(-600) (-600) (-600) (-600) (-600) (-600) (-600) (-600)
				(-600) (-600) (-600) (-600) (-600) (-600) (-600) (-600)
				(-600) (-600) (-600) (-600) (-600) (-600) (-600) (-600)
				(-600) (-600) (-600) (-600) (-600) (-600) (-600) (-600)>;

			PS_Config_Diff_Test_Frame = <50>;
		};
	};
};
